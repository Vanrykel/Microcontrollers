/*******************************************************************************
* File Name: cyfittergnu.inc
* 
* PSoC Creator  4.2
*
* Description:
* 
* This file is automatically generated by PSoC Creator.
*
********************************************************************************
* Copyright (c) 2007-2018 Cypress Semiconductor.  All rights reserved.
* You may use this file only in accordance with the license, terms, conditions, 
* disclaimers, and limitations in the end user license agreement accompanying 
* the software package with which this file was provided.
********************************************************************************/

.ifndef INCLUDED_CYFITTERGNU_INC
.set INCLUDED_CYFITTERGNU_INC, 1
.include "cydevicegnu_trm.inc"

/* SPI */
.set SPI_SCB__BIST_CONTROL, CYREG_SCB0_BIST_CONTROL
.set SPI_SCB__BIST_DATA, CYREG_SCB0_BIST_DATA
.set SPI_SCB__CTRL, CYREG_SCB0_CTRL
.set SPI_SCB__EZ_DATA00, CYREG_SCB0_EZ_DATA00
.set SPI_SCB__EZ_DATA01, CYREG_SCB0_EZ_DATA01
.set SPI_SCB__EZ_DATA02, CYREG_SCB0_EZ_DATA02
.set SPI_SCB__EZ_DATA03, CYREG_SCB0_EZ_DATA03
.set SPI_SCB__EZ_DATA04, CYREG_SCB0_EZ_DATA04
.set SPI_SCB__EZ_DATA05, CYREG_SCB0_EZ_DATA05
.set SPI_SCB__EZ_DATA06, CYREG_SCB0_EZ_DATA06
.set SPI_SCB__EZ_DATA07, CYREG_SCB0_EZ_DATA07
.set SPI_SCB__EZ_DATA08, CYREG_SCB0_EZ_DATA08
.set SPI_SCB__EZ_DATA09, CYREG_SCB0_EZ_DATA09
.set SPI_SCB__EZ_DATA10, CYREG_SCB0_EZ_DATA10
.set SPI_SCB__EZ_DATA11, CYREG_SCB0_EZ_DATA11
.set SPI_SCB__EZ_DATA12, CYREG_SCB0_EZ_DATA12
.set SPI_SCB__EZ_DATA13, CYREG_SCB0_EZ_DATA13
.set SPI_SCB__EZ_DATA14, CYREG_SCB0_EZ_DATA14
.set SPI_SCB__EZ_DATA15, CYREG_SCB0_EZ_DATA15
.set SPI_SCB__EZ_DATA16, CYREG_SCB0_EZ_DATA16
.set SPI_SCB__EZ_DATA17, CYREG_SCB0_EZ_DATA17
.set SPI_SCB__EZ_DATA18, CYREG_SCB0_EZ_DATA18
.set SPI_SCB__EZ_DATA19, CYREG_SCB0_EZ_DATA19
.set SPI_SCB__EZ_DATA20, CYREG_SCB0_EZ_DATA20
.set SPI_SCB__EZ_DATA21, CYREG_SCB0_EZ_DATA21
.set SPI_SCB__EZ_DATA22, CYREG_SCB0_EZ_DATA22
.set SPI_SCB__EZ_DATA23, CYREG_SCB0_EZ_DATA23
.set SPI_SCB__EZ_DATA24, CYREG_SCB0_EZ_DATA24
.set SPI_SCB__EZ_DATA25, CYREG_SCB0_EZ_DATA25
.set SPI_SCB__EZ_DATA26, CYREG_SCB0_EZ_DATA26
.set SPI_SCB__EZ_DATA27, CYREG_SCB0_EZ_DATA27
.set SPI_SCB__EZ_DATA28, CYREG_SCB0_EZ_DATA28
.set SPI_SCB__EZ_DATA29, CYREG_SCB0_EZ_DATA29
.set SPI_SCB__EZ_DATA30, CYREG_SCB0_EZ_DATA30
.set SPI_SCB__EZ_DATA31, CYREG_SCB0_EZ_DATA31
.set SPI_SCB__I2C_CFG, CYREG_SCB0_I2C_CFG
.set SPI_SCB__I2C_CTRL, CYREG_SCB0_I2C_CTRL
.set SPI_SCB__I2C_M_CMD, CYREG_SCB0_I2C_M_CMD
.set SPI_SCB__I2C_S_CMD, CYREG_SCB0_I2C_S_CMD
.set SPI_SCB__I2C_STATUS, CYREG_SCB0_I2C_STATUS
.set SPI_SCB__INTR_CAUSE, CYREG_SCB0_INTR_CAUSE
.set SPI_SCB__INTR_I2C_EC, CYREG_SCB0_INTR_I2C_EC
.set SPI_SCB__INTR_I2C_EC_MASK, CYREG_SCB0_INTR_I2C_EC_MASK
.set SPI_SCB__INTR_I2C_EC_MASKED, CYREG_SCB0_INTR_I2C_EC_MASKED
.set SPI_SCB__INTR_M, CYREG_SCB0_INTR_M
.set SPI_SCB__INTR_M_MASK, CYREG_SCB0_INTR_M_MASK
.set SPI_SCB__INTR_M_MASKED, CYREG_SCB0_INTR_M_MASKED
.set SPI_SCB__INTR_M_SET, CYREG_SCB0_INTR_M_SET
.set SPI_SCB__INTR_RX, CYREG_SCB0_INTR_RX
.set SPI_SCB__INTR_RX_MASK, CYREG_SCB0_INTR_RX_MASK
.set SPI_SCB__INTR_RX_MASKED, CYREG_SCB0_INTR_RX_MASKED
.set SPI_SCB__INTR_RX_SET, CYREG_SCB0_INTR_RX_SET
.set SPI_SCB__INTR_S, CYREG_SCB0_INTR_S
.set SPI_SCB__INTR_S_MASK, CYREG_SCB0_INTR_S_MASK
.set SPI_SCB__INTR_S_MASKED, CYREG_SCB0_INTR_S_MASKED
.set SPI_SCB__INTR_S_SET, CYREG_SCB0_INTR_S_SET
.set SPI_SCB__INTR_SPI_EC, CYREG_SCB0_INTR_SPI_EC
.set SPI_SCB__INTR_SPI_EC_MASK, CYREG_SCB0_INTR_SPI_EC_MASK
.set SPI_SCB__INTR_SPI_EC_MASKED, CYREG_SCB0_INTR_SPI_EC_MASKED
.set SPI_SCB__INTR_TX, CYREG_SCB0_INTR_TX
.set SPI_SCB__INTR_TX_MASK, CYREG_SCB0_INTR_TX_MASK
.set SPI_SCB__INTR_TX_MASKED, CYREG_SCB0_INTR_TX_MASKED
.set SPI_SCB__INTR_TX_SET, CYREG_SCB0_INTR_TX_SET
.set SPI_SCB__RX_CTRL, CYREG_SCB0_RX_CTRL
.set SPI_SCB__RX_FIFO_CTRL, CYREG_SCB0_RX_FIFO_CTRL
.set SPI_SCB__RX_FIFO_RD, CYREG_SCB0_RX_FIFO_RD
.set SPI_SCB__RX_FIFO_RD_SILENT, CYREG_SCB0_RX_FIFO_RD_SILENT
.set SPI_SCB__RX_FIFO_STATUS, CYREG_SCB0_RX_FIFO_STATUS
.set SPI_SCB__RX_MATCH, CYREG_SCB0_RX_MATCH
.set SPI_SCB__SPI_CTRL, CYREG_SCB0_SPI_CTRL
.set SPI_SCB__SPI_STATUS, CYREG_SCB0_SPI_STATUS
.set SPI_SCB__SS0_POSISTION, 0
.set SPI_SCB__SS1_POSISTION, 1
.set SPI_SCB__SS2_POSISTION, 2
.set SPI_SCB__SS3_POSISTION, 3
.set SPI_SCB__STATUS, CYREG_SCB0_STATUS
.set SPI_SCB__TX_CTRL, CYREG_SCB0_TX_CTRL
.set SPI_SCB__TX_FIFO_CTRL, CYREG_SCB0_TX_FIFO_CTRL
.set SPI_SCB__TX_FIFO_STATUS, CYREG_SCB0_TX_FIFO_STATUS
.set SPI_SCB__TX_FIFO_WR, CYREG_SCB0_TX_FIFO_WR
.set SPI_SCB__UART_CTRL, CYREG_SCB0_UART_CTRL
.set SPI_SCB__UART_RX_CTRL, CYREG_SCB0_UART_RX_CTRL
.set SPI_SCB__UART_RX_STATUS, CYREG_SCB0_UART_RX_STATUS
.set SPI_SCB__UART_TX_CTRL, CYREG_SCB0_UART_TX_CTRL
.set SPI_SCBCLK__DIVIDER_MASK, 0x0000FFFF
.set SPI_SCBCLK__ENABLE, CYREG_CLK_DIVIDER_A00
.set SPI_SCBCLK__ENABLE_MASK, 0x80000000
.set SPI_SCBCLK__MASK, 0x80000000
.set SPI_SCBCLK__REGISTER, CYREG_CLK_DIVIDER_A00

/* Pin_1 */
.set Pin_1__0__DM__MASK, 0x07
.set Pin_1__0__DM__SHIFT, 0
.set Pin_1__0__DR, CYREG_PRT4_DR
.set Pin_1__0__HSIOM, CYREG_HSIOM_PORT_SEL4
.set Pin_1__0__HSIOM_GPIO, 0
.set Pin_1__0__HSIOM_I2C, 14
.set Pin_1__0__HSIOM_I2C_SCL, 14
.set Pin_1__0__HSIOM_MASK, 0x0000000F
.set Pin_1__0__HSIOM_SHIFT, 0
.set Pin_1__0__HSIOM_SPI, 15
.set Pin_1__0__HSIOM_SPI_MOSI, 15
.set Pin_1__0__HSIOM_UART, 9
.set Pin_1__0__HSIOM_UART_RX, 9
.set Pin_1__0__INTCFG, CYREG_PRT4_INTCFG
.set Pin_1__0__INTSTAT, CYREG_PRT4_INTSTAT
.set Pin_1__0__MASK, 0x01
.set Pin_1__0__PC, CYREG_PRT4_PC
.set Pin_1__0__PC2, CYREG_PRT4_PC2
.set Pin_1__0__PORT, 4
.set Pin_1__0__PS, CYREG_PRT4_PS
.set Pin_1__0__SHIFT, 0
.set Pin_1__DR, CYREG_PRT4_DR
.set Pin_1__INTCFG, CYREG_PRT4_INTCFG
.set Pin_1__INTSTAT, CYREG_PRT4_INTSTAT
.set Pin_1__MASK, 0x01
.set Pin_1__PC, CYREG_PRT4_PC
.set Pin_1__PC2, CYREG_PRT4_PC2
.set Pin_1__PORT, 4
.set Pin_1__PS, CYREG_PRT4_PS
.set Pin_1__SHIFT, 0

/* Miscellaneous */
.set CYDEV_BCLK__HFCLK__HZ, 24000000
.set CYDEV_BCLK__HFCLK__KHZ, 24000
.set CYDEV_BCLK__HFCLK__MHZ, 24
.set CYDEV_BCLK__SYSCLK__HZ, 24000000
.set CYDEV_BCLK__SYSCLK__KHZ, 24000
.set CYDEV_BCLK__SYSCLK__MHZ, 24
.set CYDEV_CHIP_DIE_LEOPARD, 1
.set CYDEV_CHIP_DIE_PSOC4A, 18
.set CYDEV_CHIP_DIE_PSOC5LP, 2
.set CYDEV_CHIP_DIE_PSOC5TM, 3
.set CYDEV_CHIP_DIE_TMA4, 4
.set CYDEV_CHIP_DIE_UNKNOWN, 0
.set CYDEV_CHIP_FAMILY_FM0P, 5
.set CYDEV_CHIP_FAMILY_FM3, 6
.set CYDEV_CHIP_FAMILY_FM4, 7
.set CYDEV_CHIP_FAMILY_PSOC3, 1
.set CYDEV_CHIP_FAMILY_PSOC4, 2
.set CYDEV_CHIP_FAMILY_PSOC5, 3
.set CYDEV_CHIP_FAMILY_PSOC6, 4
.set CYDEV_CHIP_FAMILY_UNKNOWN, 0
.set CYDEV_CHIP_FAMILY_USED, CYDEV_CHIP_FAMILY_PSOC4
.set CYDEV_CHIP_JTAG_ID, 0x04C81193
.set CYDEV_CHIP_MEMBER_3A, 1
.set CYDEV_CHIP_MEMBER_4A, 18
.set CYDEV_CHIP_MEMBER_4D, 13
.set CYDEV_CHIP_MEMBER_4E, 6
.set CYDEV_CHIP_MEMBER_4F, 19
.set CYDEV_CHIP_MEMBER_4G, 4
.set CYDEV_CHIP_MEMBER_4H, 17
.set CYDEV_CHIP_MEMBER_4I, 23
.set CYDEV_CHIP_MEMBER_4J, 14
.set CYDEV_CHIP_MEMBER_4K, 15
.set CYDEV_CHIP_MEMBER_4L, 22
.set CYDEV_CHIP_MEMBER_4M, 21
.set CYDEV_CHIP_MEMBER_4N, 10
.set CYDEV_CHIP_MEMBER_4O, 7
.set CYDEV_CHIP_MEMBER_4P, 20
.set CYDEV_CHIP_MEMBER_4Q, 12
.set CYDEV_CHIP_MEMBER_4R, 8
.set CYDEV_CHIP_MEMBER_4S, 11
.set CYDEV_CHIP_MEMBER_4T, 9
.set CYDEV_CHIP_MEMBER_4U, 5
.set CYDEV_CHIP_MEMBER_4V, 16
.set CYDEV_CHIP_MEMBER_5A, 3
.set CYDEV_CHIP_MEMBER_5B, 2
.set CYDEV_CHIP_MEMBER_6A, 24
.set CYDEV_CHIP_MEMBER_FM3, 28
.set CYDEV_CHIP_MEMBER_FM4, 29
.set CYDEV_CHIP_MEMBER_PDL_FM0P_TYPE1, 25
.set CYDEV_CHIP_MEMBER_PDL_FM0P_TYPE2, 26
.set CYDEV_CHIP_MEMBER_PDL_FM0P_TYPE3, 27
.set CYDEV_CHIP_MEMBER_UNKNOWN, 0
.set CYDEV_CHIP_MEMBER_USED, CYDEV_CHIP_MEMBER_4A
.set CYDEV_CHIP_DIE_EXPECT, CYDEV_CHIP_MEMBER_USED
.set CYDEV_CHIP_DIE_ACTUAL, CYDEV_CHIP_DIE_EXPECT
.set CYDEV_CHIP_REV_LEOPARD_ES1, 0
.set CYDEV_CHIP_REV_LEOPARD_ES2, 1
.set CYDEV_CHIP_REV_LEOPARD_ES3, 3
.set CYDEV_CHIP_REV_LEOPARD_PRODUCTION, 3
.set CYDEV_CHIP_REV_PSOC4A_ES0, 17
.set CYDEV_CHIP_REV_PSOC4A_PRODUCTION, 17
.set CYDEV_CHIP_REV_PSOC5LP_ES0, 0
.set CYDEV_CHIP_REV_PSOC5LP_PRODUCTION, 0
.set CYDEV_CHIP_REV_PSOC5TM_ES0, 0
.set CYDEV_CHIP_REV_PSOC5TM_ES1, 1
.set CYDEV_CHIP_REV_PSOC5TM_PRODUCTION, 1
.set CYDEV_CHIP_REV_TMA4_ES, 17
.set CYDEV_CHIP_REV_TMA4_ES2, 33
.set CYDEV_CHIP_REV_TMA4_PRODUCTION, 17
.set CYDEV_CHIP_REVISION_3A_ES1, 0
.set CYDEV_CHIP_REVISION_3A_ES2, 1
.set CYDEV_CHIP_REVISION_3A_ES3, 3
.set CYDEV_CHIP_REVISION_3A_PRODUCTION, 3
.set CYDEV_CHIP_REVISION_4A_ES0, 17
.set CYDEV_CHIP_REVISION_4A_PRODUCTION, 17
.set CYDEV_CHIP_REVISION_4D_PRODUCTION, 0
.set CYDEV_CHIP_REVISION_4E_CCG2_NO_USBPD, 0
.set CYDEV_CHIP_REVISION_4E_PRODUCTION, 0
.set CYDEV_CHIP_REVISION_4F_PRODUCTION, 0
.set CYDEV_CHIP_REVISION_4F_PRODUCTION_256DMA, 0
.set CYDEV_CHIP_REVISION_4F_PRODUCTION_256K, 0
.set CYDEV_CHIP_REVISION_4G_ES, 17
.set CYDEV_CHIP_REVISION_4G_ES2, 33
.set CYDEV_CHIP_REVISION_4G_PRODUCTION, 17
.set CYDEV_CHIP_REVISION_4H_PRODUCTION, 0
.set CYDEV_CHIP_REVISION_4I_PRODUCTION, 0
.set CYDEV_CHIP_REVISION_4J_PRODUCTION, 0
.set CYDEV_CHIP_REVISION_4K_PRODUCTION, 0
.set CYDEV_CHIP_REVISION_4L_PRODUCTION, 0
.set CYDEV_CHIP_REVISION_4M_PRODUCTION, 0
.set CYDEV_CHIP_REVISION_4N_PRODUCTION, 0
.set CYDEV_CHIP_REVISION_4O_PRODUCTION, 0
.set CYDEV_CHIP_REVISION_4P_PRODUCTION, 0
.set CYDEV_CHIP_REVISION_4Q_PRODUCTION, 0
.set CYDEV_CHIP_REVISION_4R_PRODUCTION, 0
.set CYDEV_CHIP_REVISION_4S_PRODUCTION, 0
.set CYDEV_CHIP_REVISION_4T_PRODUCTION, 0
.set CYDEV_CHIP_REVISION_4U_PRODUCTION, 0
.set CYDEV_CHIP_REVISION_4V_PRODUCTION, 0
.set CYDEV_CHIP_REVISION_5A_ES0, 0
.set CYDEV_CHIP_REVISION_5A_ES1, 1
.set CYDEV_CHIP_REVISION_5A_PRODUCTION, 1
.set CYDEV_CHIP_REVISION_5B_ES0, 0
.set CYDEV_CHIP_REVISION_5B_PRODUCTION, 0
.set CYDEV_CHIP_REVISION_6A_ES, 17
.set CYDEV_CHIP_REVISION_6A_NO_UDB, 33
.set CYDEV_CHIP_REVISION_6A_PRODUCTION, 33
.set CYDEV_CHIP_REVISION_FM3_PRODUCTION, 0
.set CYDEV_CHIP_REVISION_FM4_PRODUCTION, 0
.set CYDEV_CHIP_REVISION_PDL_FM0P_TYPE1_PRODUCTION, 0
.set CYDEV_CHIP_REVISION_PDL_FM0P_TYPE2_PRODUCTION, 0
.set CYDEV_CHIP_REVISION_PDL_FM0P_TYPE3_PRODUCTION, 0
.set CYDEV_CHIP_REVISION_USED, CYDEV_CHIP_REVISION_4A_PRODUCTION
.set CYDEV_CHIP_REV_EXPECT, CYDEV_CHIP_REVISION_USED
.set CYDEV_CONFIG_READ_ACCELERATOR, 1
.set CYDEV_CONFIG_UNUSED_IO_AllowButWarn, 0
.set CYDEV_CONFIG_UNUSED_IO_AllowWithInfo, 1
.set CYDEV_CONFIG_UNUSED_IO_Disallowed, 2
.set CYDEV_CONFIG_UNUSED_IO, CYDEV_CONFIG_UNUSED_IO_Disallowed
.set CYDEV_CONFIGURATION_COMPRESSED, 1
.set CYDEV_CONFIGURATION_MODE_COMPRESSED, 0
.set CYDEV_CONFIGURATION_MODE, CYDEV_CONFIGURATION_MODE_COMPRESSED
.set CYDEV_CONFIGURATION_MODE_DMA, 2
.set CYDEV_CONFIGURATION_MODE_UNCOMPRESSED, 1
.set CYDEV_DEBUG_PROTECT_KILL, 4
.set CYDEV_DEBUG_PROTECT_OPEN, 1
.set CYDEV_DEBUG_PROTECT, CYDEV_DEBUG_PROTECT_OPEN
.set CYDEV_DEBUG_PROTECT_PROTECTED, 2
.set CYDEV_DEBUGGING_DPS_Disable, 3
.set CYDEV_DEBUGGING_DPS_SWD, 2
.set CYDEV_DEBUGGING_DPS, CYDEV_DEBUGGING_DPS_SWD
.set CYDEV_DEBUGGING_ENABLE, 1
.set CYDEV_DFT_SELECT_CLK0, 1
.set CYDEV_DFT_SELECT_CLK1, 2
.set CYDEV_HEAP_SIZE, 0x80
.set CYDEV_IMO_TRIMMED_BY_USB, 0
.set CYDEV_IMO_TRIMMED_BY_WCO, 0
.set CYDEV_IS_EXPORTING_CODE, 0
.set CYDEV_IS_IMPORTING_CODE, 0
.set CYDEV_PROJ_TYPE, 0
.set CYDEV_PROJ_TYPE_BOOTLOADER, 1
.set CYDEV_PROJ_TYPE_LAUNCHER, 5
.set CYDEV_PROJ_TYPE_LOADABLE, 2
.set CYDEV_PROJ_TYPE_LOADABLEANDBOOTLOADER, 4
.set CYDEV_PROJ_TYPE_MULTIAPPBOOTLOADER, 3
.set CYDEV_PROJ_TYPE_STANDARD, 0
.set CYDEV_STACK_SIZE, 0x0400
.set CYDEV_USE_BUNDLED_CMSIS, 1
.set CYDEV_VARIABLE_VDDA, 1
.set CYDEV_VDDA_MV, 3300
.set CYDEV_VDDD_MV, 3300
.set CYDEV_WDT_GENERATE_ISR, 1
.set CYIPBLOCK_M0S8_CTBM_VERSION, 0
.set CYIPBLOCK_m0s8cpuss_VERSION, 0
.set CYIPBLOCK_m0s8csd_VERSION, 0
.set CYIPBLOCK_m0s8gpio2_VERSION, 0
.set CYIPBLOCK_m0s8hsiom4a_VERSION, 0
.set CYIPBLOCK_m0s8lcd_VERSION, 0
.set CYIPBLOCK_m0s8lpcomp_VERSION, 0
.set CYIPBLOCK_m0s8pclk_VERSION, 0
.set CYIPBLOCK_m0s8sar_VERSION, 0
.set CYIPBLOCK_m0s8scb_VERSION, 0
.set CYIPBLOCK_m0s8srssv2_VERSION, 1
.set CYIPBLOCK_m0s8tcpwm_VERSION, 0
.set CYIPBLOCK_m0s8udbif_VERSION, 0
.set CYIPBLOCK_S8_GPIO_VERSION, 2
.set CYDEV_BOOTLOADER_ENABLE, 0
.endif
