;
; File Name: cyfitterrv.inc
; 
; PSoC Creator  4.2
;
; Description:
; 
;
;-------------------------------------------------------------------------------
; Copyright (c) 2007-2018 Cypress Semiconductor.  All rights reserved.
; You may use this file only in accordance with the license, terms, conditions, 
; disclaimers, and limitations in the end user license agreement accompanying 
; the software package with which this file was provided.
;-------------------------------------------------------------------------------

    IF :LNOT::DEF:INCLUDED_CYFITTERRV_INC
INCLUDED_CYFITTERRV_INC EQU 1
    GET cydevicerv_trm.inc

; PWM
PWM_cy_m0s8_tcpwm_1__CC EQU CYREG_TCPWM_CNT1_CC
PWM_cy_m0s8_tcpwm_1__CC_BUFF EQU CYREG_TCPWM_CNT1_CC_BUFF
PWM_cy_m0s8_tcpwm_1__COUNTER EQU CYREG_TCPWM_CNT1_COUNTER
PWM_cy_m0s8_tcpwm_1__CTRL EQU CYREG_TCPWM_CNT1_CTRL
PWM_cy_m0s8_tcpwm_1__INTR EQU CYREG_TCPWM_CNT1_INTR
PWM_cy_m0s8_tcpwm_1__INTR_MASK EQU CYREG_TCPWM_CNT1_INTR_MASK
PWM_cy_m0s8_tcpwm_1__INTR_MASKED EQU CYREG_TCPWM_CNT1_INTR_MASKED
PWM_cy_m0s8_tcpwm_1__INTR_SET EQU CYREG_TCPWM_CNT1_INTR_SET
PWM_cy_m0s8_tcpwm_1__PERIOD EQU CYREG_TCPWM_CNT1_PERIOD
PWM_cy_m0s8_tcpwm_1__PERIOD_BUFF EQU CYREG_TCPWM_CNT1_PERIOD_BUFF
PWM_cy_m0s8_tcpwm_1__STATUS EQU CYREG_TCPWM_CNT1_STATUS
PWM_cy_m0s8_tcpwm_1__TCPWM_CMD EQU CYREG_TCPWM_CMD
PWM_cy_m0s8_tcpwm_1__TCPWM_CMDCAPTURE_MASK EQU 0x02
PWM_cy_m0s8_tcpwm_1__TCPWM_CMDCAPTURE_SHIFT EQU 1
PWM_cy_m0s8_tcpwm_1__TCPWM_CMDRELOAD_MASK EQU 0x200
PWM_cy_m0s8_tcpwm_1__TCPWM_CMDRELOAD_SHIFT EQU 9
PWM_cy_m0s8_tcpwm_1__TCPWM_CMDSTART_MASK EQU 0x2000000
PWM_cy_m0s8_tcpwm_1__TCPWM_CMDSTART_SHIFT EQU 25
PWM_cy_m0s8_tcpwm_1__TCPWM_CMDSTOP_MASK EQU 0x20000
PWM_cy_m0s8_tcpwm_1__TCPWM_CMDSTOP_SHIFT EQU 17
PWM_cy_m0s8_tcpwm_1__TCPWM_CTRL EQU CYREG_TCPWM_CTRL
PWM_cy_m0s8_tcpwm_1__TCPWM_CTRL_MASK EQU 0x02
PWM_cy_m0s8_tcpwm_1__TCPWM_CTRL_SHIFT EQU 1
PWM_cy_m0s8_tcpwm_1__TCPWM_INTR_CAUSE EQU CYREG_TCPWM_INTR_CAUSE
PWM_cy_m0s8_tcpwm_1__TCPWM_INTR_CAUSE_MASK EQU 0x02
PWM_cy_m0s8_tcpwm_1__TCPWM_INTR_CAUSE_SHIFT EQU 1
PWM_cy_m0s8_tcpwm_1__TCPWM_NUMBER EQU 1
PWM_cy_m0s8_tcpwm_1__TR_CTRL0 EQU CYREG_TCPWM_CNT1_TR_CTRL0
PWM_cy_m0s8_tcpwm_1__TR_CTRL1 EQU CYREG_TCPWM_CNT1_TR_CTRL1
PWM_cy_m0s8_tcpwm_1__TR_CTRL2 EQU CYREG_TCPWM_CNT1_TR_CTRL2
PWM_steering__0__DM__MASK EQU 0xE00000
PWM_steering__0__DM__SHIFT EQU 21
PWM_steering__0__DR EQU CYREG_PRT0_DR
PWM_steering__0__HSIOM EQU CYREG_HSIOM_PORT_SEL0
PWM_steering__0__HSIOM_MASK EQU 0xF0000000
PWM_steering__0__HSIOM_SHIFT EQU 28
PWM_steering__0__INTCFG EQU CYREG_PRT0_INTCFG
PWM_steering__0__INTSTAT EQU CYREG_PRT0_INTSTAT
PWM_steering__0__MASK EQU 0x80
PWM_steering__0__PA__CFG0 EQU CYREG_UDB_PA0_CFG0
PWM_steering__0__PA__CFG1 EQU CYREG_UDB_PA0_CFG1
PWM_steering__0__PA__CFG10 EQU CYREG_UDB_PA0_CFG10
PWM_steering__0__PA__CFG11 EQU CYREG_UDB_PA0_CFG11
PWM_steering__0__PA__CFG12 EQU CYREG_UDB_PA0_CFG12
PWM_steering__0__PA__CFG13 EQU CYREG_UDB_PA0_CFG13
PWM_steering__0__PA__CFG14 EQU CYREG_UDB_PA0_CFG14
PWM_steering__0__PA__CFG2 EQU CYREG_UDB_PA0_CFG2
PWM_steering__0__PA__CFG3 EQU CYREG_UDB_PA0_CFG3
PWM_steering__0__PA__CFG4 EQU CYREG_UDB_PA0_CFG4
PWM_steering__0__PA__CFG5 EQU CYREG_UDB_PA0_CFG5
PWM_steering__0__PA__CFG6 EQU CYREG_UDB_PA0_CFG6
PWM_steering__0__PA__CFG7 EQU CYREG_UDB_PA0_CFG7
PWM_steering__0__PA__CFG8 EQU CYREG_UDB_PA0_CFG8
PWM_steering__0__PA__CFG9 EQU CYREG_UDB_PA0_CFG9
PWM_steering__0__PC EQU CYREG_PRT0_PC
PWM_steering__0__PC2 EQU CYREG_PRT0_PC2
PWM_steering__0__PORT EQU 0
PWM_steering__0__PS EQU CYREG_PRT0_PS
PWM_steering__0__SHIFT EQU 7
PWM_steering__DR EQU CYREG_PRT0_DR
PWM_steering__INTCFG EQU CYREG_PRT0_INTCFG
PWM_steering__INTSTAT EQU CYREG_PRT0_INTSTAT
PWM_steering__MASK EQU 0x80
PWM_steering__PA__CFG0 EQU CYREG_UDB_PA0_CFG0
PWM_steering__PA__CFG1 EQU CYREG_UDB_PA0_CFG1
PWM_steering__PA__CFG10 EQU CYREG_UDB_PA0_CFG10
PWM_steering__PA__CFG11 EQU CYREG_UDB_PA0_CFG11
PWM_steering__PA__CFG12 EQU CYREG_UDB_PA0_CFG12
PWM_steering__PA__CFG13 EQU CYREG_UDB_PA0_CFG13
PWM_steering__PA__CFG14 EQU CYREG_UDB_PA0_CFG14
PWM_steering__PA__CFG2 EQU CYREG_UDB_PA0_CFG2
PWM_steering__PA__CFG3 EQU CYREG_UDB_PA0_CFG3
PWM_steering__PA__CFG4 EQU CYREG_UDB_PA0_CFG4
PWM_steering__PA__CFG5 EQU CYREG_UDB_PA0_CFG5
PWM_steering__PA__CFG6 EQU CYREG_UDB_PA0_CFG6
PWM_steering__PA__CFG7 EQU CYREG_UDB_PA0_CFG7
PWM_steering__PA__CFG8 EQU CYREG_UDB_PA0_CFG8
PWM_steering__PA__CFG9 EQU CYREG_UDB_PA0_CFG9
PWM_steering__PC EQU CYREG_PRT0_PC
PWM_steering__PC2 EQU CYREG_PRT0_PC2
PWM_steering__PORT EQU 0
PWM_steering__PS EQU CYREG_PRT0_PS
PWM_steering__SHIFT EQU 7
PWM_throttle__0__DM__MASK EQU 0xE00000
PWM_throttle__0__DM__SHIFT EQU 21
PWM_throttle__0__DR EQU CYREG_PRT3_DR
PWM_throttle__0__HSIOM EQU CYREG_HSIOM_PORT_SEL3
PWM_throttle__0__HSIOM_MASK EQU 0xF0000000
PWM_throttle__0__HSIOM_SHIFT EQU 28
PWM_throttle__0__INTCFG EQU CYREG_PRT3_INTCFG
PWM_throttle__0__INTSTAT EQU CYREG_PRT3_INTSTAT
PWM_throttle__0__MASK EQU 0x80
PWM_throttle__0__PA__CFG0 EQU CYREG_UDB_PA3_CFG0
PWM_throttle__0__PA__CFG1 EQU CYREG_UDB_PA3_CFG1
PWM_throttle__0__PA__CFG10 EQU CYREG_UDB_PA3_CFG10
PWM_throttle__0__PA__CFG11 EQU CYREG_UDB_PA3_CFG11
PWM_throttle__0__PA__CFG12 EQU CYREG_UDB_PA3_CFG12
PWM_throttle__0__PA__CFG13 EQU CYREG_UDB_PA3_CFG13
PWM_throttle__0__PA__CFG14 EQU CYREG_UDB_PA3_CFG14
PWM_throttle__0__PA__CFG2 EQU CYREG_UDB_PA3_CFG2
PWM_throttle__0__PA__CFG3 EQU CYREG_UDB_PA3_CFG3
PWM_throttle__0__PA__CFG4 EQU CYREG_UDB_PA3_CFG4
PWM_throttle__0__PA__CFG5 EQU CYREG_UDB_PA3_CFG5
PWM_throttle__0__PA__CFG6 EQU CYREG_UDB_PA3_CFG6
PWM_throttle__0__PA__CFG7 EQU CYREG_UDB_PA3_CFG7
PWM_throttle__0__PA__CFG8 EQU CYREG_UDB_PA3_CFG8
PWM_throttle__0__PA__CFG9 EQU CYREG_UDB_PA3_CFG9
PWM_throttle__0__PC EQU CYREG_PRT3_PC
PWM_throttle__0__PC2 EQU CYREG_PRT3_PC2
PWM_throttle__0__PORT EQU 3
PWM_throttle__0__PS EQU CYREG_PRT3_PS
PWM_throttle__0__SHIFT EQU 7
PWM_throttle__DR EQU CYREG_PRT3_DR
PWM_throttle__INTCFG EQU CYREG_PRT3_INTCFG
PWM_throttle__INTSTAT EQU CYREG_PRT3_INTSTAT
PWM_throttle__MASK EQU 0x80
PWM_throttle__PA__CFG0 EQU CYREG_UDB_PA3_CFG0
PWM_throttle__PA__CFG1 EQU CYREG_UDB_PA3_CFG1
PWM_throttle__PA__CFG10 EQU CYREG_UDB_PA3_CFG10
PWM_throttle__PA__CFG11 EQU CYREG_UDB_PA3_CFG11
PWM_throttle__PA__CFG12 EQU CYREG_UDB_PA3_CFG12
PWM_throttle__PA__CFG13 EQU CYREG_UDB_PA3_CFG13
PWM_throttle__PA__CFG14 EQU CYREG_UDB_PA3_CFG14
PWM_throttle__PA__CFG2 EQU CYREG_UDB_PA3_CFG2
PWM_throttle__PA__CFG3 EQU CYREG_UDB_PA3_CFG3
PWM_throttle__PA__CFG4 EQU CYREG_UDB_PA3_CFG4
PWM_throttle__PA__CFG5 EQU CYREG_UDB_PA3_CFG5
PWM_throttle__PA__CFG6 EQU CYREG_UDB_PA3_CFG6
PWM_throttle__PA__CFG7 EQU CYREG_UDB_PA3_CFG7
PWM_throttle__PA__CFG8 EQU CYREG_UDB_PA3_CFG8
PWM_throttle__PA__CFG9 EQU CYREG_UDB_PA3_CFG9
PWM_throttle__PC EQU CYREG_PRT3_PC
PWM_throttle__PC2 EQU CYREG_PRT3_PC2
PWM_throttle__PORT EQU 3
PWM_throttle__PS EQU CYREG_PRT3_PS
PWM_throttle__SHIFT EQU 7

; Clock_2
Clock_2__DIVIDER_MASK EQU 0x0000FFFF
Clock_2__ENABLE EQU CYREG_CLK_DIVIDER_A00
Clock_2__ENABLE_MASK EQU 0x80000000
Clock_2__MASK EQU 0x80000000
Clock_2__REGISTER EQU CYREG_CLK_DIVIDER_A00

; INT_125
INT_125__INTC_CLR_EN_REG EQU CYREG_CM0_ICER
INT_125__INTC_CLR_PD_REG EQU CYREG_CM0_ICPR
INT_125__INTC_MASK EQU 0x10000
INT_125__INTC_NUMBER EQU 16
INT_125__INTC_PRIOR_MASK EQU 0xC0
INT_125__INTC_PRIOR_NUM EQU 3
INT_125__INTC_PRIOR_REG EQU CYREG_CM0_IPR4
INT_125__INTC_SET_EN_REG EQU CYREG_CM0_ISER
INT_125__INTC_SET_PD_REG EQU CYREG_CM0_ISPR

; Timer_1
Timer_1_cy_m0s8_tcpwm_1__CC EQU CYREG_TCPWM_CNT2_CC
Timer_1_cy_m0s8_tcpwm_1__CC_BUFF EQU CYREG_TCPWM_CNT2_CC_BUFF
Timer_1_cy_m0s8_tcpwm_1__COUNTER EQU CYREG_TCPWM_CNT2_COUNTER
Timer_1_cy_m0s8_tcpwm_1__CTRL EQU CYREG_TCPWM_CNT2_CTRL
Timer_1_cy_m0s8_tcpwm_1__INTR EQU CYREG_TCPWM_CNT2_INTR
Timer_1_cy_m0s8_tcpwm_1__INTR_MASK EQU CYREG_TCPWM_CNT2_INTR_MASK
Timer_1_cy_m0s8_tcpwm_1__INTR_MASKED EQU CYREG_TCPWM_CNT2_INTR_MASKED
Timer_1_cy_m0s8_tcpwm_1__INTR_SET EQU CYREG_TCPWM_CNT2_INTR_SET
Timer_1_cy_m0s8_tcpwm_1__PERIOD EQU CYREG_TCPWM_CNT2_PERIOD
Timer_1_cy_m0s8_tcpwm_1__PERIOD_BUFF EQU CYREG_TCPWM_CNT2_PERIOD_BUFF
Timer_1_cy_m0s8_tcpwm_1__STATUS EQU CYREG_TCPWM_CNT2_STATUS
Timer_1_cy_m0s8_tcpwm_1__TCPWM_CMD EQU CYREG_TCPWM_CMD
Timer_1_cy_m0s8_tcpwm_1__TCPWM_CMDCAPTURE_MASK EQU 0x04
Timer_1_cy_m0s8_tcpwm_1__TCPWM_CMDCAPTURE_SHIFT EQU 2
Timer_1_cy_m0s8_tcpwm_1__TCPWM_CMDRELOAD_MASK EQU 0x400
Timer_1_cy_m0s8_tcpwm_1__TCPWM_CMDRELOAD_SHIFT EQU 10
Timer_1_cy_m0s8_tcpwm_1__TCPWM_CMDSTART_MASK EQU 0x4000000
Timer_1_cy_m0s8_tcpwm_1__TCPWM_CMDSTART_SHIFT EQU 26
Timer_1_cy_m0s8_tcpwm_1__TCPWM_CMDSTOP_MASK EQU 0x40000
Timer_1_cy_m0s8_tcpwm_1__TCPWM_CMDSTOP_SHIFT EQU 18
Timer_1_cy_m0s8_tcpwm_1__TCPWM_CTRL EQU CYREG_TCPWM_CTRL
Timer_1_cy_m0s8_tcpwm_1__TCPWM_CTRL_MASK EQU 0x04
Timer_1_cy_m0s8_tcpwm_1__TCPWM_CTRL_SHIFT EQU 2
Timer_1_cy_m0s8_tcpwm_1__TCPWM_INTR_CAUSE EQU CYREG_TCPWM_INTR_CAUSE
Timer_1_cy_m0s8_tcpwm_1__TCPWM_INTR_CAUSE_MASK EQU 0x04
Timer_1_cy_m0s8_tcpwm_1__TCPWM_INTR_CAUSE_SHIFT EQU 2
Timer_1_cy_m0s8_tcpwm_1__TCPWM_NUMBER EQU 2
Timer_1_cy_m0s8_tcpwm_1__TR_CTRL0 EQU CYREG_TCPWM_CNT2_TR_CTRL0
Timer_1_cy_m0s8_tcpwm_1__TR_CTRL1 EQU CYREG_TCPWM_CNT2_TR_CTRL1
Timer_1_cy_m0s8_tcpwm_1__TR_CTRL2 EQU CYREG_TCPWM_CNT2_TR_CTRL2

; Timer_2
Timer_2_cy_m0s8_tcpwm_1__CC EQU CYREG_TCPWM_CNT3_CC
Timer_2_cy_m0s8_tcpwm_1__CC_BUFF EQU CYREG_TCPWM_CNT3_CC_BUFF
Timer_2_cy_m0s8_tcpwm_1__COUNTER EQU CYREG_TCPWM_CNT3_COUNTER
Timer_2_cy_m0s8_tcpwm_1__CTRL EQU CYREG_TCPWM_CNT3_CTRL
Timer_2_cy_m0s8_tcpwm_1__INTR EQU CYREG_TCPWM_CNT3_INTR
Timer_2_cy_m0s8_tcpwm_1__INTR_MASK EQU CYREG_TCPWM_CNT3_INTR_MASK
Timer_2_cy_m0s8_tcpwm_1__INTR_MASKED EQU CYREG_TCPWM_CNT3_INTR_MASKED
Timer_2_cy_m0s8_tcpwm_1__INTR_SET EQU CYREG_TCPWM_CNT3_INTR_SET
Timer_2_cy_m0s8_tcpwm_1__PERIOD EQU CYREG_TCPWM_CNT3_PERIOD
Timer_2_cy_m0s8_tcpwm_1__PERIOD_BUFF EQU CYREG_TCPWM_CNT3_PERIOD_BUFF
Timer_2_cy_m0s8_tcpwm_1__STATUS EQU CYREG_TCPWM_CNT3_STATUS
Timer_2_cy_m0s8_tcpwm_1__TCPWM_CMD EQU CYREG_TCPWM_CMD
Timer_2_cy_m0s8_tcpwm_1__TCPWM_CMDCAPTURE_MASK EQU 0x08
Timer_2_cy_m0s8_tcpwm_1__TCPWM_CMDCAPTURE_SHIFT EQU 3
Timer_2_cy_m0s8_tcpwm_1__TCPWM_CMDRELOAD_MASK EQU 0x800
Timer_2_cy_m0s8_tcpwm_1__TCPWM_CMDRELOAD_SHIFT EQU 11
Timer_2_cy_m0s8_tcpwm_1__TCPWM_CMDSTART_MASK EQU 0x8000000
Timer_2_cy_m0s8_tcpwm_1__TCPWM_CMDSTART_SHIFT EQU 27
Timer_2_cy_m0s8_tcpwm_1__TCPWM_CMDSTOP_MASK EQU 0x80000
Timer_2_cy_m0s8_tcpwm_1__TCPWM_CMDSTOP_SHIFT EQU 19
Timer_2_cy_m0s8_tcpwm_1__TCPWM_CTRL EQU CYREG_TCPWM_CTRL
Timer_2_cy_m0s8_tcpwm_1__TCPWM_CTRL_MASK EQU 0x08
Timer_2_cy_m0s8_tcpwm_1__TCPWM_CTRL_SHIFT EQU 3
Timer_2_cy_m0s8_tcpwm_1__TCPWM_INTR_CAUSE EQU CYREG_TCPWM_INTR_CAUSE
Timer_2_cy_m0s8_tcpwm_1__TCPWM_INTR_CAUSE_MASK EQU 0x08
Timer_2_cy_m0s8_tcpwm_1__TCPWM_INTR_CAUSE_SHIFT EQU 3
Timer_2_cy_m0s8_tcpwm_1__TCPWM_NUMBER EQU 3
Timer_2_cy_m0s8_tcpwm_1__TR_CTRL0 EQU CYREG_TCPWM_CNT3_TR_CTRL0
Timer_2_cy_m0s8_tcpwm_1__TR_CTRL1 EQU CYREG_TCPWM_CNT3_TR_CTRL1
Timer_2_cy_m0s8_tcpwm_1__TR_CTRL2 EQU CYREG_TCPWM_CNT3_TR_CTRL2

; Clock_125
Clock_125__DIVIDER_MASK EQU 0x0000FFFF
Clock_125__ENABLE EQU CYREG_CLK_DIVIDER_A01
Clock_125__ENABLE_MASK EQU 0x80000000
Clock_125__MASK EQU 0x80000000
Clock_125__REGISTER EQU CYREG_CLK_DIVIDER_A01

; readTimer
readTimer_cy_m0s8_tcpwm_1__CC EQU CYREG_TCPWM_CNT0_CC
readTimer_cy_m0s8_tcpwm_1__CC_BUFF EQU CYREG_TCPWM_CNT0_CC_BUFF
readTimer_cy_m0s8_tcpwm_1__COUNTER EQU CYREG_TCPWM_CNT0_COUNTER
readTimer_cy_m0s8_tcpwm_1__CTRL EQU CYREG_TCPWM_CNT0_CTRL
readTimer_cy_m0s8_tcpwm_1__INTR EQU CYREG_TCPWM_CNT0_INTR
readTimer_cy_m0s8_tcpwm_1__INTR_MASK EQU CYREG_TCPWM_CNT0_INTR_MASK
readTimer_cy_m0s8_tcpwm_1__INTR_MASKED EQU CYREG_TCPWM_CNT0_INTR_MASKED
readTimer_cy_m0s8_tcpwm_1__INTR_SET EQU CYREG_TCPWM_CNT0_INTR_SET
readTimer_cy_m0s8_tcpwm_1__PERIOD EQU CYREG_TCPWM_CNT0_PERIOD
readTimer_cy_m0s8_tcpwm_1__PERIOD_BUFF EQU CYREG_TCPWM_CNT0_PERIOD_BUFF
readTimer_cy_m0s8_tcpwm_1__STATUS EQU CYREG_TCPWM_CNT0_STATUS
readTimer_cy_m0s8_tcpwm_1__TCPWM_CMD EQU CYREG_TCPWM_CMD
readTimer_cy_m0s8_tcpwm_1__TCPWM_CMDCAPTURE_MASK EQU 0x01
readTimer_cy_m0s8_tcpwm_1__TCPWM_CMDCAPTURE_SHIFT EQU 0
readTimer_cy_m0s8_tcpwm_1__TCPWM_CMDRELOAD_MASK EQU 0x100
readTimer_cy_m0s8_tcpwm_1__TCPWM_CMDRELOAD_SHIFT EQU 8
readTimer_cy_m0s8_tcpwm_1__TCPWM_CMDSTART_MASK EQU 0x1000000
readTimer_cy_m0s8_tcpwm_1__TCPWM_CMDSTART_SHIFT EQU 24
readTimer_cy_m0s8_tcpwm_1__TCPWM_CMDSTOP_MASK EQU 0x10000
readTimer_cy_m0s8_tcpwm_1__TCPWM_CMDSTOP_SHIFT EQU 16
readTimer_cy_m0s8_tcpwm_1__TCPWM_CTRL EQU CYREG_TCPWM_CTRL
readTimer_cy_m0s8_tcpwm_1__TCPWM_CTRL_MASK EQU 0x01
readTimer_cy_m0s8_tcpwm_1__TCPWM_CTRL_SHIFT EQU 0
readTimer_cy_m0s8_tcpwm_1__TCPWM_INTR_CAUSE EQU CYREG_TCPWM_INTR_CAUSE
readTimer_cy_m0s8_tcpwm_1__TCPWM_INTR_CAUSE_MASK EQU 0x01
readTimer_cy_m0s8_tcpwm_1__TCPWM_INTR_CAUSE_SHIFT EQU 0
readTimer_cy_m0s8_tcpwm_1__TCPWM_NUMBER EQU 0
readTimer_cy_m0s8_tcpwm_1__TR_CTRL0 EQU CYREG_TCPWM_CNT0_TR_CTRL0
readTimer_cy_m0s8_tcpwm_1__TR_CTRL1 EQU CYREG_TCPWM_CNT0_TR_CTRL1
readTimer_cy_m0s8_tcpwm_1__TR_CTRL2 EQU CYREG_TCPWM_CNT0_TR_CTRL2

; I2C_MPU6500
I2C_MPU6500_SCB__BIST_CONTROL EQU CYREG_SCB0_BIST_CONTROL
I2C_MPU6500_SCB__BIST_DATA EQU CYREG_SCB0_BIST_DATA
I2C_MPU6500_SCB__CTRL EQU CYREG_SCB0_CTRL
I2C_MPU6500_SCB__EZ_DATA00 EQU CYREG_SCB0_EZ_DATA00
I2C_MPU6500_SCB__EZ_DATA01 EQU CYREG_SCB0_EZ_DATA01
I2C_MPU6500_SCB__EZ_DATA02 EQU CYREG_SCB0_EZ_DATA02
I2C_MPU6500_SCB__EZ_DATA03 EQU CYREG_SCB0_EZ_DATA03
I2C_MPU6500_SCB__EZ_DATA04 EQU CYREG_SCB0_EZ_DATA04
I2C_MPU6500_SCB__EZ_DATA05 EQU CYREG_SCB0_EZ_DATA05
I2C_MPU6500_SCB__EZ_DATA06 EQU CYREG_SCB0_EZ_DATA06
I2C_MPU6500_SCB__EZ_DATA07 EQU CYREG_SCB0_EZ_DATA07
I2C_MPU6500_SCB__EZ_DATA08 EQU CYREG_SCB0_EZ_DATA08
I2C_MPU6500_SCB__EZ_DATA09 EQU CYREG_SCB0_EZ_DATA09
I2C_MPU6500_SCB__EZ_DATA10 EQU CYREG_SCB0_EZ_DATA10
I2C_MPU6500_SCB__EZ_DATA11 EQU CYREG_SCB0_EZ_DATA11
I2C_MPU6500_SCB__EZ_DATA12 EQU CYREG_SCB0_EZ_DATA12
I2C_MPU6500_SCB__EZ_DATA13 EQU CYREG_SCB0_EZ_DATA13
I2C_MPU6500_SCB__EZ_DATA14 EQU CYREG_SCB0_EZ_DATA14
I2C_MPU6500_SCB__EZ_DATA15 EQU CYREG_SCB0_EZ_DATA15
I2C_MPU6500_SCB__EZ_DATA16 EQU CYREG_SCB0_EZ_DATA16
I2C_MPU6500_SCB__EZ_DATA17 EQU CYREG_SCB0_EZ_DATA17
I2C_MPU6500_SCB__EZ_DATA18 EQU CYREG_SCB0_EZ_DATA18
I2C_MPU6500_SCB__EZ_DATA19 EQU CYREG_SCB0_EZ_DATA19
I2C_MPU6500_SCB__EZ_DATA20 EQU CYREG_SCB0_EZ_DATA20
I2C_MPU6500_SCB__EZ_DATA21 EQU CYREG_SCB0_EZ_DATA21
I2C_MPU6500_SCB__EZ_DATA22 EQU CYREG_SCB0_EZ_DATA22
I2C_MPU6500_SCB__EZ_DATA23 EQU CYREG_SCB0_EZ_DATA23
I2C_MPU6500_SCB__EZ_DATA24 EQU CYREG_SCB0_EZ_DATA24
I2C_MPU6500_SCB__EZ_DATA25 EQU CYREG_SCB0_EZ_DATA25
I2C_MPU6500_SCB__EZ_DATA26 EQU CYREG_SCB0_EZ_DATA26
I2C_MPU6500_SCB__EZ_DATA27 EQU CYREG_SCB0_EZ_DATA27
I2C_MPU6500_SCB__EZ_DATA28 EQU CYREG_SCB0_EZ_DATA28
I2C_MPU6500_SCB__EZ_DATA29 EQU CYREG_SCB0_EZ_DATA29
I2C_MPU6500_SCB__EZ_DATA30 EQU CYREG_SCB0_EZ_DATA30
I2C_MPU6500_SCB__EZ_DATA31 EQU CYREG_SCB0_EZ_DATA31
I2C_MPU6500_SCB__I2C_CFG EQU CYREG_SCB0_I2C_CFG
I2C_MPU6500_SCB__I2C_CTRL EQU CYREG_SCB0_I2C_CTRL
I2C_MPU6500_SCB__I2C_M_CMD EQU CYREG_SCB0_I2C_M_CMD
I2C_MPU6500_SCB__I2C_S_CMD EQU CYREG_SCB0_I2C_S_CMD
I2C_MPU6500_SCB__I2C_STATUS EQU CYREG_SCB0_I2C_STATUS
I2C_MPU6500_SCB__INTR_CAUSE EQU CYREG_SCB0_INTR_CAUSE
I2C_MPU6500_SCB__INTR_I2C_EC EQU CYREG_SCB0_INTR_I2C_EC
I2C_MPU6500_SCB__INTR_I2C_EC_MASK EQU CYREG_SCB0_INTR_I2C_EC_MASK
I2C_MPU6500_SCB__INTR_I2C_EC_MASKED EQU CYREG_SCB0_INTR_I2C_EC_MASKED
I2C_MPU6500_SCB__INTR_M EQU CYREG_SCB0_INTR_M
I2C_MPU6500_SCB__INTR_M_MASK EQU CYREG_SCB0_INTR_M_MASK
I2C_MPU6500_SCB__INTR_M_MASKED EQU CYREG_SCB0_INTR_M_MASKED
I2C_MPU6500_SCB__INTR_M_SET EQU CYREG_SCB0_INTR_M_SET
I2C_MPU6500_SCB__INTR_RX EQU CYREG_SCB0_INTR_RX
I2C_MPU6500_SCB__INTR_RX_MASK EQU CYREG_SCB0_INTR_RX_MASK
I2C_MPU6500_SCB__INTR_RX_MASKED EQU CYREG_SCB0_INTR_RX_MASKED
I2C_MPU6500_SCB__INTR_RX_SET EQU CYREG_SCB0_INTR_RX_SET
I2C_MPU6500_SCB__INTR_S EQU CYREG_SCB0_INTR_S
I2C_MPU6500_SCB__INTR_S_MASK EQU CYREG_SCB0_INTR_S_MASK
I2C_MPU6500_SCB__INTR_S_MASKED EQU CYREG_SCB0_INTR_S_MASKED
I2C_MPU6500_SCB__INTR_S_SET EQU CYREG_SCB0_INTR_S_SET
I2C_MPU6500_SCB__INTR_SPI_EC EQU CYREG_SCB0_INTR_SPI_EC
I2C_MPU6500_SCB__INTR_SPI_EC_MASK EQU CYREG_SCB0_INTR_SPI_EC_MASK
I2C_MPU6500_SCB__INTR_SPI_EC_MASKED EQU CYREG_SCB0_INTR_SPI_EC_MASKED
I2C_MPU6500_SCB__INTR_TX EQU CYREG_SCB0_INTR_TX
I2C_MPU6500_SCB__INTR_TX_MASK EQU CYREG_SCB0_INTR_TX_MASK
I2C_MPU6500_SCB__INTR_TX_MASKED EQU CYREG_SCB0_INTR_TX_MASKED
I2C_MPU6500_SCB__INTR_TX_SET EQU CYREG_SCB0_INTR_TX_SET
I2C_MPU6500_SCB__RX_CTRL EQU CYREG_SCB0_RX_CTRL
I2C_MPU6500_SCB__RX_FIFO_CTRL EQU CYREG_SCB0_RX_FIFO_CTRL
I2C_MPU6500_SCB__RX_FIFO_RD EQU CYREG_SCB0_RX_FIFO_RD
I2C_MPU6500_SCB__RX_FIFO_RD_SILENT EQU CYREG_SCB0_RX_FIFO_RD_SILENT
I2C_MPU6500_SCB__RX_FIFO_STATUS EQU CYREG_SCB0_RX_FIFO_STATUS
I2C_MPU6500_SCB__RX_MATCH EQU CYREG_SCB0_RX_MATCH
I2C_MPU6500_SCB__SPI_CTRL EQU CYREG_SCB0_SPI_CTRL
I2C_MPU6500_SCB__SPI_STATUS EQU CYREG_SCB0_SPI_STATUS
I2C_MPU6500_SCB__SS0_POSISTION EQU 0
I2C_MPU6500_SCB__SS1_POSISTION EQU 1
I2C_MPU6500_SCB__SS2_POSISTION EQU 2
I2C_MPU6500_SCB__SS3_POSISTION EQU 3
I2C_MPU6500_SCB__STATUS EQU CYREG_SCB0_STATUS
I2C_MPU6500_SCB__TX_CTRL EQU CYREG_SCB0_TX_CTRL
I2C_MPU6500_SCB__TX_FIFO_CTRL EQU CYREG_SCB0_TX_FIFO_CTRL
I2C_MPU6500_SCB__TX_FIFO_STATUS EQU CYREG_SCB0_TX_FIFO_STATUS
I2C_MPU6500_SCB__TX_FIFO_WR EQU CYREG_SCB0_TX_FIFO_WR
I2C_MPU6500_SCB__UART_CTRL EQU CYREG_SCB0_UART_CTRL
I2C_MPU6500_SCB__UART_RX_CTRL EQU CYREG_SCB0_UART_RX_CTRL
I2C_MPU6500_SCB__UART_RX_STATUS EQU CYREG_SCB0_UART_RX_STATUS
I2C_MPU6500_SCB__UART_TX_CTRL EQU CYREG_SCB0_UART_TX_CTRL
I2C_MPU6500_SCB_IRQ__INTC_CLR_EN_REG EQU CYREG_CM0_ICER
I2C_MPU6500_SCB_IRQ__INTC_CLR_PD_REG EQU CYREG_CM0_ICPR
I2C_MPU6500_SCB_IRQ__INTC_MASK EQU 0x400
I2C_MPU6500_SCB_IRQ__INTC_NUMBER EQU 10
I2C_MPU6500_SCB_IRQ__INTC_PRIOR_MASK EQU 0xC00000
I2C_MPU6500_SCB_IRQ__INTC_PRIOR_NUM EQU 3
I2C_MPU6500_SCB_IRQ__INTC_PRIOR_REG EQU CYREG_CM0_IPR2
I2C_MPU6500_SCB_IRQ__INTC_SET_EN_REG EQU CYREG_CM0_ISER
I2C_MPU6500_SCB_IRQ__INTC_SET_PD_REG EQU CYREG_CM0_ISPR
I2C_MPU6500_SCBCLK__DIVIDER_MASK EQU 0x0000FFFF
I2C_MPU6500_SCBCLK__ENABLE EQU CYREG_CLK_DIVIDER_B00
I2C_MPU6500_SCBCLK__ENABLE_MASK EQU 0x80000000
I2C_MPU6500_SCBCLK__MASK EQU 0x80000000
I2C_MPU6500_SCBCLK__REGISTER EQU CYREG_CLK_DIVIDER_B00
I2C_MPU6500_scl__0__DM__MASK EQU 0x07
I2C_MPU6500_scl__0__DM__SHIFT EQU 0
I2C_MPU6500_scl__0__DR EQU CYREG_PRT4_DR
I2C_MPU6500_scl__0__HSIOM EQU CYREG_HSIOM_PORT_SEL4
I2C_MPU6500_scl__0__HSIOM_GPIO EQU 0
I2C_MPU6500_scl__0__HSIOM_I2C EQU 14
I2C_MPU6500_scl__0__HSIOM_I2C_SCL EQU 14
I2C_MPU6500_scl__0__HSIOM_MASK EQU 0x0000000F
I2C_MPU6500_scl__0__HSIOM_SHIFT EQU 0
I2C_MPU6500_scl__0__HSIOM_SPI EQU 15
I2C_MPU6500_scl__0__HSIOM_SPI_MOSI EQU 15
I2C_MPU6500_scl__0__HSIOM_UART EQU 9
I2C_MPU6500_scl__0__HSIOM_UART_RX EQU 9
I2C_MPU6500_scl__0__INTCFG EQU CYREG_PRT4_INTCFG
I2C_MPU6500_scl__0__INTSTAT EQU CYREG_PRT4_INTSTAT
I2C_MPU6500_scl__0__MASK EQU 0x01
I2C_MPU6500_scl__0__PC EQU CYREG_PRT4_PC
I2C_MPU6500_scl__0__PC2 EQU CYREG_PRT4_PC2
I2C_MPU6500_scl__0__PORT EQU 4
I2C_MPU6500_scl__0__PS EQU CYREG_PRT4_PS
I2C_MPU6500_scl__0__SHIFT EQU 0
I2C_MPU6500_scl__DR EQU CYREG_PRT4_DR
I2C_MPU6500_scl__INTCFG EQU CYREG_PRT4_INTCFG
I2C_MPU6500_scl__INTSTAT EQU CYREG_PRT4_INTSTAT
I2C_MPU6500_scl__MASK EQU 0x01
I2C_MPU6500_scl__PC EQU CYREG_PRT4_PC
I2C_MPU6500_scl__PC2 EQU CYREG_PRT4_PC2
I2C_MPU6500_scl__PORT EQU 4
I2C_MPU6500_scl__PS EQU CYREG_PRT4_PS
I2C_MPU6500_scl__SHIFT EQU 0
I2C_MPU6500_sda__0__DM__MASK EQU 0x38
I2C_MPU6500_sda__0__DM__SHIFT EQU 3
I2C_MPU6500_sda__0__DR EQU CYREG_PRT4_DR
I2C_MPU6500_sda__0__HSIOM EQU CYREG_HSIOM_PORT_SEL4
I2C_MPU6500_sda__0__HSIOM_GPIO EQU 0
I2C_MPU6500_sda__0__HSIOM_I2C EQU 14
I2C_MPU6500_sda__0__HSIOM_I2C_SDA EQU 14
I2C_MPU6500_sda__0__HSIOM_MASK EQU 0x000000F0
I2C_MPU6500_sda__0__HSIOM_SHIFT EQU 4
I2C_MPU6500_sda__0__HSIOM_SPI EQU 15
I2C_MPU6500_sda__0__HSIOM_SPI_MISO EQU 15
I2C_MPU6500_sda__0__HSIOM_UART EQU 9
I2C_MPU6500_sda__0__HSIOM_UART_TX EQU 9
I2C_MPU6500_sda__0__INTCFG EQU CYREG_PRT4_INTCFG
I2C_MPU6500_sda__0__INTSTAT EQU CYREG_PRT4_INTSTAT
I2C_MPU6500_sda__0__MASK EQU 0x02
I2C_MPU6500_sda__0__PC EQU CYREG_PRT4_PC
I2C_MPU6500_sda__0__PC2 EQU CYREG_PRT4_PC2
I2C_MPU6500_sda__0__PORT EQU 4
I2C_MPU6500_sda__0__PS EQU CYREG_PRT4_PS
I2C_MPU6500_sda__0__SHIFT EQU 1
I2C_MPU6500_sda__DR EQU CYREG_PRT4_DR
I2C_MPU6500_sda__INTCFG EQU CYREG_PRT4_INTCFG
I2C_MPU6500_sda__INTSTAT EQU CYREG_PRT4_INTSTAT
I2C_MPU6500_sda__MASK EQU 0x02
I2C_MPU6500_sda__PC EQU CYREG_PRT4_PC
I2C_MPU6500_sda__PC2 EQU CYREG_PRT4_PC2
I2C_MPU6500_sda__PORT EQU 4
I2C_MPU6500_sda__PS EQU CYREG_PRT4_PS
I2C_MPU6500_sda__SHIFT EQU 1

; UART_CPANEL
UART_CPANEL_rx__0__DM__MASK EQU 0x7000
UART_CPANEL_rx__0__DM__SHIFT EQU 12
UART_CPANEL_rx__0__DR EQU CYREG_PRT0_DR
UART_CPANEL_rx__0__HSIOM EQU CYREG_HSIOM_PORT_SEL0
UART_CPANEL_rx__0__HSIOM_GPIO EQU 0
UART_CPANEL_rx__0__HSIOM_I2C EQU 14
UART_CPANEL_rx__0__HSIOM_I2C_SCL EQU 14
UART_CPANEL_rx__0__HSIOM_MASK EQU 0x000F0000
UART_CPANEL_rx__0__HSIOM_SHIFT EQU 16
UART_CPANEL_rx__0__HSIOM_SPI EQU 15
UART_CPANEL_rx__0__HSIOM_SPI_MOSI EQU 15
UART_CPANEL_rx__0__HSIOM_UART EQU 9
UART_CPANEL_rx__0__HSIOM_UART_RX EQU 9
UART_CPANEL_rx__0__INTCFG EQU CYREG_PRT0_INTCFG
UART_CPANEL_rx__0__INTSTAT EQU CYREG_PRT0_INTSTAT
UART_CPANEL_rx__0__MASK EQU 0x10
UART_CPANEL_rx__0__PA__CFG0 EQU CYREG_UDB_PA0_CFG0
UART_CPANEL_rx__0__PA__CFG1 EQU CYREG_UDB_PA0_CFG1
UART_CPANEL_rx__0__PA__CFG10 EQU CYREG_UDB_PA0_CFG10
UART_CPANEL_rx__0__PA__CFG11 EQU CYREG_UDB_PA0_CFG11
UART_CPANEL_rx__0__PA__CFG12 EQU CYREG_UDB_PA0_CFG12
UART_CPANEL_rx__0__PA__CFG13 EQU CYREG_UDB_PA0_CFG13
UART_CPANEL_rx__0__PA__CFG14 EQU CYREG_UDB_PA0_CFG14
UART_CPANEL_rx__0__PA__CFG2 EQU CYREG_UDB_PA0_CFG2
UART_CPANEL_rx__0__PA__CFG3 EQU CYREG_UDB_PA0_CFG3
UART_CPANEL_rx__0__PA__CFG4 EQU CYREG_UDB_PA0_CFG4
UART_CPANEL_rx__0__PA__CFG5 EQU CYREG_UDB_PA0_CFG5
UART_CPANEL_rx__0__PA__CFG6 EQU CYREG_UDB_PA0_CFG6
UART_CPANEL_rx__0__PA__CFG7 EQU CYREG_UDB_PA0_CFG7
UART_CPANEL_rx__0__PA__CFG8 EQU CYREG_UDB_PA0_CFG8
UART_CPANEL_rx__0__PA__CFG9 EQU CYREG_UDB_PA0_CFG9
UART_CPANEL_rx__0__PC EQU CYREG_PRT0_PC
UART_CPANEL_rx__0__PC2 EQU CYREG_PRT0_PC2
UART_CPANEL_rx__0__PORT EQU 0
UART_CPANEL_rx__0__PS EQU CYREG_PRT0_PS
UART_CPANEL_rx__0__SHIFT EQU 4
UART_CPANEL_rx__DR EQU CYREG_PRT0_DR
UART_CPANEL_rx__INTCFG EQU CYREG_PRT0_INTCFG
UART_CPANEL_rx__INTSTAT EQU CYREG_PRT0_INTSTAT
UART_CPANEL_rx__MASK EQU 0x10
UART_CPANEL_rx__PA__CFG0 EQU CYREG_UDB_PA0_CFG0
UART_CPANEL_rx__PA__CFG1 EQU CYREG_UDB_PA0_CFG1
UART_CPANEL_rx__PA__CFG10 EQU CYREG_UDB_PA0_CFG10
UART_CPANEL_rx__PA__CFG11 EQU CYREG_UDB_PA0_CFG11
UART_CPANEL_rx__PA__CFG12 EQU CYREG_UDB_PA0_CFG12
UART_CPANEL_rx__PA__CFG13 EQU CYREG_UDB_PA0_CFG13
UART_CPANEL_rx__PA__CFG14 EQU CYREG_UDB_PA0_CFG14
UART_CPANEL_rx__PA__CFG2 EQU CYREG_UDB_PA0_CFG2
UART_CPANEL_rx__PA__CFG3 EQU CYREG_UDB_PA0_CFG3
UART_CPANEL_rx__PA__CFG4 EQU CYREG_UDB_PA0_CFG4
UART_CPANEL_rx__PA__CFG5 EQU CYREG_UDB_PA0_CFG5
UART_CPANEL_rx__PA__CFG6 EQU CYREG_UDB_PA0_CFG6
UART_CPANEL_rx__PA__CFG7 EQU CYREG_UDB_PA0_CFG7
UART_CPANEL_rx__PA__CFG8 EQU CYREG_UDB_PA0_CFG8
UART_CPANEL_rx__PA__CFG9 EQU CYREG_UDB_PA0_CFG9
UART_CPANEL_rx__PC EQU CYREG_PRT0_PC
UART_CPANEL_rx__PC2 EQU CYREG_PRT0_PC2
UART_CPANEL_rx__PORT EQU 0
UART_CPANEL_rx__PS EQU CYREG_PRT0_PS
UART_CPANEL_rx__SHIFT EQU 4
UART_CPANEL_SCB__BIST_CONTROL EQU CYREG_SCB1_BIST_CONTROL
UART_CPANEL_SCB__BIST_DATA EQU CYREG_SCB1_BIST_DATA
UART_CPANEL_SCB__CTRL EQU CYREG_SCB1_CTRL
UART_CPANEL_SCB__EZ_DATA00 EQU CYREG_SCB1_EZ_DATA00
UART_CPANEL_SCB__EZ_DATA01 EQU CYREG_SCB1_EZ_DATA01
UART_CPANEL_SCB__EZ_DATA02 EQU CYREG_SCB1_EZ_DATA02
UART_CPANEL_SCB__EZ_DATA03 EQU CYREG_SCB1_EZ_DATA03
UART_CPANEL_SCB__EZ_DATA04 EQU CYREG_SCB1_EZ_DATA04
UART_CPANEL_SCB__EZ_DATA05 EQU CYREG_SCB1_EZ_DATA05
UART_CPANEL_SCB__EZ_DATA06 EQU CYREG_SCB1_EZ_DATA06
UART_CPANEL_SCB__EZ_DATA07 EQU CYREG_SCB1_EZ_DATA07
UART_CPANEL_SCB__EZ_DATA08 EQU CYREG_SCB1_EZ_DATA08
UART_CPANEL_SCB__EZ_DATA09 EQU CYREG_SCB1_EZ_DATA09
UART_CPANEL_SCB__EZ_DATA10 EQU CYREG_SCB1_EZ_DATA10
UART_CPANEL_SCB__EZ_DATA11 EQU CYREG_SCB1_EZ_DATA11
UART_CPANEL_SCB__EZ_DATA12 EQU CYREG_SCB1_EZ_DATA12
UART_CPANEL_SCB__EZ_DATA13 EQU CYREG_SCB1_EZ_DATA13
UART_CPANEL_SCB__EZ_DATA14 EQU CYREG_SCB1_EZ_DATA14
UART_CPANEL_SCB__EZ_DATA15 EQU CYREG_SCB1_EZ_DATA15
UART_CPANEL_SCB__EZ_DATA16 EQU CYREG_SCB1_EZ_DATA16
UART_CPANEL_SCB__EZ_DATA17 EQU CYREG_SCB1_EZ_DATA17
UART_CPANEL_SCB__EZ_DATA18 EQU CYREG_SCB1_EZ_DATA18
UART_CPANEL_SCB__EZ_DATA19 EQU CYREG_SCB1_EZ_DATA19
UART_CPANEL_SCB__EZ_DATA20 EQU CYREG_SCB1_EZ_DATA20
UART_CPANEL_SCB__EZ_DATA21 EQU CYREG_SCB1_EZ_DATA21
UART_CPANEL_SCB__EZ_DATA22 EQU CYREG_SCB1_EZ_DATA22
UART_CPANEL_SCB__EZ_DATA23 EQU CYREG_SCB1_EZ_DATA23
UART_CPANEL_SCB__EZ_DATA24 EQU CYREG_SCB1_EZ_DATA24
UART_CPANEL_SCB__EZ_DATA25 EQU CYREG_SCB1_EZ_DATA25
UART_CPANEL_SCB__EZ_DATA26 EQU CYREG_SCB1_EZ_DATA26
UART_CPANEL_SCB__EZ_DATA27 EQU CYREG_SCB1_EZ_DATA27
UART_CPANEL_SCB__EZ_DATA28 EQU CYREG_SCB1_EZ_DATA28
UART_CPANEL_SCB__EZ_DATA29 EQU CYREG_SCB1_EZ_DATA29
UART_CPANEL_SCB__EZ_DATA30 EQU CYREG_SCB1_EZ_DATA30
UART_CPANEL_SCB__EZ_DATA31 EQU CYREG_SCB1_EZ_DATA31
UART_CPANEL_SCB__I2C_CFG EQU CYREG_SCB1_I2C_CFG
UART_CPANEL_SCB__I2C_CTRL EQU CYREG_SCB1_I2C_CTRL
UART_CPANEL_SCB__I2C_M_CMD EQU CYREG_SCB1_I2C_M_CMD
UART_CPANEL_SCB__I2C_S_CMD EQU CYREG_SCB1_I2C_S_CMD
UART_CPANEL_SCB__I2C_STATUS EQU CYREG_SCB1_I2C_STATUS
UART_CPANEL_SCB__INTR_CAUSE EQU CYREG_SCB1_INTR_CAUSE
UART_CPANEL_SCB__INTR_I2C_EC EQU CYREG_SCB1_INTR_I2C_EC
UART_CPANEL_SCB__INTR_I2C_EC_MASK EQU CYREG_SCB1_INTR_I2C_EC_MASK
UART_CPANEL_SCB__INTR_I2C_EC_MASKED EQU CYREG_SCB1_INTR_I2C_EC_MASKED
UART_CPANEL_SCB__INTR_M EQU CYREG_SCB1_INTR_M
UART_CPANEL_SCB__INTR_M_MASK EQU CYREG_SCB1_INTR_M_MASK
UART_CPANEL_SCB__INTR_M_MASKED EQU CYREG_SCB1_INTR_M_MASKED
UART_CPANEL_SCB__INTR_M_SET EQU CYREG_SCB1_INTR_M_SET
UART_CPANEL_SCB__INTR_RX EQU CYREG_SCB1_INTR_RX
UART_CPANEL_SCB__INTR_RX_MASK EQU CYREG_SCB1_INTR_RX_MASK
UART_CPANEL_SCB__INTR_RX_MASKED EQU CYREG_SCB1_INTR_RX_MASKED
UART_CPANEL_SCB__INTR_RX_SET EQU CYREG_SCB1_INTR_RX_SET
UART_CPANEL_SCB__INTR_S EQU CYREG_SCB1_INTR_S
UART_CPANEL_SCB__INTR_S_MASK EQU CYREG_SCB1_INTR_S_MASK
UART_CPANEL_SCB__INTR_S_MASKED EQU CYREG_SCB1_INTR_S_MASKED
UART_CPANEL_SCB__INTR_S_SET EQU CYREG_SCB1_INTR_S_SET
UART_CPANEL_SCB__INTR_SPI_EC EQU CYREG_SCB1_INTR_SPI_EC
UART_CPANEL_SCB__INTR_SPI_EC_MASK EQU CYREG_SCB1_INTR_SPI_EC_MASK
UART_CPANEL_SCB__INTR_SPI_EC_MASKED EQU CYREG_SCB1_INTR_SPI_EC_MASKED
UART_CPANEL_SCB__INTR_TX EQU CYREG_SCB1_INTR_TX
UART_CPANEL_SCB__INTR_TX_MASK EQU CYREG_SCB1_INTR_TX_MASK
UART_CPANEL_SCB__INTR_TX_MASKED EQU CYREG_SCB1_INTR_TX_MASKED
UART_CPANEL_SCB__INTR_TX_SET EQU CYREG_SCB1_INTR_TX_SET
UART_CPANEL_SCB__RX_CTRL EQU CYREG_SCB1_RX_CTRL
UART_CPANEL_SCB__RX_FIFO_CTRL EQU CYREG_SCB1_RX_FIFO_CTRL
UART_CPANEL_SCB__RX_FIFO_RD EQU CYREG_SCB1_RX_FIFO_RD
UART_CPANEL_SCB__RX_FIFO_RD_SILENT EQU CYREG_SCB1_RX_FIFO_RD_SILENT
UART_CPANEL_SCB__RX_FIFO_STATUS EQU CYREG_SCB1_RX_FIFO_STATUS
UART_CPANEL_SCB__RX_MATCH EQU CYREG_SCB1_RX_MATCH
UART_CPANEL_SCB__SPI_CTRL EQU CYREG_SCB1_SPI_CTRL
UART_CPANEL_SCB__SPI_STATUS EQU CYREG_SCB1_SPI_STATUS
UART_CPANEL_SCB__SS0_POSISTION EQU 0
UART_CPANEL_SCB__SS1_POSISTION EQU 1
UART_CPANEL_SCB__SS2_POSISTION EQU 2
UART_CPANEL_SCB__SS3_POSISTION EQU 3
UART_CPANEL_SCB__STATUS EQU CYREG_SCB1_STATUS
UART_CPANEL_SCB__TX_CTRL EQU CYREG_SCB1_TX_CTRL
UART_CPANEL_SCB__TX_FIFO_CTRL EQU CYREG_SCB1_TX_FIFO_CTRL
UART_CPANEL_SCB__TX_FIFO_STATUS EQU CYREG_SCB1_TX_FIFO_STATUS
UART_CPANEL_SCB__TX_FIFO_WR EQU CYREG_SCB1_TX_FIFO_WR
UART_CPANEL_SCB__UART_CTRL EQU CYREG_SCB1_UART_CTRL
UART_CPANEL_SCB__UART_RX_CTRL EQU CYREG_SCB1_UART_RX_CTRL
UART_CPANEL_SCB__UART_RX_STATUS EQU CYREG_SCB1_UART_RX_STATUS
UART_CPANEL_SCB__UART_TX_CTRL EQU CYREG_SCB1_UART_TX_CTRL
UART_CPANEL_SCBCLK__DIVIDER_MASK EQU 0x0000FFFF
UART_CPANEL_SCBCLK__ENABLE EQU CYREG_CLK_DIVIDER_C00
UART_CPANEL_SCBCLK__ENABLE_MASK EQU 0x80000000
UART_CPANEL_SCBCLK__MASK EQU 0x80000000
UART_CPANEL_SCBCLK__REGISTER EQU CYREG_CLK_DIVIDER_C00
UART_CPANEL_tx__0__DM__MASK EQU 0x38000
UART_CPANEL_tx__0__DM__SHIFT EQU 15
UART_CPANEL_tx__0__DR EQU CYREG_PRT0_DR
UART_CPANEL_tx__0__HSIOM EQU CYREG_HSIOM_PORT_SEL0
UART_CPANEL_tx__0__HSIOM_GPIO EQU 0
UART_CPANEL_tx__0__HSIOM_I2C EQU 14
UART_CPANEL_tx__0__HSIOM_I2C_SDA EQU 14
UART_CPANEL_tx__0__HSIOM_MASK EQU 0x00F00000
UART_CPANEL_tx__0__HSIOM_SHIFT EQU 20
UART_CPANEL_tx__0__HSIOM_SPI EQU 15
UART_CPANEL_tx__0__HSIOM_SPI_MISO EQU 15
UART_CPANEL_tx__0__HSIOM_UART EQU 9
UART_CPANEL_tx__0__HSIOM_UART_TX EQU 9
UART_CPANEL_tx__0__INTCFG EQU CYREG_PRT0_INTCFG
UART_CPANEL_tx__0__INTSTAT EQU CYREG_PRT0_INTSTAT
UART_CPANEL_tx__0__MASK EQU 0x20
UART_CPANEL_tx__0__OUT_SEL EQU CYREG_UDB_PA0_CFG10
UART_CPANEL_tx__0__OUT_SEL_SHIFT EQU 10
UART_CPANEL_tx__0__OUT_SEL_VAL EQU -1
UART_CPANEL_tx__0__PA__CFG0 EQU CYREG_UDB_PA0_CFG0
UART_CPANEL_tx__0__PA__CFG1 EQU CYREG_UDB_PA0_CFG1
UART_CPANEL_tx__0__PA__CFG10 EQU CYREG_UDB_PA0_CFG10
UART_CPANEL_tx__0__PA__CFG11 EQU CYREG_UDB_PA0_CFG11
UART_CPANEL_tx__0__PA__CFG12 EQU CYREG_UDB_PA0_CFG12
UART_CPANEL_tx__0__PA__CFG13 EQU CYREG_UDB_PA0_CFG13
UART_CPANEL_tx__0__PA__CFG14 EQU CYREG_UDB_PA0_CFG14
UART_CPANEL_tx__0__PA__CFG2 EQU CYREG_UDB_PA0_CFG2
UART_CPANEL_tx__0__PA__CFG3 EQU CYREG_UDB_PA0_CFG3
UART_CPANEL_tx__0__PA__CFG4 EQU CYREG_UDB_PA0_CFG4
UART_CPANEL_tx__0__PA__CFG5 EQU CYREG_UDB_PA0_CFG5
UART_CPANEL_tx__0__PA__CFG6 EQU CYREG_UDB_PA0_CFG6
UART_CPANEL_tx__0__PA__CFG7 EQU CYREG_UDB_PA0_CFG7
UART_CPANEL_tx__0__PA__CFG8 EQU CYREG_UDB_PA0_CFG8
UART_CPANEL_tx__0__PA__CFG9 EQU CYREG_UDB_PA0_CFG9
UART_CPANEL_tx__0__PC EQU CYREG_PRT0_PC
UART_CPANEL_tx__0__PC2 EQU CYREG_PRT0_PC2
UART_CPANEL_tx__0__PORT EQU 0
UART_CPANEL_tx__0__PS EQU CYREG_PRT0_PS
UART_CPANEL_tx__0__SHIFT EQU 5
UART_CPANEL_tx__DR EQU CYREG_PRT0_DR
UART_CPANEL_tx__INTCFG EQU CYREG_PRT0_INTCFG
UART_CPANEL_tx__INTSTAT EQU CYREG_PRT0_INTSTAT
UART_CPANEL_tx__MASK EQU 0x20
UART_CPANEL_tx__PA__CFG0 EQU CYREG_UDB_PA0_CFG0
UART_CPANEL_tx__PA__CFG1 EQU CYREG_UDB_PA0_CFG1
UART_CPANEL_tx__PA__CFG10 EQU CYREG_UDB_PA0_CFG10
UART_CPANEL_tx__PA__CFG11 EQU CYREG_UDB_PA0_CFG11
UART_CPANEL_tx__PA__CFG12 EQU CYREG_UDB_PA0_CFG12
UART_CPANEL_tx__PA__CFG13 EQU CYREG_UDB_PA0_CFG13
UART_CPANEL_tx__PA__CFG14 EQU CYREG_UDB_PA0_CFG14
UART_CPANEL_tx__PA__CFG2 EQU CYREG_UDB_PA0_CFG2
UART_CPANEL_tx__PA__CFG3 EQU CYREG_UDB_PA0_CFG3
UART_CPANEL_tx__PA__CFG4 EQU CYREG_UDB_PA0_CFG4
UART_CPANEL_tx__PA__CFG5 EQU CYREG_UDB_PA0_CFG5
UART_CPANEL_tx__PA__CFG6 EQU CYREG_UDB_PA0_CFG6
UART_CPANEL_tx__PA__CFG7 EQU CYREG_UDB_PA0_CFG7
UART_CPANEL_tx__PA__CFG8 EQU CYREG_UDB_PA0_CFG8
UART_CPANEL_tx__PA__CFG9 EQU CYREG_UDB_PA0_CFG9
UART_CPANEL_tx__PC EQU CYREG_PRT0_PC
UART_CPANEL_tx__PC2 EQU CYREG_PRT0_PC2
UART_CPANEL_tx__PORT EQU 0
UART_CPANEL_tx__PS EQU CYREG_PRT0_PS
UART_CPANEL_tx__SHIFT EQU 5

; STEERING_OUT
STEERING_OUT__0__DM__MASK EQU 0xE00000
STEERING_OUT__0__DM__SHIFT EQU 21
STEERING_OUT__0__DR EQU CYREG_PRT2_DR
STEERING_OUT__0__HSIOM EQU CYREG_HSIOM_PORT_SEL2
STEERING_OUT__0__HSIOM_MASK EQU 0xF0000000
STEERING_OUT__0__HSIOM_SHIFT EQU 28
STEERING_OUT__0__INTCFG EQU CYREG_PRT2_INTCFG
STEERING_OUT__0__INTSTAT EQU CYREG_PRT2_INTSTAT
STEERING_OUT__0__MASK EQU 0x80
STEERING_OUT__0__OUT_SEL EQU CYREG_UDB_PA2_CFG10
STEERING_OUT__0__OUT_SEL_SHIFT EQU 14
STEERING_OUT__0__OUT_SEL_VAL EQU 2
STEERING_OUT__0__PA__CFG0 EQU CYREG_UDB_PA2_CFG0
STEERING_OUT__0__PA__CFG1 EQU CYREG_UDB_PA2_CFG1
STEERING_OUT__0__PA__CFG10 EQU CYREG_UDB_PA2_CFG10
STEERING_OUT__0__PA__CFG11 EQU CYREG_UDB_PA2_CFG11
STEERING_OUT__0__PA__CFG12 EQU CYREG_UDB_PA2_CFG12
STEERING_OUT__0__PA__CFG13 EQU CYREG_UDB_PA2_CFG13
STEERING_OUT__0__PA__CFG14 EQU CYREG_UDB_PA2_CFG14
STEERING_OUT__0__PA__CFG2 EQU CYREG_UDB_PA2_CFG2
STEERING_OUT__0__PA__CFG3 EQU CYREG_UDB_PA2_CFG3
STEERING_OUT__0__PA__CFG4 EQU CYREG_UDB_PA2_CFG4
STEERING_OUT__0__PA__CFG5 EQU CYREG_UDB_PA2_CFG5
STEERING_OUT__0__PA__CFG6 EQU CYREG_UDB_PA2_CFG6
STEERING_OUT__0__PA__CFG7 EQU CYREG_UDB_PA2_CFG7
STEERING_OUT__0__PA__CFG8 EQU CYREG_UDB_PA2_CFG8
STEERING_OUT__0__PA__CFG9 EQU CYREG_UDB_PA2_CFG9
STEERING_OUT__0__PC EQU CYREG_PRT2_PC
STEERING_OUT__0__PC2 EQU CYREG_PRT2_PC2
STEERING_OUT__0__PORT EQU 2
STEERING_OUT__0__PS EQU CYREG_PRT2_PS
STEERING_OUT__0__SHIFT EQU 7
STEERING_OUT__DR EQU CYREG_PRT2_DR
STEERING_OUT__INTCFG EQU CYREG_PRT2_INTCFG
STEERING_OUT__INTSTAT EQU CYREG_PRT2_INTSTAT
STEERING_OUT__MASK EQU 0x80
STEERING_OUT__PA__CFG0 EQU CYREG_UDB_PA2_CFG0
STEERING_OUT__PA__CFG1 EQU CYREG_UDB_PA2_CFG1
STEERING_OUT__PA__CFG10 EQU CYREG_UDB_PA2_CFG10
STEERING_OUT__PA__CFG11 EQU CYREG_UDB_PA2_CFG11
STEERING_OUT__PA__CFG12 EQU CYREG_UDB_PA2_CFG12
STEERING_OUT__PA__CFG13 EQU CYREG_UDB_PA2_CFG13
STEERING_OUT__PA__CFG14 EQU CYREG_UDB_PA2_CFG14
STEERING_OUT__PA__CFG2 EQU CYREG_UDB_PA2_CFG2
STEERING_OUT__PA__CFG3 EQU CYREG_UDB_PA2_CFG3
STEERING_OUT__PA__CFG4 EQU CYREG_UDB_PA2_CFG4
STEERING_OUT__PA__CFG5 EQU CYREG_UDB_PA2_CFG5
STEERING_OUT__PA__CFG6 EQU CYREG_UDB_PA2_CFG6
STEERING_OUT__PA__CFG7 EQU CYREG_UDB_PA2_CFG7
STEERING_OUT__PA__CFG8 EQU CYREG_UDB_PA2_CFG8
STEERING_OUT__PA__CFG9 EQU CYREG_UDB_PA2_CFG9
STEERING_OUT__PC EQU CYREG_PRT2_PC
STEERING_OUT__PC2 EQU CYREG_PRT2_PC2
STEERING_OUT__PORT EQU 2
STEERING_OUT__PS EQU CYREG_PRT2_PS
STEERING_OUT__SHIFT EQU 7

; Miscellaneous
CYDEV_BCLK__HFCLK__HZ EQU 24000000
CYDEV_BCLK__HFCLK__KHZ EQU 24000
CYDEV_BCLK__HFCLK__MHZ EQU 24
CYDEV_BCLK__SYSCLK__HZ EQU 24000000
CYDEV_BCLK__SYSCLK__KHZ EQU 24000
CYDEV_BCLK__SYSCLK__MHZ EQU 24
CYDEV_CHIP_DIE_LEOPARD EQU 1
CYDEV_CHIP_DIE_PSOC4A EQU 21
CYDEV_CHIP_DIE_PSOC5LP EQU 2
CYDEV_CHIP_DIE_PSOC5TM EQU 3
CYDEV_CHIP_DIE_TMA4 EQU 4
CYDEV_CHIP_DIE_UNKNOWN EQU 0
CYDEV_CHIP_FAMILY_FM0P EQU 5
CYDEV_CHIP_FAMILY_FM3 EQU 6
CYDEV_CHIP_FAMILY_FM4 EQU 7
CYDEV_CHIP_FAMILY_PSOC3 EQU 1
CYDEV_CHIP_FAMILY_PSOC4 EQU 2
CYDEV_CHIP_FAMILY_PSOC5 EQU 3
CYDEV_CHIP_FAMILY_PSOC6 EQU 4
CYDEV_CHIP_FAMILY_UNKNOWN EQU 0
CYDEV_CHIP_FAMILY_USED EQU CYDEV_CHIP_FAMILY_PSOC4
CYDEV_CHIP_JTAG_ID EQU 0x04C81193
CYDEV_CHIP_MEMBER_3A EQU 1
CYDEV_CHIP_MEMBER_4A EQU 21
CYDEV_CHIP_MEMBER_4D EQU 16
CYDEV_CHIP_MEMBER_4E EQU 6
CYDEV_CHIP_MEMBER_4F EQU 22
CYDEV_CHIP_MEMBER_4G EQU 4
CYDEV_CHIP_MEMBER_4H EQU 20
CYDEV_CHIP_MEMBER_4I EQU 26
CYDEV_CHIP_MEMBER_4J EQU 17
CYDEV_CHIP_MEMBER_4K EQU 18
CYDEV_CHIP_MEMBER_4L EQU 25
CYDEV_CHIP_MEMBER_4M EQU 24
CYDEV_CHIP_MEMBER_4N EQU 11
CYDEV_CHIP_MEMBER_4O EQU 8
CYDEV_CHIP_MEMBER_4P EQU 23
CYDEV_CHIP_MEMBER_4Q EQU 14
CYDEV_CHIP_MEMBER_4R EQU 9
CYDEV_CHIP_MEMBER_4S EQU 12
CYDEV_CHIP_MEMBER_4T EQU 10
CYDEV_CHIP_MEMBER_4U EQU 5
CYDEV_CHIP_MEMBER_4V EQU 19
CYDEV_CHIP_MEMBER_4W EQU 13
CYDEV_CHIP_MEMBER_4X EQU 7
CYDEV_CHIP_MEMBER_4Y EQU 15
CYDEV_CHIP_MEMBER_5A EQU 3
CYDEV_CHIP_MEMBER_5B EQU 2
CYDEV_CHIP_MEMBER_6A EQU 27
CYDEV_CHIP_MEMBER_FM3 EQU 31
CYDEV_CHIP_MEMBER_FM4 EQU 32
CYDEV_CHIP_MEMBER_PDL_FM0P_TYPE1 EQU 28
CYDEV_CHIP_MEMBER_PDL_FM0P_TYPE2 EQU 29
CYDEV_CHIP_MEMBER_PDL_FM0P_TYPE3 EQU 30
CYDEV_CHIP_MEMBER_UNKNOWN EQU 0
CYDEV_CHIP_MEMBER_USED EQU CYDEV_CHIP_MEMBER_4A
CYDEV_CHIP_DIE_EXPECT EQU CYDEV_CHIP_MEMBER_USED
CYDEV_CHIP_DIE_ACTUAL EQU CYDEV_CHIP_DIE_EXPECT
CYDEV_CHIP_REV_LEOPARD_ES1 EQU 0
CYDEV_CHIP_REV_LEOPARD_ES2 EQU 1
CYDEV_CHIP_REV_LEOPARD_ES3 EQU 3
CYDEV_CHIP_REV_LEOPARD_PRODUCTION EQU 3
CYDEV_CHIP_REV_PSOC4A_ES0 EQU 17
CYDEV_CHIP_REV_PSOC4A_PRODUCTION EQU 17
CYDEV_CHIP_REV_PSOC5LP_ES0 EQU 0
CYDEV_CHIP_REV_PSOC5LP_PRODUCTION EQU 0
CYDEV_CHIP_REV_PSOC5TM_ES0 EQU 0
CYDEV_CHIP_REV_PSOC5TM_ES1 EQU 1
CYDEV_CHIP_REV_PSOC5TM_PRODUCTION EQU 1
CYDEV_CHIP_REV_TMA4_ES EQU 17
CYDEV_CHIP_REV_TMA4_ES2 EQU 33
CYDEV_CHIP_REV_TMA4_PRODUCTION EQU 17
CYDEV_CHIP_REVISION_3A_ES1 EQU 0
CYDEV_CHIP_REVISION_3A_ES2 EQU 1
CYDEV_CHIP_REVISION_3A_ES3 EQU 3
CYDEV_CHIP_REVISION_3A_PRODUCTION EQU 3
CYDEV_CHIP_REVISION_4A_ES0 EQU 17
CYDEV_CHIP_REVISION_4A_PRODUCTION EQU 17
CYDEV_CHIP_REVISION_4D_PRODUCTION EQU 0
CYDEV_CHIP_REVISION_4E_CCG2_NO_USBPD EQU 0
CYDEV_CHIP_REVISION_4E_PRODUCTION EQU 0
CYDEV_CHIP_REVISION_4F_PRODUCTION EQU 0
CYDEV_CHIP_REVISION_4F_PRODUCTION_256DMA EQU 0
CYDEV_CHIP_REVISION_4F_PRODUCTION_256K EQU 0
CYDEV_CHIP_REVISION_4G_ES EQU 17
CYDEV_CHIP_REVISION_4G_ES2 EQU 33
CYDEV_CHIP_REVISION_4G_PRODUCTION EQU 17
CYDEV_CHIP_REVISION_4H_PRODUCTION EQU 0
CYDEV_CHIP_REVISION_4I_PRODUCTION EQU 0
CYDEV_CHIP_REVISION_4J_PRODUCTION EQU 0
CYDEV_CHIP_REVISION_4K_PRODUCTION EQU 0
CYDEV_CHIP_REVISION_4L_PRODUCTION EQU 0
CYDEV_CHIP_REVISION_4M_PRODUCTION EQU 0
CYDEV_CHIP_REVISION_4N_PRODUCTION EQU 0
CYDEV_CHIP_REVISION_4O_PRODUCTION EQU 0
CYDEV_CHIP_REVISION_4P_PRODUCTION EQU 0
CYDEV_CHIP_REVISION_4Q_PRODUCTION EQU 0
CYDEV_CHIP_REVISION_4R_PRODUCTION EQU 0
CYDEV_CHIP_REVISION_4S_PRODUCTION EQU 0
CYDEV_CHIP_REVISION_4T_PRODUCTION EQU 0
CYDEV_CHIP_REVISION_4U_PRODUCTION EQU 0
CYDEV_CHIP_REVISION_4V_PRODUCTION EQU 0
CYDEV_CHIP_REVISION_4W_PRODUCTION EQU 0
CYDEV_CHIP_REVISION_4X_PRODUCTION EQU 0
CYDEV_CHIP_REVISION_4Y_PRODUCTION EQU 0
CYDEV_CHIP_REVISION_5A_ES0 EQU 0
CYDEV_CHIP_REVISION_5A_ES1 EQU 1
CYDEV_CHIP_REVISION_5A_PRODUCTION EQU 1
CYDEV_CHIP_REVISION_5B_ES0 EQU 0
CYDEV_CHIP_REVISION_5B_PRODUCTION EQU 0
CYDEV_CHIP_REVISION_6A_ES EQU 17
CYDEV_CHIP_REVISION_6A_NO_UDB EQU 33
CYDEV_CHIP_REVISION_6A_PRODUCTION EQU 33
CYDEV_CHIP_REVISION_FM3_PRODUCTION EQU 0
CYDEV_CHIP_REVISION_FM4_PRODUCTION EQU 0
CYDEV_CHIP_REVISION_PDL_FM0P_TYPE1_PRODUCTION EQU 0
CYDEV_CHIP_REVISION_PDL_FM0P_TYPE2_PRODUCTION EQU 0
CYDEV_CHIP_REVISION_PDL_FM0P_TYPE3_PRODUCTION EQU 0
CYDEV_CHIP_REVISION_USED EQU CYDEV_CHIP_REVISION_4A_PRODUCTION
CYDEV_CHIP_REV_EXPECT EQU CYDEV_CHIP_REVISION_USED
CYDEV_CONFIG_READ_ACCELERATOR EQU 1
CYDEV_CONFIG_UNUSED_IO_AllowButWarn EQU 0
CYDEV_CONFIG_UNUSED_IO_AllowWithInfo EQU 1
CYDEV_CONFIG_UNUSED_IO_Disallowed EQU 2
CYDEV_CONFIG_UNUSED_IO EQU CYDEV_CONFIG_UNUSED_IO_Disallowed
CYDEV_CONFIGURATION_COMPRESSED EQU 1
CYDEV_CONFIGURATION_MODE_COMPRESSED EQU 0
CYDEV_CONFIGURATION_MODE EQU CYDEV_CONFIGURATION_MODE_COMPRESSED
CYDEV_CONFIGURATION_MODE_DMA EQU 2
CYDEV_CONFIGURATION_MODE_UNCOMPRESSED EQU 1
CYDEV_DEBUG_PROTECT_KILL EQU 4
CYDEV_DEBUG_PROTECT_OPEN EQU 1
CYDEV_DEBUG_PROTECT EQU CYDEV_DEBUG_PROTECT_OPEN
CYDEV_DEBUG_PROTECT_PROTECTED EQU 2
CYDEV_DEBUGGING_DPS_Disable EQU 3
CYDEV_DEBUGGING_DPS_SWD EQU 2
CYDEV_DEBUGGING_DPS EQU CYDEV_DEBUGGING_DPS_SWD
CYDEV_DEBUGGING_ENABLE EQU 1
CYDEV_DFT_SELECT_CLK0 EQU 1
CYDEV_DFT_SELECT_CLK1 EQU 2
CYDEV_HEAP_SIZE EQU 0x80
CYDEV_IMO_TRIMMED_BY_USB EQU 0
CYDEV_IMO_TRIMMED_BY_WCO EQU 0
CYDEV_IS_EXPORTING_CODE EQU 0
CYDEV_IS_IMPORTING_CODE EQU 0
CYDEV_PROJ_TYPE EQU 0
CYDEV_PROJ_TYPE_BOOTLOADER EQU 1
CYDEV_PROJ_TYPE_LAUNCHER EQU 5
CYDEV_PROJ_TYPE_LOADABLE EQU 2
CYDEV_PROJ_TYPE_LOADABLEANDBOOTLOADER EQU 4
CYDEV_PROJ_TYPE_MULTIAPPBOOTLOADER EQU 3
CYDEV_PROJ_TYPE_STANDARD EQU 0
CYDEV_STACK_SIZE EQU 0x0400
CYDEV_USE_BUNDLED_CMSIS EQU 1
CYDEV_VARIABLE_VDDA EQU 1
CYDEV_VDDA_MV EQU 3300
CYDEV_VDDD_MV EQU 3300
CYDEV_WDT_GENERATE_ISR EQU 1
CYIPBLOCK_M0S8_CTBM_VERSION EQU 0
CYIPBLOCK_m0s8cpuss_VERSION EQU 0
CYIPBLOCK_m0s8csd_VERSION EQU 0
CYIPBLOCK_m0s8gpio2_VERSION EQU 0
CYIPBLOCK_m0s8hsiom4a_VERSION EQU 0
CYIPBLOCK_m0s8lcd_VERSION EQU 0
CYIPBLOCK_m0s8lpcomp_VERSION EQU 0
CYIPBLOCK_m0s8pclk_VERSION EQU 0
CYIPBLOCK_m0s8sar_VERSION EQU 0
CYIPBLOCK_m0s8scb_VERSION EQU 0
CYIPBLOCK_m0s8srssv2_VERSION EQU 1
CYIPBLOCK_m0s8tcpwm_VERSION EQU 0
CYIPBLOCK_m0s8udbif_VERSION EQU 0
CYIPBLOCK_S8_GPIO_VERSION EQU 2
CYDEV_BOOTLOADER_ENABLE EQU 0
    ENDIF
    END
