/*******************************************************************************
* File Name: cyfittergnu.inc
* 
* PSoC Creator  4.1 Update 1
*
* Description:
* 
* This file is automatically generated by PSoC Creator.
*
********************************************************************************
* Copyright (c) 2007-2017 Cypress Semiconductor.  All rights reserved.
* You may use this file only in accordance with the license, terms, conditions, 
* disclaimers, and limitations in the end user license agreement accompanying 
* the software package with which this file was provided.
********************************************************************************/

.ifndef INCLUDED_CYFITTERGNU_INC
.set INCLUDED_CYFITTERGNU_INC, 1
.include "cydevicegnu_trm.inc"

/* LCD_Char_LCDPort */
.set LCD_Char_LCDPort__0__DM__MASK, 0x07
.set LCD_Char_LCDPort__0__DM__SHIFT, 0
.set LCD_Char_LCDPort__0__DR, CYREG_PRT2_DR
.set LCD_Char_LCDPort__0__HSIOM, CYREG_HSIOM_PORT_SEL2
.set LCD_Char_LCDPort__0__HSIOM_MASK, 0x0000000F
.set LCD_Char_LCDPort__0__HSIOM_SHIFT, 0
.set LCD_Char_LCDPort__0__INTCFG, CYREG_PRT2_INTCFG
.set LCD_Char_LCDPort__0__INTSTAT, CYREG_PRT2_INTSTAT
.set LCD_Char_LCDPort__0__MASK, 0x01
.set LCD_Char_LCDPort__0__PA__CFG0, CYREG_UDB_PA2_CFG0
.set LCD_Char_LCDPort__0__PA__CFG1, CYREG_UDB_PA2_CFG1
.set LCD_Char_LCDPort__0__PA__CFG10, CYREG_UDB_PA2_CFG10
.set LCD_Char_LCDPort__0__PA__CFG11, CYREG_UDB_PA2_CFG11
.set LCD_Char_LCDPort__0__PA__CFG12, CYREG_UDB_PA2_CFG12
.set LCD_Char_LCDPort__0__PA__CFG13, CYREG_UDB_PA2_CFG13
.set LCD_Char_LCDPort__0__PA__CFG14, CYREG_UDB_PA2_CFG14
.set LCD_Char_LCDPort__0__PA__CFG2, CYREG_UDB_PA2_CFG2
.set LCD_Char_LCDPort__0__PA__CFG3, CYREG_UDB_PA2_CFG3
.set LCD_Char_LCDPort__0__PA__CFG4, CYREG_UDB_PA2_CFG4
.set LCD_Char_LCDPort__0__PA__CFG5, CYREG_UDB_PA2_CFG5
.set LCD_Char_LCDPort__0__PA__CFG6, CYREG_UDB_PA2_CFG6
.set LCD_Char_LCDPort__0__PA__CFG7, CYREG_UDB_PA2_CFG7
.set LCD_Char_LCDPort__0__PA__CFG8, CYREG_UDB_PA2_CFG8
.set LCD_Char_LCDPort__0__PA__CFG9, CYREG_UDB_PA2_CFG9
.set LCD_Char_LCDPort__0__PC, CYREG_PRT2_PC
.set LCD_Char_LCDPort__0__PC2, CYREG_PRT2_PC2
.set LCD_Char_LCDPort__0__PORT, 2
.set LCD_Char_LCDPort__0__PS, CYREG_PRT2_PS
.set LCD_Char_LCDPort__0__SHIFT, 0
.set LCD_Char_LCDPort__1__DM__MASK, 0x38
.set LCD_Char_LCDPort__1__DM__SHIFT, 3
.set LCD_Char_LCDPort__1__DR, CYREG_PRT2_DR
.set LCD_Char_LCDPort__1__HSIOM, CYREG_HSIOM_PORT_SEL2
.set LCD_Char_LCDPort__1__HSIOM_MASK, 0x000000F0
.set LCD_Char_LCDPort__1__HSIOM_SHIFT, 4
.set LCD_Char_LCDPort__1__INTCFG, CYREG_PRT2_INTCFG
.set LCD_Char_LCDPort__1__INTSTAT, CYREG_PRT2_INTSTAT
.set LCD_Char_LCDPort__1__MASK, 0x02
.set LCD_Char_LCDPort__1__PA__CFG0, CYREG_UDB_PA2_CFG0
.set LCD_Char_LCDPort__1__PA__CFG1, CYREG_UDB_PA2_CFG1
.set LCD_Char_LCDPort__1__PA__CFG10, CYREG_UDB_PA2_CFG10
.set LCD_Char_LCDPort__1__PA__CFG11, CYREG_UDB_PA2_CFG11
.set LCD_Char_LCDPort__1__PA__CFG12, CYREG_UDB_PA2_CFG12
.set LCD_Char_LCDPort__1__PA__CFG13, CYREG_UDB_PA2_CFG13
.set LCD_Char_LCDPort__1__PA__CFG14, CYREG_UDB_PA2_CFG14
.set LCD_Char_LCDPort__1__PA__CFG2, CYREG_UDB_PA2_CFG2
.set LCD_Char_LCDPort__1__PA__CFG3, CYREG_UDB_PA2_CFG3
.set LCD_Char_LCDPort__1__PA__CFG4, CYREG_UDB_PA2_CFG4
.set LCD_Char_LCDPort__1__PA__CFG5, CYREG_UDB_PA2_CFG5
.set LCD_Char_LCDPort__1__PA__CFG6, CYREG_UDB_PA2_CFG6
.set LCD_Char_LCDPort__1__PA__CFG7, CYREG_UDB_PA2_CFG7
.set LCD_Char_LCDPort__1__PA__CFG8, CYREG_UDB_PA2_CFG8
.set LCD_Char_LCDPort__1__PA__CFG9, CYREG_UDB_PA2_CFG9
.set LCD_Char_LCDPort__1__PC, CYREG_PRT2_PC
.set LCD_Char_LCDPort__1__PC2, CYREG_PRT2_PC2
.set LCD_Char_LCDPort__1__PORT, 2
.set LCD_Char_LCDPort__1__PS, CYREG_PRT2_PS
.set LCD_Char_LCDPort__1__SHIFT, 1
.set LCD_Char_LCDPort__2__DM__MASK, 0x1C0
.set LCD_Char_LCDPort__2__DM__SHIFT, 6
.set LCD_Char_LCDPort__2__DR, CYREG_PRT2_DR
.set LCD_Char_LCDPort__2__HSIOM, CYREG_HSIOM_PORT_SEL2
.set LCD_Char_LCDPort__2__HSIOM_MASK, 0x00000F00
.set LCD_Char_LCDPort__2__HSIOM_SHIFT, 8
.set LCD_Char_LCDPort__2__INTCFG, CYREG_PRT2_INTCFG
.set LCD_Char_LCDPort__2__INTSTAT, CYREG_PRT2_INTSTAT
.set LCD_Char_LCDPort__2__MASK, 0x04
.set LCD_Char_LCDPort__2__PA__CFG0, CYREG_UDB_PA2_CFG0
.set LCD_Char_LCDPort__2__PA__CFG1, CYREG_UDB_PA2_CFG1
.set LCD_Char_LCDPort__2__PA__CFG10, CYREG_UDB_PA2_CFG10
.set LCD_Char_LCDPort__2__PA__CFG11, CYREG_UDB_PA2_CFG11
.set LCD_Char_LCDPort__2__PA__CFG12, CYREG_UDB_PA2_CFG12
.set LCD_Char_LCDPort__2__PA__CFG13, CYREG_UDB_PA2_CFG13
.set LCD_Char_LCDPort__2__PA__CFG14, CYREG_UDB_PA2_CFG14
.set LCD_Char_LCDPort__2__PA__CFG2, CYREG_UDB_PA2_CFG2
.set LCD_Char_LCDPort__2__PA__CFG3, CYREG_UDB_PA2_CFG3
.set LCD_Char_LCDPort__2__PA__CFG4, CYREG_UDB_PA2_CFG4
.set LCD_Char_LCDPort__2__PA__CFG5, CYREG_UDB_PA2_CFG5
.set LCD_Char_LCDPort__2__PA__CFG6, CYREG_UDB_PA2_CFG6
.set LCD_Char_LCDPort__2__PA__CFG7, CYREG_UDB_PA2_CFG7
.set LCD_Char_LCDPort__2__PA__CFG8, CYREG_UDB_PA2_CFG8
.set LCD_Char_LCDPort__2__PA__CFG9, CYREG_UDB_PA2_CFG9
.set LCD_Char_LCDPort__2__PC, CYREG_PRT2_PC
.set LCD_Char_LCDPort__2__PC2, CYREG_PRT2_PC2
.set LCD_Char_LCDPort__2__PORT, 2
.set LCD_Char_LCDPort__2__PS, CYREG_PRT2_PS
.set LCD_Char_LCDPort__2__SHIFT, 2
.set LCD_Char_LCDPort__3__DM__MASK, 0xE00
.set LCD_Char_LCDPort__3__DM__SHIFT, 9
.set LCD_Char_LCDPort__3__DR, CYREG_PRT2_DR
.set LCD_Char_LCDPort__3__HSIOM, CYREG_HSIOM_PORT_SEL2
.set LCD_Char_LCDPort__3__HSIOM_MASK, 0x0000F000
.set LCD_Char_LCDPort__3__HSIOM_SHIFT, 12
.set LCD_Char_LCDPort__3__INTCFG, CYREG_PRT2_INTCFG
.set LCD_Char_LCDPort__3__INTSTAT, CYREG_PRT2_INTSTAT
.set LCD_Char_LCDPort__3__MASK, 0x08
.set LCD_Char_LCDPort__3__PA__CFG0, CYREG_UDB_PA2_CFG0
.set LCD_Char_LCDPort__3__PA__CFG1, CYREG_UDB_PA2_CFG1
.set LCD_Char_LCDPort__3__PA__CFG10, CYREG_UDB_PA2_CFG10
.set LCD_Char_LCDPort__3__PA__CFG11, CYREG_UDB_PA2_CFG11
.set LCD_Char_LCDPort__3__PA__CFG12, CYREG_UDB_PA2_CFG12
.set LCD_Char_LCDPort__3__PA__CFG13, CYREG_UDB_PA2_CFG13
.set LCD_Char_LCDPort__3__PA__CFG14, CYREG_UDB_PA2_CFG14
.set LCD_Char_LCDPort__3__PA__CFG2, CYREG_UDB_PA2_CFG2
.set LCD_Char_LCDPort__3__PA__CFG3, CYREG_UDB_PA2_CFG3
.set LCD_Char_LCDPort__3__PA__CFG4, CYREG_UDB_PA2_CFG4
.set LCD_Char_LCDPort__3__PA__CFG5, CYREG_UDB_PA2_CFG5
.set LCD_Char_LCDPort__3__PA__CFG6, CYREG_UDB_PA2_CFG6
.set LCD_Char_LCDPort__3__PA__CFG7, CYREG_UDB_PA2_CFG7
.set LCD_Char_LCDPort__3__PA__CFG8, CYREG_UDB_PA2_CFG8
.set LCD_Char_LCDPort__3__PA__CFG9, CYREG_UDB_PA2_CFG9
.set LCD_Char_LCDPort__3__PC, CYREG_PRT2_PC
.set LCD_Char_LCDPort__3__PC2, CYREG_PRT2_PC2
.set LCD_Char_LCDPort__3__PORT, 2
.set LCD_Char_LCDPort__3__PS, CYREG_PRT2_PS
.set LCD_Char_LCDPort__3__SHIFT, 3
.set LCD_Char_LCDPort__4__DM__MASK, 0x7000
.set LCD_Char_LCDPort__4__DM__SHIFT, 12
.set LCD_Char_LCDPort__4__DR, CYREG_PRT2_DR
.set LCD_Char_LCDPort__4__HSIOM, CYREG_HSIOM_PORT_SEL2
.set LCD_Char_LCDPort__4__HSIOM_MASK, 0x000F0000
.set LCD_Char_LCDPort__4__HSIOM_SHIFT, 16
.set LCD_Char_LCDPort__4__INTCFG, CYREG_PRT2_INTCFG
.set LCD_Char_LCDPort__4__INTSTAT, CYREG_PRT2_INTSTAT
.set LCD_Char_LCDPort__4__MASK, 0x10
.set LCD_Char_LCDPort__4__PA__CFG0, CYREG_UDB_PA2_CFG0
.set LCD_Char_LCDPort__4__PA__CFG1, CYREG_UDB_PA2_CFG1
.set LCD_Char_LCDPort__4__PA__CFG10, CYREG_UDB_PA2_CFG10
.set LCD_Char_LCDPort__4__PA__CFG11, CYREG_UDB_PA2_CFG11
.set LCD_Char_LCDPort__4__PA__CFG12, CYREG_UDB_PA2_CFG12
.set LCD_Char_LCDPort__4__PA__CFG13, CYREG_UDB_PA2_CFG13
.set LCD_Char_LCDPort__4__PA__CFG14, CYREG_UDB_PA2_CFG14
.set LCD_Char_LCDPort__4__PA__CFG2, CYREG_UDB_PA2_CFG2
.set LCD_Char_LCDPort__4__PA__CFG3, CYREG_UDB_PA2_CFG3
.set LCD_Char_LCDPort__4__PA__CFG4, CYREG_UDB_PA2_CFG4
.set LCD_Char_LCDPort__4__PA__CFG5, CYREG_UDB_PA2_CFG5
.set LCD_Char_LCDPort__4__PA__CFG6, CYREG_UDB_PA2_CFG6
.set LCD_Char_LCDPort__4__PA__CFG7, CYREG_UDB_PA2_CFG7
.set LCD_Char_LCDPort__4__PA__CFG8, CYREG_UDB_PA2_CFG8
.set LCD_Char_LCDPort__4__PA__CFG9, CYREG_UDB_PA2_CFG9
.set LCD_Char_LCDPort__4__PC, CYREG_PRT2_PC
.set LCD_Char_LCDPort__4__PC2, CYREG_PRT2_PC2
.set LCD_Char_LCDPort__4__PORT, 2
.set LCD_Char_LCDPort__4__PS, CYREG_PRT2_PS
.set LCD_Char_LCDPort__4__SHIFT, 4
.set LCD_Char_LCDPort__5__DM__MASK, 0x38000
.set LCD_Char_LCDPort__5__DM__SHIFT, 15
.set LCD_Char_LCDPort__5__DR, CYREG_PRT2_DR
.set LCD_Char_LCDPort__5__HSIOM, CYREG_HSIOM_PORT_SEL2
.set LCD_Char_LCDPort__5__HSIOM_MASK, 0x00F00000
.set LCD_Char_LCDPort__5__HSIOM_SHIFT, 20
.set LCD_Char_LCDPort__5__INTCFG, CYREG_PRT2_INTCFG
.set LCD_Char_LCDPort__5__INTSTAT, CYREG_PRT2_INTSTAT
.set LCD_Char_LCDPort__5__MASK, 0x20
.set LCD_Char_LCDPort__5__PA__CFG0, CYREG_UDB_PA2_CFG0
.set LCD_Char_LCDPort__5__PA__CFG1, CYREG_UDB_PA2_CFG1
.set LCD_Char_LCDPort__5__PA__CFG10, CYREG_UDB_PA2_CFG10
.set LCD_Char_LCDPort__5__PA__CFG11, CYREG_UDB_PA2_CFG11
.set LCD_Char_LCDPort__5__PA__CFG12, CYREG_UDB_PA2_CFG12
.set LCD_Char_LCDPort__5__PA__CFG13, CYREG_UDB_PA2_CFG13
.set LCD_Char_LCDPort__5__PA__CFG14, CYREG_UDB_PA2_CFG14
.set LCD_Char_LCDPort__5__PA__CFG2, CYREG_UDB_PA2_CFG2
.set LCD_Char_LCDPort__5__PA__CFG3, CYREG_UDB_PA2_CFG3
.set LCD_Char_LCDPort__5__PA__CFG4, CYREG_UDB_PA2_CFG4
.set LCD_Char_LCDPort__5__PA__CFG5, CYREG_UDB_PA2_CFG5
.set LCD_Char_LCDPort__5__PA__CFG6, CYREG_UDB_PA2_CFG6
.set LCD_Char_LCDPort__5__PA__CFG7, CYREG_UDB_PA2_CFG7
.set LCD_Char_LCDPort__5__PA__CFG8, CYREG_UDB_PA2_CFG8
.set LCD_Char_LCDPort__5__PA__CFG9, CYREG_UDB_PA2_CFG9
.set LCD_Char_LCDPort__5__PC, CYREG_PRT2_PC
.set LCD_Char_LCDPort__5__PC2, CYREG_PRT2_PC2
.set LCD_Char_LCDPort__5__PORT, 2
.set LCD_Char_LCDPort__5__PS, CYREG_PRT2_PS
.set LCD_Char_LCDPort__5__SHIFT, 5
.set LCD_Char_LCDPort__6__DM__MASK, 0x1C0000
.set LCD_Char_LCDPort__6__DM__SHIFT, 18
.set LCD_Char_LCDPort__6__DR, CYREG_PRT2_DR
.set LCD_Char_LCDPort__6__HSIOM, CYREG_HSIOM_PORT_SEL2
.set LCD_Char_LCDPort__6__HSIOM_MASK, 0x0F000000
.set LCD_Char_LCDPort__6__HSIOM_SHIFT, 24
.set LCD_Char_LCDPort__6__INTCFG, CYREG_PRT2_INTCFG
.set LCD_Char_LCDPort__6__INTSTAT, CYREG_PRT2_INTSTAT
.set LCD_Char_LCDPort__6__MASK, 0x40
.set LCD_Char_LCDPort__6__PA__CFG0, CYREG_UDB_PA2_CFG0
.set LCD_Char_LCDPort__6__PA__CFG1, CYREG_UDB_PA2_CFG1
.set LCD_Char_LCDPort__6__PA__CFG10, CYREG_UDB_PA2_CFG10
.set LCD_Char_LCDPort__6__PA__CFG11, CYREG_UDB_PA2_CFG11
.set LCD_Char_LCDPort__6__PA__CFG12, CYREG_UDB_PA2_CFG12
.set LCD_Char_LCDPort__6__PA__CFG13, CYREG_UDB_PA2_CFG13
.set LCD_Char_LCDPort__6__PA__CFG14, CYREG_UDB_PA2_CFG14
.set LCD_Char_LCDPort__6__PA__CFG2, CYREG_UDB_PA2_CFG2
.set LCD_Char_LCDPort__6__PA__CFG3, CYREG_UDB_PA2_CFG3
.set LCD_Char_LCDPort__6__PA__CFG4, CYREG_UDB_PA2_CFG4
.set LCD_Char_LCDPort__6__PA__CFG5, CYREG_UDB_PA2_CFG5
.set LCD_Char_LCDPort__6__PA__CFG6, CYREG_UDB_PA2_CFG6
.set LCD_Char_LCDPort__6__PA__CFG7, CYREG_UDB_PA2_CFG7
.set LCD_Char_LCDPort__6__PA__CFG8, CYREG_UDB_PA2_CFG8
.set LCD_Char_LCDPort__6__PA__CFG9, CYREG_UDB_PA2_CFG9
.set LCD_Char_LCDPort__6__PC, CYREG_PRT2_PC
.set LCD_Char_LCDPort__6__PC2, CYREG_PRT2_PC2
.set LCD_Char_LCDPort__6__PORT, 2
.set LCD_Char_LCDPort__6__PS, CYREG_PRT2_PS
.set LCD_Char_LCDPort__6__SHIFT, 6
.set LCD_Char_LCDPort__DR, CYREG_PRT2_DR
.set LCD_Char_LCDPort__INTCFG, CYREG_PRT2_INTCFG
.set LCD_Char_LCDPort__INTSTAT, CYREG_PRT2_INTSTAT
.set LCD_Char_LCDPort__MASK, 0x7F
.set LCD_Char_LCDPort__PA__CFG0, CYREG_UDB_PA2_CFG0
.set LCD_Char_LCDPort__PA__CFG1, CYREG_UDB_PA2_CFG1
.set LCD_Char_LCDPort__PA__CFG10, CYREG_UDB_PA2_CFG10
.set LCD_Char_LCDPort__PA__CFG11, CYREG_UDB_PA2_CFG11
.set LCD_Char_LCDPort__PA__CFG12, CYREG_UDB_PA2_CFG12
.set LCD_Char_LCDPort__PA__CFG13, CYREG_UDB_PA2_CFG13
.set LCD_Char_LCDPort__PA__CFG14, CYREG_UDB_PA2_CFG14
.set LCD_Char_LCDPort__PA__CFG2, CYREG_UDB_PA2_CFG2
.set LCD_Char_LCDPort__PA__CFG3, CYREG_UDB_PA2_CFG3
.set LCD_Char_LCDPort__PA__CFG4, CYREG_UDB_PA2_CFG4
.set LCD_Char_LCDPort__PA__CFG5, CYREG_UDB_PA2_CFG5
.set LCD_Char_LCDPort__PA__CFG6, CYREG_UDB_PA2_CFG6
.set LCD_Char_LCDPort__PA__CFG7, CYREG_UDB_PA2_CFG7
.set LCD_Char_LCDPort__PA__CFG8, CYREG_UDB_PA2_CFG8
.set LCD_Char_LCDPort__PA__CFG9, CYREG_UDB_PA2_CFG9
.set LCD_Char_LCDPort__PC, CYREG_PRT2_PC
.set LCD_Char_LCDPort__PC2, CYREG_PRT2_PC2
.set LCD_Char_LCDPort__PORT, 2
.set LCD_Char_LCDPort__PS, CYREG_PRT2_PS
.set LCD_Char_LCDPort__SHIFT, 0

/* Pin_Switch */
.set Pin_Switch__0__DM__MASK, 0xE00000
.set Pin_Switch__0__DM__SHIFT, 21
.set Pin_Switch__0__DR, CYREG_PRT0_DR
.set Pin_Switch__0__HSIOM, CYREG_HSIOM_PORT_SEL0
.set Pin_Switch__0__HSIOM_MASK, 0xF0000000
.set Pin_Switch__0__HSIOM_SHIFT, 28
.set Pin_Switch__0__INTCFG, CYREG_PRT0_INTCFG
.set Pin_Switch__0__INTSTAT, CYREG_PRT0_INTSTAT
.set Pin_Switch__0__MASK, 0x80
.set Pin_Switch__0__PA__CFG0, CYREG_UDB_PA0_CFG0
.set Pin_Switch__0__PA__CFG1, CYREG_UDB_PA0_CFG1
.set Pin_Switch__0__PA__CFG10, CYREG_UDB_PA0_CFG10
.set Pin_Switch__0__PA__CFG11, CYREG_UDB_PA0_CFG11
.set Pin_Switch__0__PA__CFG12, CYREG_UDB_PA0_CFG12
.set Pin_Switch__0__PA__CFG13, CYREG_UDB_PA0_CFG13
.set Pin_Switch__0__PA__CFG14, CYREG_UDB_PA0_CFG14
.set Pin_Switch__0__PA__CFG2, CYREG_UDB_PA0_CFG2
.set Pin_Switch__0__PA__CFG3, CYREG_UDB_PA0_CFG3
.set Pin_Switch__0__PA__CFG4, CYREG_UDB_PA0_CFG4
.set Pin_Switch__0__PA__CFG5, CYREG_UDB_PA0_CFG5
.set Pin_Switch__0__PA__CFG6, CYREG_UDB_PA0_CFG6
.set Pin_Switch__0__PA__CFG7, CYREG_UDB_PA0_CFG7
.set Pin_Switch__0__PA__CFG8, CYREG_UDB_PA0_CFG8
.set Pin_Switch__0__PA__CFG9, CYREG_UDB_PA0_CFG9
.set Pin_Switch__0__PC, CYREG_PRT0_PC
.set Pin_Switch__0__PC2, CYREG_PRT0_PC2
.set Pin_Switch__0__PORT, 0
.set Pin_Switch__0__PS, CYREG_PRT0_PS
.set Pin_Switch__0__SHIFT, 7
.set Pin_Switch__DR, CYREG_PRT0_DR
.set Pin_Switch__INTCFG, CYREG_PRT0_INTCFG
.set Pin_Switch__INTSTAT, CYREG_PRT0_INTSTAT
.set Pin_Switch__MASK, 0x80
.set Pin_Switch__PA__CFG0, CYREG_UDB_PA0_CFG0
.set Pin_Switch__PA__CFG1, CYREG_UDB_PA0_CFG1
.set Pin_Switch__PA__CFG10, CYREG_UDB_PA0_CFG10
.set Pin_Switch__PA__CFG11, CYREG_UDB_PA0_CFG11
.set Pin_Switch__PA__CFG12, CYREG_UDB_PA0_CFG12
.set Pin_Switch__PA__CFG13, CYREG_UDB_PA0_CFG13
.set Pin_Switch__PA__CFG14, CYREG_UDB_PA0_CFG14
.set Pin_Switch__PA__CFG2, CYREG_UDB_PA0_CFG2
.set Pin_Switch__PA__CFG3, CYREG_UDB_PA0_CFG3
.set Pin_Switch__PA__CFG4, CYREG_UDB_PA0_CFG4
.set Pin_Switch__PA__CFG5, CYREG_UDB_PA0_CFG5
.set Pin_Switch__PA__CFG6, CYREG_UDB_PA0_CFG6
.set Pin_Switch__PA__CFG7, CYREG_UDB_PA0_CFG7
.set Pin_Switch__PA__CFG8, CYREG_UDB_PA0_CFG8
.set Pin_Switch__PA__CFG9, CYREG_UDB_PA0_CFG9
.set Pin_Switch__PC, CYREG_PRT0_PC
.set Pin_Switch__PC2, CYREG_PRT0_PC2
.set Pin_Switch__PORT, 0
.set Pin_Switch__PS, CYREG_PRT0_PS
.set Pin_Switch__SHIFT, 7

/* Rx */
.set Rx__0__DM__MASK, 0x07
.set Rx__0__DM__SHIFT, 0
.set Rx__0__DR, CYREG_PRT0_DR
.set Rx__0__HSIOM, CYREG_HSIOM_PORT_SEL0
.set Rx__0__HSIOM_MASK, 0x0000000F
.set Rx__0__HSIOM_SHIFT, 0
.set Rx__0__INTCFG, CYREG_PRT0_INTCFG
.set Rx__0__INTSTAT, CYREG_PRT0_INTSTAT
.set Rx__0__MASK, 0x01
.set Rx__0__PA__CFG0, CYREG_UDB_PA0_CFG0
.set Rx__0__PA__CFG1, CYREG_UDB_PA0_CFG1
.set Rx__0__PA__CFG10, CYREG_UDB_PA0_CFG10
.set Rx__0__PA__CFG11, CYREG_UDB_PA0_CFG11
.set Rx__0__PA__CFG12, CYREG_UDB_PA0_CFG12
.set Rx__0__PA__CFG13, CYREG_UDB_PA0_CFG13
.set Rx__0__PA__CFG14, CYREG_UDB_PA0_CFG14
.set Rx__0__PA__CFG2, CYREG_UDB_PA0_CFG2
.set Rx__0__PA__CFG3, CYREG_UDB_PA0_CFG3
.set Rx__0__PA__CFG4, CYREG_UDB_PA0_CFG4
.set Rx__0__PA__CFG5, CYREG_UDB_PA0_CFG5
.set Rx__0__PA__CFG6, CYREG_UDB_PA0_CFG6
.set Rx__0__PA__CFG7, CYREG_UDB_PA0_CFG7
.set Rx__0__PA__CFG8, CYREG_UDB_PA0_CFG8
.set Rx__0__PA__CFG9, CYREG_UDB_PA0_CFG9
.set Rx__0__PC, CYREG_PRT0_PC
.set Rx__0__PC2, CYREG_PRT0_PC2
.set Rx__0__PORT, 0
.set Rx__0__PS, CYREG_PRT0_PS
.set Rx__0__SHIFT, 0
.set Rx__DR, CYREG_PRT0_DR
.set Rx__INTCFG, CYREG_PRT0_INTCFG
.set Rx__INTSTAT, CYREG_PRT0_INTSTAT
.set Rx__MASK, 0x01
.set Rx__PA__CFG0, CYREG_UDB_PA0_CFG0
.set Rx__PA__CFG1, CYREG_UDB_PA0_CFG1
.set Rx__PA__CFG10, CYREG_UDB_PA0_CFG10
.set Rx__PA__CFG11, CYREG_UDB_PA0_CFG11
.set Rx__PA__CFG12, CYREG_UDB_PA0_CFG12
.set Rx__PA__CFG13, CYREG_UDB_PA0_CFG13
.set Rx__PA__CFG14, CYREG_UDB_PA0_CFG14
.set Rx__PA__CFG2, CYREG_UDB_PA0_CFG2
.set Rx__PA__CFG3, CYREG_UDB_PA0_CFG3
.set Rx__PA__CFG4, CYREG_UDB_PA0_CFG4
.set Rx__PA__CFG5, CYREG_UDB_PA0_CFG5
.set Rx__PA__CFG6, CYREG_UDB_PA0_CFG6
.set Rx__PA__CFG7, CYREG_UDB_PA0_CFG7
.set Rx__PA__CFG8, CYREG_UDB_PA0_CFG8
.set Rx__PA__CFG9, CYREG_UDB_PA0_CFG9
.set Rx__PC, CYREG_PRT0_PC
.set Rx__PC2, CYREG_PRT0_PC2
.set Rx__PORT, 0
.set Rx__PS, CYREG_PRT0_PS
.set Rx__SHIFT, 0

/* Tx */
.set Tx__0__DM__MASK, 0x38
.set Tx__0__DM__SHIFT, 3
.set Tx__0__DR, CYREG_PRT0_DR
.set Tx__0__HSIOM, CYREG_HSIOM_PORT_SEL0
.set Tx__0__HSIOM_MASK, 0x000000F0
.set Tx__0__HSIOM_SHIFT, 4
.set Tx__0__INTCFG, CYREG_PRT0_INTCFG
.set Tx__0__INTSTAT, CYREG_PRT0_INTSTAT
.set Tx__0__MASK, 0x02
.set Tx__0__OUT_SEL, CYREG_UDB_PA0_CFG10
.set Tx__0__OUT_SEL_SHIFT, 2
.set Tx__0__OUT_SEL_VAL, 3
.set Tx__0__PA__CFG0, CYREG_UDB_PA0_CFG0
.set Tx__0__PA__CFG1, CYREG_UDB_PA0_CFG1
.set Tx__0__PA__CFG10, CYREG_UDB_PA0_CFG10
.set Tx__0__PA__CFG11, CYREG_UDB_PA0_CFG11
.set Tx__0__PA__CFG12, CYREG_UDB_PA0_CFG12
.set Tx__0__PA__CFG13, CYREG_UDB_PA0_CFG13
.set Tx__0__PA__CFG14, CYREG_UDB_PA0_CFG14
.set Tx__0__PA__CFG2, CYREG_UDB_PA0_CFG2
.set Tx__0__PA__CFG3, CYREG_UDB_PA0_CFG3
.set Tx__0__PA__CFG4, CYREG_UDB_PA0_CFG4
.set Tx__0__PA__CFG5, CYREG_UDB_PA0_CFG5
.set Tx__0__PA__CFG6, CYREG_UDB_PA0_CFG6
.set Tx__0__PA__CFG7, CYREG_UDB_PA0_CFG7
.set Tx__0__PA__CFG8, CYREG_UDB_PA0_CFG8
.set Tx__0__PA__CFG9, CYREG_UDB_PA0_CFG9
.set Tx__0__PC, CYREG_PRT0_PC
.set Tx__0__PC2, CYREG_PRT0_PC2
.set Tx__0__PORT, 0
.set Tx__0__PS, CYREG_PRT0_PS
.set Tx__0__SHIFT, 1
.set Tx__DR, CYREG_PRT0_DR
.set Tx__INTCFG, CYREG_PRT0_INTCFG
.set Tx__INTSTAT, CYREG_PRT0_INTSTAT
.set Tx__MASK, 0x02
.set Tx__PA__CFG0, CYREG_UDB_PA0_CFG0
.set Tx__PA__CFG1, CYREG_UDB_PA0_CFG1
.set Tx__PA__CFG10, CYREG_UDB_PA0_CFG10
.set Tx__PA__CFG11, CYREG_UDB_PA0_CFG11
.set Tx__PA__CFG12, CYREG_UDB_PA0_CFG12
.set Tx__PA__CFG13, CYREG_UDB_PA0_CFG13
.set Tx__PA__CFG14, CYREG_UDB_PA0_CFG14
.set Tx__PA__CFG2, CYREG_UDB_PA0_CFG2
.set Tx__PA__CFG3, CYREG_UDB_PA0_CFG3
.set Tx__PA__CFG4, CYREG_UDB_PA0_CFG4
.set Tx__PA__CFG5, CYREG_UDB_PA0_CFG5
.set Tx__PA__CFG6, CYREG_UDB_PA0_CFG6
.set Tx__PA__CFG7, CYREG_UDB_PA0_CFG7
.set Tx__PA__CFG8, CYREG_UDB_PA0_CFG8
.set Tx__PA__CFG9, CYREG_UDB_PA0_CFG9
.set Tx__PC, CYREG_PRT0_PC
.set Tx__PC2, CYREG_PRT0_PC2
.set Tx__PORT, 0
.set Tx__PS, CYREG_PRT0_PS
.set Tx__SHIFT, 1

/* UART_BUART */
.set UART_BUART_sRX_RxBitCounter__16BIT_CONTROL_AUX_CTL_REG, CYREG_UDB_W16_ACTL_00
.set UART_BUART_sRX_RxBitCounter__16BIT_CONTROL_CONTROL_REG, CYREG_UDB_W16_CTL_00
.set UART_BUART_sRX_RxBitCounter__16BIT_CONTROL_COUNT_REG, CYREG_UDB_W16_CTL_00
.set UART_BUART_sRX_RxBitCounter__16BIT_COUNT_CONTROL_REG, CYREG_UDB_W16_CTL_00
.set UART_BUART_sRX_RxBitCounter__16BIT_COUNT_COUNT_REG, CYREG_UDB_W16_CTL_00
.set UART_BUART_sRX_RxBitCounter__16BIT_MASK_MASK_REG, CYREG_UDB_W16_MSK_00
.set UART_BUART_sRX_RxBitCounter__16BIT_MASK_PERIOD_REG, CYREG_UDB_W16_MSK_00
.set UART_BUART_sRX_RxBitCounter__16BIT_PERIOD_MASK_REG, CYREG_UDB_W16_MSK_00
.set UART_BUART_sRX_RxBitCounter__16BIT_PERIOD_PERIOD_REG, CYREG_UDB_W16_MSK_00
.set UART_BUART_sRX_RxBitCounter__32BIT_CONTROL_AUX_CTL_REG, CYREG_UDB_W32_ACTL_00
.set UART_BUART_sRX_RxBitCounter__32BIT_CONTROL_REG, CYREG_UDB_W32_CTL_00
.set UART_BUART_sRX_RxBitCounter__32BIT_COUNT_REG, CYREG_UDB_W32_CTL_00
.set UART_BUART_sRX_RxBitCounter__32BIT_PERIOD_REG, CYREG_UDB_W32_MSK_00
.set UART_BUART_sRX_RxBitCounter__CONTROL_AUX_CTL_REG, CYREG_UDB_W8_ACTL_00
.set UART_BUART_sRX_RxBitCounter__CONTROL_REG, CYREG_UDB_W8_CTL_00
.set UART_BUART_sRX_RxBitCounter__CONTROL_ST_REG, CYREG_UDB_CAT16_CTL_ST_00
.set UART_BUART_sRX_RxBitCounter__COUNT_REG, CYREG_UDB_W8_CTL_00
.set UART_BUART_sRX_RxBitCounter__COUNT_ST_REG, CYREG_UDB_CAT16_CTL_ST_00
.set UART_BUART_sRX_RxBitCounter__MASK_CTL_AUX_CTL_REG, CYREG_UDB_CAT16_ACTL_MSK_00
.set UART_BUART_sRX_RxBitCounter__PER_CTL_AUX_CTL_REG, CYREG_UDB_CAT16_ACTL_MSK_00
.set UART_BUART_sRX_RxBitCounter__PERIOD_REG, CYREG_UDB_W8_MSK_00
.set UART_BUART_sRX_RxBitCounter_ST__16BIT_STATUS_AUX_CTL_REG, CYREG_UDB_W16_ACTL_00
.set UART_BUART_sRX_RxBitCounter_ST__16BIT_STATUS_REG, CYREG_UDB_W16_ST_00
.set UART_BUART_sRX_RxBitCounter_ST__32BIT_MASK_REG, CYREG_UDB_W32_MSK_00
.set UART_BUART_sRX_RxBitCounter_ST__32BIT_STATUS_AUX_CTL_REG, CYREG_UDB_W32_ACTL_00
.set UART_BUART_sRX_RxBitCounter_ST__32BIT_STATUS_REG, CYREG_UDB_W32_ST_00
.set UART_BUART_sRX_RxBitCounter_ST__MASK_REG, CYREG_UDB_W8_MSK_00
.set UART_BUART_sRX_RxBitCounter_ST__MASK_ST_AUX_CTL_REG, CYREG_UDB_CAT16_ACTL_MSK_00
.set UART_BUART_sRX_RxBitCounter_ST__PER_ST_AUX_CTL_REG, CYREG_UDB_CAT16_ACTL_MSK_00
.set UART_BUART_sRX_RxBitCounter_ST__STATUS_AUX_CTL_REG, CYREG_UDB_W8_ACTL_00
.set UART_BUART_sRX_RxBitCounter_ST__STATUS_CNT_REG, CYREG_UDB_CAT16_CTL_ST_00
.set UART_BUART_sRX_RxBitCounter_ST__STATUS_CONTROL_REG, CYREG_UDB_CAT16_CTL_ST_00
.set UART_BUART_sRX_RxBitCounter_ST__STATUS_REG, CYREG_UDB_W8_ST_00
.set UART_BUART_sRX_RxShifter_u0__16BIT_A0_REG, CYREG_UDB_W16_A0_00
.set UART_BUART_sRX_RxShifter_u0__16BIT_A1_REG, CYREG_UDB_W16_A1_00
.set UART_BUART_sRX_RxShifter_u0__16BIT_D0_REG, CYREG_UDB_W16_D0_00
.set UART_BUART_sRX_RxShifter_u0__16BIT_D1_REG, CYREG_UDB_W16_D1_00
.set UART_BUART_sRX_RxShifter_u0__16BIT_DP_AUX_CTL_REG, CYREG_UDB_W16_ACTL_00
.set UART_BUART_sRX_RxShifter_u0__16BIT_F0_REG, CYREG_UDB_W16_F0_00
.set UART_BUART_sRX_RxShifter_u0__16BIT_F1_REG, CYREG_UDB_W16_F1_00
.set UART_BUART_sRX_RxShifter_u0__32BIT_A0_REG, CYREG_UDB_W32_A0_00
.set UART_BUART_sRX_RxShifter_u0__32BIT_A1_REG, CYREG_UDB_W32_A1_00
.set UART_BUART_sRX_RxShifter_u0__32BIT_D0_REG, CYREG_UDB_W32_D0_00
.set UART_BUART_sRX_RxShifter_u0__32BIT_D1_REG, CYREG_UDB_W32_D1_00
.set UART_BUART_sRX_RxShifter_u0__32BIT_DP_AUX_CTL_REG, CYREG_UDB_W32_ACTL_00
.set UART_BUART_sRX_RxShifter_u0__32BIT_F0_REG, CYREG_UDB_W32_F0_00
.set UART_BUART_sRX_RxShifter_u0__32BIT_F1_REG, CYREG_UDB_W32_F1_00
.set UART_BUART_sRX_RxShifter_u0__A0_A1_REG, CYREG_UDB_CAT16_A_00
.set UART_BUART_sRX_RxShifter_u0__A0_REG, CYREG_UDB_W8_A0_00
.set UART_BUART_sRX_RxShifter_u0__A1_REG, CYREG_UDB_W8_A1_00
.set UART_BUART_sRX_RxShifter_u0__D0_D1_REG, CYREG_UDB_CAT16_D_00
.set UART_BUART_sRX_RxShifter_u0__D0_REG, CYREG_UDB_W8_D0_00
.set UART_BUART_sRX_RxShifter_u0__D1_REG, CYREG_UDB_W8_D1_00
.set UART_BUART_sRX_RxShifter_u0__DP_AUX_CTL_REG, CYREG_UDB_W8_ACTL_00
.set UART_BUART_sRX_RxShifter_u0__F0_F1_REG, CYREG_UDB_CAT16_F_00
.set UART_BUART_sRX_RxShifter_u0__F0_REG, CYREG_UDB_W8_F0_00
.set UART_BUART_sRX_RxShifter_u0__F1_REG, CYREG_UDB_W8_F1_00
.set UART_BUART_sRX_RxShifter_u0__MSK_DP_AUX_CTL_REG, CYREG_UDB_CAT16_ACTL_MSK_00
.set UART_BUART_sRX_RxShifter_u0__PER_DP_AUX_CTL_REG, CYREG_UDB_CAT16_ACTL_MSK_00
.set UART_BUART_sRX_RxSts__16BIT_STATUS_AUX_CTL_REG, CYREG_UDB_W16_ACTL_01
.set UART_BUART_sRX_RxSts__16BIT_STATUS_REG, CYREG_UDB_W16_ST_01
.set UART_BUART_sRX_RxSts__3__MASK, 0x08
.set UART_BUART_sRX_RxSts__3__POS, 3
.set UART_BUART_sRX_RxSts__4__MASK, 0x10
.set UART_BUART_sRX_RxSts__4__POS, 4
.set UART_BUART_sRX_RxSts__5__MASK, 0x20
.set UART_BUART_sRX_RxSts__5__POS, 5
.set UART_BUART_sRX_RxSts__MASK, 0x38
.set UART_BUART_sRX_RxSts__MASK_REG, CYREG_UDB_W8_MSK_01
.set UART_BUART_sRX_RxSts__STATUS_AUX_CTL_REG, CYREG_UDB_W8_ACTL_01
.set UART_BUART_sRX_RxSts__STATUS_REG, CYREG_UDB_W8_ST_01
.set UART_BUART_sTX_sCLOCK_TxBitClkGen__16BIT_A0_REG, CYREG_UDB_W16_A0_02
.set UART_BUART_sTX_sCLOCK_TxBitClkGen__16BIT_A1_REG, CYREG_UDB_W16_A1_02
.set UART_BUART_sTX_sCLOCK_TxBitClkGen__16BIT_D0_REG, CYREG_UDB_W16_D0_02
.set UART_BUART_sTX_sCLOCK_TxBitClkGen__16BIT_D1_REG, CYREG_UDB_W16_D1_02
.set UART_BUART_sTX_sCLOCK_TxBitClkGen__16BIT_DP_AUX_CTL_REG, CYREG_UDB_W16_ACTL_02
.set UART_BUART_sTX_sCLOCK_TxBitClkGen__16BIT_F0_REG, CYREG_UDB_W16_F0_02
.set UART_BUART_sTX_sCLOCK_TxBitClkGen__16BIT_F1_REG, CYREG_UDB_W16_F1_02
.set UART_BUART_sTX_sCLOCK_TxBitClkGen__A0_A1_REG, CYREG_UDB_CAT16_A_02
.set UART_BUART_sTX_sCLOCK_TxBitClkGen__A0_REG, CYREG_UDB_W8_A0_02
.set UART_BUART_sTX_sCLOCK_TxBitClkGen__A1_REG, CYREG_UDB_W8_A1_02
.set UART_BUART_sTX_sCLOCK_TxBitClkGen__D0_D1_REG, CYREG_UDB_CAT16_D_02
.set UART_BUART_sTX_sCLOCK_TxBitClkGen__D0_REG, CYREG_UDB_W8_D0_02
.set UART_BUART_sTX_sCLOCK_TxBitClkGen__D1_REG, CYREG_UDB_W8_D1_02
.set UART_BUART_sTX_sCLOCK_TxBitClkGen__DP_AUX_CTL_REG, CYREG_UDB_W8_ACTL_02
.set UART_BUART_sTX_sCLOCK_TxBitClkGen__F0_F1_REG, CYREG_UDB_CAT16_F_02
.set UART_BUART_sTX_sCLOCK_TxBitClkGen__F0_REG, CYREG_UDB_W8_F0_02
.set UART_BUART_sTX_sCLOCK_TxBitClkGen__F1_REG, CYREG_UDB_W8_F1_02
.set UART_BUART_sTX_TxShifter_u0__A0_A1_REG, CYREG_UDB_CAT16_A_03
.set UART_BUART_sTX_TxShifter_u0__A0_REG, CYREG_UDB_W8_A0_03
.set UART_BUART_sTX_TxShifter_u0__A1_REG, CYREG_UDB_W8_A1_03
.set UART_BUART_sTX_TxShifter_u0__D0_D1_REG, CYREG_UDB_CAT16_D_03
.set UART_BUART_sTX_TxShifter_u0__D0_REG, CYREG_UDB_W8_D0_03
.set UART_BUART_sTX_TxShifter_u0__D1_REG, CYREG_UDB_W8_D1_03
.set UART_BUART_sTX_TxShifter_u0__DP_AUX_CTL_REG, CYREG_UDB_W8_ACTL_03
.set UART_BUART_sTX_TxShifter_u0__F0_F1_REG, CYREG_UDB_CAT16_F_03
.set UART_BUART_sTX_TxShifter_u0__F0_REG, CYREG_UDB_W8_F0_03
.set UART_BUART_sTX_TxShifter_u0__F1_REG, CYREG_UDB_W8_F1_03
.set UART_BUART_sTX_TxSts__0__MASK, 0x01
.set UART_BUART_sTX_TxSts__0__POS, 0
.set UART_BUART_sTX_TxSts__1__MASK, 0x02
.set UART_BUART_sTX_TxSts__1__POS, 1
.set UART_BUART_sTX_TxSts__2__MASK, 0x04
.set UART_BUART_sTX_TxSts__2__POS, 2
.set UART_BUART_sTX_TxSts__3__MASK, 0x08
.set UART_BUART_sTX_TxSts__3__POS, 3
.set UART_BUART_sTX_TxSts__MASK, 0x0F
.set UART_BUART_sTX_TxSts__MASK_REG, CYREG_UDB_W8_MSK_03
.set UART_BUART_sTX_TxSts__STATUS_AUX_CTL_REG, CYREG_UDB_W8_ACTL_03
.set UART_BUART_sTX_TxSts__STATUS_REG, CYREG_UDB_W8_ST_03

/* UART_IntClock */
.set UART_IntClock__DIVIDER_MASK, 0x0000FFFF
.set UART_IntClock__ENABLE, CYREG_CLK_DIVIDER_A00
.set UART_IntClock__ENABLE_MASK, 0x80000000
.set UART_IntClock__MASK, 0x80000000
.set UART_IntClock__REGISTER, CYREG_CLK_DIVIDER_A00

/* UART_RXInternalInterrupt */
.set UART_RXInternalInterrupt__INTC_CLR_EN_REG, CYREG_CM0_ICER
.set UART_RXInternalInterrupt__INTC_CLR_PD_REG, CYREG_CM0_ICPR
.set UART_RXInternalInterrupt__INTC_MASK, 0x01
.set UART_RXInternalInterrupt__INTC_NUMBER, 0
.set UART_RXInternalInterrupt__INTC_PRIOR_MASK, 0xC0
.set UART_RXInternalInterrupt__INTC_PRIOR_NUM, 3
.set UART_RXInternalInterrupt__INTC_PRIOR_REG, CYREG_CM0_IPR0
.set UART_RXInternalInterrupt__INTC_SET_EN_REG, CYREG_CM0_ISER
.set UART_RXInternalInterrupt__INTC_SET_PD_REG, CYREG_CM0_ISPR

/* UART_TXInternalInterrupt */
.set UART_TXInternalInterrupt__INTC_CLR_EN_REG, CYREG_CM0_ICER
.set UART_TXInternalInterrupt__INTC_CLR_PD_REG, CYREG_CM0_ICPR
.set UART_TXInternalInterrupt__INTC_MASK, 0x04
.set UART_TXInternalInterrupt__INTC_NUMBER, 2
.set UART_TXInternalInterrupt__INTC_PRIOR_MASK, 0xC00000
.set UART_TXInternalInterrupt__INTC_PRIOR_NUM, 3
.set UART_TXInternalInterrupt__INTC_PRIOR_REG, CYREG_CM0_IPR0
.set UART_TXInternalInterrupt__INTC_SET_EN_REG, CYREG_CM0_ISER
.set UART_TXInternalInterrupt__INTC_SET_PD_REG, CYREG_CM0_ISPR

/* Miscellaneous */
.set CYDEV_BCLK__HFCLK__HZ, 24000000
.set CYDEV_BCLK__HFCLK__KHZ, 24000
.set CYDEV_BCLK__HFCLK__MHZ, 24
.set CYDEV_BCLK__SYSCLK__HZ, 24000000
.set CYDEV_BCLK__SYSCLK__KHZ, 24000
.set CYDEV_BCLK__SYSCLK__MHZ, 24
.set CYDEV_CHIP_DIE_LEOPARD, 1
.set CYDEV_CHIP_DIE_PSOC4A, 16
.set CYDEV_CHIP_DIE_PSOC5LP, 2
.set CYDEV_CHIP_DIE_PSOC5TM, 3
.set CYDEV_CHIP_DIE_TMA4, 4
.set CYDEV_CHIP_DIE_UNKNOWN, 0
.set CYDEV_CHIP_FAMILY_FM0P, 5
.set CYDEV_CHIP_FAMILY_FM3, 6
.set CYDEV_CHIP_FAMILY_FM4, 7
.set CYDEV_CHIP_FAMILY_PSOC3, 1
.set CYDEV_CHIP_FAMILY_PSOC4, 2
.set CYDEV_CHIP_FAMILY_PSOC5, 3
.set CYDEV_CHIP_FAMILY_PSOC6, 4
.set CYDEV_CHIP_FAMILY_UNKNOWN, 0
.set CYDEV_CHIP_FAMILY_USED, CYDEV_CHIP_FAMILY_PSOC4
.set CYDEV_CHIP_JTAG_ID, 0x04C81193
.set CYDEV_CHIP_MEMBER_3A, 1
.set CYDEV_CHIP_MEMBER_4A, 16
.set CYDEV_CHIP_MEMBER_4D, 12
.set CYDEV_CHIP_MEMBER_4E, 6
.set CYDEV_CHIP_MEMBER_4F, 17
.set CYDEV_CHIP_MEMBER_4G, 4
.set CYDEV_CHIP_MEMBER_4H, 15
.set CYDEV_CHIP_MEMBER_4I, 21
.set CYDEV_CHIP_MEMBER_4J, 13
.set CYDEV_CHIP_MEMBER_4K, 14
.set CYDEV_CHIP_MEMBER_4L, 20
.set CYDEV_CHIP_MEMBER_4M, 19
.set CYDEV_CHIP_MEMBER_4N, 9
.set CYDEV_CHIP_MEMBER_4O, 7
.set CYDEV_CHIP_MEMBER_4P, 18
.set CYDEV_CHIP_MEMBER_4Q, 11
.set CYDEV_CHIP_MEMBER_4R, 8
.set CYDEV_CHIP_MEMBER_4S, 10
.set CYDEV_CHIP_MEMBER_4U, 5
.set CYDEV_CHIP_MEMBER_5A, 3
.set CYDEV_CHIP_MEMBER_5B, 2
.set CYDEV_CHIP_MEMBER_6A, 22
.set CYDEV_CHIP_MEMBER_FM3, 26
.set CYDEV_CHIP_MEMBER_FM4, 27
.set CYDEV_CHIP_MEMBER_PDL_FM0P_TYPE1, 23
.set CYDEV_CHIP_MEMBER_PDL_FM0P_TYPE2, 24
.set CYDEV_CHIP_MEMBER_PDL_FM0P_TYPE3, 25
.set CYDEV_CHIP_MEMBER_UNKNOWN, 0
.set CYDEV_CHIP_MEMBER_USED, CYDEV_CHIP_MEMBER_4A
.set CYDEV_CHIP_DIE_EXPECT, CYDEV_CHIP_MEMBER_USED
.set CYDEV_CHIP_DIE_ACTUAL, CYDEV_CHIP_DIE_EXPECT
.set CYDEV_CHIP_REV_LEOPARD_ES1, 0
.set CYDEV_CHIP_REV_LEOPARD_ES2, 1
.set CYDEV_CHIP_REV_LEOPARD_ES3, 3
.set CYDEV_CHIP_REV_LEOPARD_PRODUCTION, 3
.set CYDEV_CHIP_REV_PSOC4A_ES0, 17
.set CYDEV_CHIP_REV_PSOC4A_PRODUCTION, 17
.set CYDEV_CHIP_REV_PSOC5LP_ES0, 0
.set CYDEV_CHIP_REV_PSOC5LP_PRODUCTION, 0
.set CYDEV_CHIP_REV_PSOC5TM_ES0, 0
.set CYDEV_CHIP_REV_PSOC5TM_ES1, 1
.set CYDEV_CHIP_REV_PSOC5TM_PRODUCTION, 1
.set CYDEV_CHIP_REV_TMA4_ES, 17
.set CYDEV_CHIP_REV_TMA4_ES2, 33
.set CYDEV_CHIP_REV_TMA4_PRODUCTION, 17
.set CYDEV_CHIP_REVISION_3A_ES1, 0
.set CYDEV_CHIP_REVISION_3A_ES2, 1
.set CYDEV_CHIP_REVISION_3A_ES3, 3
.set CYDEV_CHIP_REVISION_3A_PRODUCTION, 3
.set CYDEV_CHIP_REVISION_4A_ES0, 17
.set CYDEV_CHIP_REVISION_4A_PRODUCTION, 17
.set CYDEV_CHIP_REVISION_4D_PRODUCTION, 0
.set CYDEV_CHIP_REVISION_4E_PRODUCTION, 0
.set CYDEV_CHIP_REVISION_4F_PRODUCTION, 0
.set CYDEV_CHIP_REVISION_4F_PRODUCTION_256DMA, 0
.set CYDEV_CHIP_REVISION_4F_PRODUCTION_256K, 0
.set CYDEV_CHIP_REVISION_4G_ES, 17
.set CYDEV_CHIP_REVISION_4G_ES2, 33
.set CYDEV_CHIP_REVISION_4G_PRODUCTION, 17
.set CYDEV_CHIP_REVISION_4H_PRODUCTION, 0
.set CYDEV_CHIP_REVISION_4I_PRODUCTION, 0
.set CYDEV_CHIP_REVISION_4J_PRODUCTION, 0
.set CYDEV_CHIP_REVISION_4K_PRODUCTION, 0
.set CYDEV_CHIP_REVISION_4L_PRODUCTION, 0
.set CYDEV_CHIP_REVISION_4M_PRODUCTION, 0
.set CYDEV_CHIP_REVISION_4N_PRODUCTION, 0
.set CYDEV_CHIP_REVISION_4O_PRODUCTION, 0
.set CYDEV_CHIP_REVISION_4P_PRODUCTION, 0
.set CYDEV_CHIP_REVISION_4Q_PRODUCTION, 0
.set CYDEV_CHIP_REVISION_4R_PRODUCTION, 0
.set CYDEV_CHIP_REVISION_4S_PRODUCTION, 0
.set CYDEV_CHIP_REVISION_4U_PRODUCTION, 0
.set CYDEV_CHIP_REVISION_5A_ES0, 0
.set CYDEV_CHIP_REVISION_5A_ES1, 1
.set CYDEV_CHIP_REVISION_5A_PRODUCTION, 1
.set CYDEV_CHIP_REVISION_5B_ES0, 0
.set CYDEV_CHIP_REVISION_5B_PRODUCTION, 0
.set CYDEV_CHIP_REVISION_6A_NO_UDB, 0
.set CYDEV_CHIP_REVISION_6A_PRODUCTION, 0
.set CYDEV_CHIP_REVISION_FM3_PRODUCTION, 0
.set CYDEV_CHIP_REVISION_FM4_PRODUCTION, 0
.set CYDEV_CHIP_REVISION_PDL_FM0P_TYPE1_PRODUCTION, 0
.set CYDEV_CHIP_REVISION_PDL_FM0P_TYPE2_PRODUCTION, 0
.set CYDEV_CHIP_REVISION_PDL_FM0P_TYPE3_PRODUCTION, 0
.set CYDEV_CHIP_REVISION_USED, CYDEV_CHIP_REVISION_4A_PRODUCTION
.set CYDEV_CHIP_REV_EXPECT, CYDEV_CHIP_REVISION_USED
.set CYDEV_CONFIG_READ_ACCELERATOR, 1
.set CYDEV_CONFIG_UNUSED_IO_AllowButWarn, 0
.set CYDEV_CONFIG_UNUSED_IO, CYDEV_CONFIG_UNUSED_IO_AllowButWarn
.set CYDEV_CONFIG_UNUSED_IO_AllowWithInfo, 1
.set CYDEV_CONFIG_UNUSED_IO_Disallowed, 2
.set CYDEV_CONFIGURATION_COMPRESSED, 1
.set CYDEV_CONFIGURATION_MODE_COMPRESSED, 0
.set CYDEV_CONFIGURATION_MODE, CYDEV_CONFIGURATION_MODE_COMPRESSED
.set CYDEV_CONFIGURATION_MODE_DMA, 2
.set CYDEV_CONFIGURATION_MODE_UNCOMPRESSED, 1
.set CYDEV_DEBUG_PROTECT_KILL, 4
.set CYDEV_DEBUG_PROTECT_OPEN, 1
.set CYDEV_DEBUG_PROTECT, CYDEV_DEBUG_PROTECT_OPEN
.set CYDEV_DEBUG_PROTECT_PROTECTED, 2
.set CYDEV_DEBUGGING_DPS_Disable, 3
.set CYDEV_DEBUGGING_DPS_SWD, 2
.set CYDEV_DEBUGGING_DPS, CYDEV_DEBUGGING_DPS_SWD
.set CYDEV_DEBUGGING_ENABLE, 1
.set CYDEV_DFT_SELECT_CLK0, 1
.set CYDEV_DFT_SELECT_CLK1, 2
.set CYDEV_HEAP_SIZE, 0x80
.set CYDEV_IMO_TRIMMED_BY_USB, 0
.set CYDEV_IMO_TRIMMED_BY_WCO, 0
.set CYDEV_IS_EXPORTING_CODE, 0
.set CYDEV_IS_IMPORTING_CODE, 0
.set CYDEV_PROJ_TYPE, 0
.set CYDEV_PROJ_TYPE_BOOTLOADER, 1
.set CYDEV_PROJ_TYPE_LAUNCHER, 5
.set CYDEV_PROJ_TYPE_LOADABLE, 2
.set CYDEV_PROJ_TYPE_LOADABLEANDBOOTLOADER, 4
.set CYDEV_PROJ_TYPE_MULTIAPPBOOTLOADER, 3
.set CYDEV_PROJ_TYPE_STANDARD, 0
.set CYDEV_STACK_SIZE, 0x0400
.set CYDEV_USE_BUNDLED_CMSIS, 1
.set CYDEV_VARIABLE_VDDA, 0
.set CYDEV_VDDA, 5
.set CYDEV_VDDA_MV, 5000
.set CYDEV_VDDD, 5
.set CYDEV_VDDD_MV, 5000
.set CYDEV_WDT_GENERATE_ISR, 0
.set CYIPBLOCK_M0S8_CTBM_VERSION, 0
.set CYIPBLOCK_m0s8cpuss_VERSION, 0
.set CYIPBLOCK_m0s8csd_VERSION, 0
.set CYIPBLOCK_m0s8gpio2_VERSION, 0
.set CYIPBLOCK_m0s8hsiom4a_VERSION, 0
.set CYIPBLOCK_m0s8lcd_VERSION, 0
.set CYIPBLOCK_m0s8lpcomp_VERSION, 0
.set CYIPBLOCK_m0s8pclk_VERSION, 0
.set CYIPBLOCK_m0s8sar_VERSION, 0
.set CYIPBLOCK_m0s8scb_VERSION, 0
.set CYIPBLOCK_m0s8srssv2_VERSION, 1
.set CYIPBLOCK_m0s8tcpwm_VERSION, 0
.set CYIPBLOCK_m0s8udbif_VERSION, 0
.set CYIPBLOCK_S8_GPIO_VERSION, 2
.set CYDEV_BOOTLOADER_ENABLE, 0
.endif
