/*******************************************************************************
* File Name: cyfittergnu.inc
* 
* PSoC Creator  4.1 Update 1
*
* Description:
* 
* This file is automatically generated by PSoC Creator.
*
********************************************************************************
* Copyright (c) 2007-2017 Cypress Semiconductor.  All rights reserved.
* You may use this file only in accordance with the license, terms, conditions, 
* disclaimers, and limitations in the end user license agreement accompanying 
* the software package with which this file was provided.
********************************************************************************/

.ifndef INCLUDED_CYFITTERGNU_INC
.set INCLUDED_CYFITTERGNU_INC, 1
.include "cydevicegnu_trm.inc"

/* Clock_1 */
.set Clock_1__DIVIDER_MASK, 0x0000FFFF
.set Clock_1__ENABLE, CYREG_CLK_DIVIDER_A00
.set Clock_1__ENABLE_MASK, 0x80000000
.set Clock_1__MASK, 0x80000000
.set Clock_1__REGISTER, CYREG_CLK_DIVIDER_A00

/* Echo */
.set Echo__0__DM__MASK, 0x07
.set Echo__0__DM__SHIFT, 0
.set Echo__0__DR, CYREG_PRT0_DR
.set Echo__0__HSIOM, CYREG_HSIOM_PORT_SEL0
.set Echo__0__HSIOM_MASK, 0x0000000F
.set Echo__0__HSIOM_SHIFT, 0
.set Echo__0__INTCFG, CYREG_PRT0_INTCFG
.set Echo__0__INTSTAT, CYREG_PRT0_INTSTAT
.set Echo__0__MASK, 0x01
.set Echo__0__PA__CFG0, CYREG_UDB_PA0_CFG0
.set Echo__0__PA__CFG1, CYREG_UDB_PA0_CFG1
.set Echo__0__PA__CFG10, CYREG_UDB_PA0_CFG10
.set Echo__0__PA__CFG11, CYREG_UDB_PA0_CFG11
.set Echo__0__PA__CFG12, CYREG_UDB_PA0_CFG12
.set Echo__0__PA__CFG13, CYREG_UDB_PA0_CFG13
.set Echo__0__PA__CFG14, CYREG_UDB_PA0_CFG14
.set Echo__0__PA__CFG2, CYREG_UDB_PA0_CFG2
.set Echo__0__PA__CFG3, CYREG_UDB_PA0_CFG3
.set Echo__0__PA__CFG4, CYREG_UDB_PA0_CFG4
.set Echo__0__PA__CFG5, CYREG_UDB_PA0_CFG5
.set Echo__0__PA__CFG6, CYREG_UDB_PA0_CFG6
.set Echo__0__PA__CFG7, CYREG_UDB_PA0_CFG7
.set Echo__0__PA__CFG8, CYREG_UDB_PA0_CFG8
.set Echo__0__PA__CFG9, CYREG_UDB_PA0_CFG9
.set Echo__0__PC, CYREG_PRT0_PC
.set Echo__0__PC2, CYREG_PRT0_PC2
.set Echo__0__PORT, 0
.set Echo__0__PS, CYREG_PRT0_PS
.set Echo__0__SHIFT, 0
.set Echo__1__DM__MASK, 0x38
.set Echo__1__DM__SHIFT, 3
.set Echo__1__DR, CYREG_PRT0_DR
.set Echo__1__HSIOM, CYREG_HSIOM_PORT_SEL0
.set Echo__1__HSIOM_MASK, 0x000000F0
.set Echo__1__HSIOM_SHIFT, 4
.set Echo__1__INTCFG, CYREG_PRT0_INTCFG
.set Echo__1__INTSTAT, CYREG_PRT0_INTSTAT
.set Echo__1__MASK, 0x02
.set Echo__1__PA__CFG0, CYREG_UDB_PA0_CFG0
.set Echo__1__PA__CFG1, CYREG_UDB_PA0_CFG1
.set Echo__1__PA__CFG10, CYREG_UDB_PA0_CFG10
.set Echo__1__PA__CFG11, CYREG_UDB_PA0_CFG11
.set Echo__1__PA__CFG12, CYREG_UDB_PA0_CFG12
.set Echo__1__PA__CFG13, CYREG_UDB_PA0_CFG13
.set Echo__1__PA__CFG14, CYREG_UDB_PA0_CFG14
.set Echo__1__PA__CFG2, CYREG_UDB_PA0_CFG2
.set Echo__1__PA__CFG3, CYREG_UDB_PA0_CFG3
.set Echo__1__PA__CFG4, CYREG_UDB_PA0_CFG4
.set Echo__1__PA__CFG5, CYREG_UDB_PA0_CFG5
.set Echo__1__PA__CFG6, CYREG_UDB_PA0_CFG6
.set Echo__1__PA__CFG7, CYREG_UDB_PA0_CFG7
.set Echo__1__PA__CFG8, CYREG_UDB_PA0_CFG8
.set Echo__1__PA__CFG9, CYREG_UDB_PA0_CFG9
.set Echo__1__PC, CYREG_PRT0_PC
.set Echo__1__PC2, CYREG_PRT0_PC2
.set Echo__1__PORT, 0
.set Echo__1__PS, CYREG_PRT0_PS
.set Echo__1__SHIFT, 1
.set Echo__2__DM__MASK, 0x1C0
.set Echo__2__DM__SHIFT, 6
.set Echo__2__DR, CYREG_PRT0_DR
.set Echo__2__HSIOM, CYREG_HSIOM_PORT_SEL0
.set Echo__2__HSIOM_MASK, 0x00000F00
.set Echo__2__HSIOM_SHIFT, 8
.set Echo__2__INTCFG, CYREG_PRT0_INTCFG
.set Echo__2__INTSTAT, CYREG_PRT0_INTSTAT
.set Echo__2__MASK, 0x04
.set Echo__2__PA__CFG0, CYREG_UDB_PA0_CFG0
.set Echo__2__PA__CFG1, CYREG_UDB_PA0_CFG1
.set Echo__2__PA__CFG10, CYREG_UDB_PA0_CFG10
.set Echo__2__PA__CFG11, CYREG_UDB_PA0_CFG11
.set Echo__2__PA__CFG12, CYREG_UDB_PA0_CFG12
.set Echo__2__PA__CFG13, CYREG_UDB_PA0_CFG13
.set Echo__2__PA__CFG14, CYREG_UDB_PA0_CFG14
.set Echo__2__PA__CFG2, CYREG_UDB_PA0_CFG2
.set Echo__2__PA__CFG3, CYREG_UDB_PA0_CFG3
.set Echo__2__PA__CFG4, CYREG_UDB_PA0_CFG4
.set Echo__2__PA__CFG5, CYREG_UDB_PA0_CFG5
.set Echo__2__PA__CFG6, CYREG_UDB_PA0_CFG6
.set Echo__2__PA__CFG7, CYREG_UDB_PA0_CFG7
.set Echo__2__PA__CFG8, CYREG_UDB_PA0_CFG8
.set Echo__2__PA__CFG9, CYREG_UDB_PA0_CFG9
.set Echo__2__PC, CYREG_PRT0_PC
.set Echo__2__PC2, CYREG_PRT0_PC2
.set Echo__2__PORT, 0
.set Echo__2__PS, CYREG_PRT0_PS
.set Echo__2__SHIFT, 2
.set Echo__DR, CYREG_PRT0_DR
.set Echo__INTCFG, CYREG_PRT0_INTCFG
.set Echo__INTSTAT, CYREG_PRT0_INTSTAT
.set Echo__MASK, 0x07
.set Echo__PA__CFG0, CYREG_UDB_PA0_CFG0
.set Echo__PA__CFG1, CYREG_UDB_PA0_CFG1
.set Echo__PA__CFG10, CYREG_UDB_PA0_CFG10
.set Echo__PA__CFG11, CYREG_UDB_PA0_CFG11
.set Echo__PA__CFG12, CYREG_UDB_PA0_CFG12
.set Echo__PA__CFG13, CYREG_UDB_PA0_CFG13
.set Echo__PA__CFG14, CYREG_UDB_PA0_CFG14
.set Echo__PA__CFG2, CYREG_UDB_PA0_CFG2
.set Echo__PA__CFG3, CYREG_UDB_PA0_CFG3
.set Echo__PA__CFG4, CYREG_UDB_PA0_CFG4
.set Echo__PA__CFG5, CYREG_UDB_PA0_CFG5
.set Echo__PA__CFG6, CYREG_UDB_PA0_CFG6
.set Echo__PA__CFG7, CYREG_UDB_PA0_CFG7
.set Echo__PA__CFG8, CYREG_UDB_PA0_CFG8
.set Echo__PA__CFG9, CYREG_UDB_PA0_CFG9
.set Echo__PC, CYREG_PRT0_PC
.set Echo__PC2, CYREG_PRT0_PC2
.set Echo__PORT, 0
.set Echo__PS, CYREG_PRT0_PS
.set Echo__SHIFT, 0
.set Echo__SNAP, CYREG_PRT0_INTSTAT

/* ISR */
.set ISR__INTC_CLR_EN_REG, CYREG_CM0_ICER
.set ISR__INTC_CLR_PD_REG, CYREG_CM0_ICPR
.set ISR__INTC_MASK, 0x10000
.set ISR__INTC_NUMBER, 16
.set ISR__INTC_PRIOR_MASK, 0xC0
.set ISR__INTC_PRIOR_NUM, 3
.set ISR__INTC_PRIOR_REG, CYREG_CM0_IPR4
.set ISR__INTC_SET_EN_REG, CYREG_CM0_ISER
.set ISR__INTC_SET_PD_REG, CYREG_CM0_ISPR

/* Timer */
.set Timer_cy_m0s8_tcpwm_1__CC, CYREG_TCPWM_CNT0_CC
.set Timer_cy_m0s8_tcpwm_1__CC_BUFF, CYREG_TCPWM_CNT0_CC_BUFF
.set Timer_cy_m0s8_tcpwm_1__COUNTER, CYREG_TCPWM_CNT0_COUNTER
.set Timer_cy_m0s8_tcpwm_1__CTRL, CYREG_TCPWM_CNT0_CTRL
.set Timer_cy_m0s8_tcpwm_1__INTR, CYREG_TCPWM_CNT0_INTR
.set Timer_cy_m0s8_tcpwm_1__INTR_MASK, CYREG_TCPWM_CNT0_INTR_MASK
.set Timer_cy_m0s8_tcpwm_1__INTR_MASKED, CYREG_TCPWM_CNT0_INTR_MASKED
.set Timer_cy_m0s8_tcpwm_1__INTR_SET, CYREG_TCPWM_CNT0_INTR_SET
.set Timer_cy_m0s8_tcpwm_1__PERIOD, CYREG_TCPWM_CNT0_PERIOD
.set Timer_cy_m0s8_tcpwm_1__PERIOD_BUFF, CYREG_TCPWM_CNT0_PERIOD_BUFF
.set Timer_cy_m0s8_tcpwm_1__STATUS, CYREG_TCPWM_CNT0_STATUS
.set Timer_cy_m0s8_tcpwm_1__TCPWM_CMD, CYREG_TCPWM_CMD
.set Timer_cy_m0s8_tcpwm_1__TCPWM_CMDCAPTURE_MASK, 0x01
.set Timer_cy_m0s8_tcpwm_1__TCPWM_CMDCAPTURE_SHIFT, 0
.set Timer_cy_m0s8_tcpwm_1__TCPWM_CMDRELOAD_MASK, 0x100
.set Timer_cy_m0s8_tcpwm_1__TCPWM_CMDRELOAD_SHIFT, 8
.set Timer_cy_m0s8_tcpwm_1__TCPWM_CMDSTART_MASK, 0x1000000
.set Timer_cy_m0s8_tcpwm_1__TCPWM_CMDSTART_SHIFT, 24
.set Timer_cy_m0s8_tcpwm_1__TCPWM_CMDSTOP_MASK, 0x10000
.set Timer_cy_m0s8_tcpwm_1__TCPWM_CMDSTOP_SHIFT, 16
.set Timer_cy_m0s8_tcpwm_1__TCPWM_CTRL, CYREG_TCPWM_CTRL
.set Timer_cy_m0s8_tcpwm_1__TCPWM_CTRL_MASK, 0x01
.set Timer_cy_m0s8_tcpwm_1__TCPWM_CTRL_SHIFT, 0
.set Timer_cy_m0s8_tcpwm_1__TCPWM_INTR_CAUSE, CYREG_TCPWM_INTR_CAUSE
.set Timer_cy_m0s8_tcpwm_1__TCPWM_INTR_CAUSE_MASK, 0x01
.set Timer_cy_m0s8_tcpwm_1__TCPWM_INTR_CAUSE_SHIFT, 0
.set Timer_cy_m0s8_tcpwm_1__TCPWM_NUMBER, 0
.set Timer_cy_m0s8_tcpwm_1__TR_CTRL0, CYREG_TCPWM_CNT0_TR_CTRL0
.set Timer_cy_m0s8_tcpwm_1__TR_CTRL1, CYREG_TCPWM_CNT0_TR_CTRL1
.set Timer_cy_m0s8_tcpwm_1__TR_CTRL2, CYREG_TCPWM_CNT0_TR_CTRL2

/* Trigger */
.set Trigger__0__DM__MASK, 0xE00
.set Trigger__0__DM__SHIFT, 9
.set Trigger__0__DR, CYREG_PRT0_DR
.set Trigger__0__HSIOM, CYREG_HSIOM_PORT_SEL0
.set Trigger__0__HSIOM_MASK, 0x0000F000
.set Trigger__0__HSIOM_SHIFT, 12
.set Trigger__0__INTCFG, CYREG_PRT0_INTCFG
.set Trigger__0__INTSTAT, CYREG_PRT0_INTSTAT
.set Trigger__0__MASK, 0x08
.set Trigger__0__PA__CFG0, CYREG_UDB_PA0_CFG0
.set Trigger__0__PA__CFG1, CYREG_UDB_PA0_CFG1
.set Trigger__0__PA__CFG10, CYREG_UDB_PA0_CFG10
.set Trigger__0__PA__CFG11, CYREG_UDB_PA0_CFG11
.set Trigger__0__PA__CFG12, CYREG_UDB_PA0_CFG12
.set Trigger__0__PA__CFG13, CYREG_UDB_PA0_CFG13
.set Trigger__0__PA__CFG14, CYREG_UDB_PA0_CFG14
.set Trigger__0__PA__CFG2, CYREG_UDB_PA0_CFG2
.set Trigger__0__PA__CFG3, CYREG_UDB_PA0_CFG3
.set Trigger__0__PA__CFG4, CYREG_UDB_PA0_CFG4
.set Trigger__0__PA__CFG5, CYREG_UDB_PA0_CFG5
.set Trigger__0__PA__CFG6, CYREG_UDB_PA0_CFG6
.set Trigger__0__PA__CFG7, CYREG_UDB_PA0_CFG7
.set Trigger__0__PA__CFG8, CYREG_UDB_PA0_CFG8
.set Trigger__0__PA__CFG9, CYREG_UDB_PA0_CFG9
.set Trigger__0__PC, CYREG_PRT0_PC
.set Trigger__0__PC2, CYREG_PRT0_PC2
.set Trigger__0__PORT, 0
.set Trigger__0__PS, CYREG_PRT0_PS
.set Trigger__0__SHIFT, 3
.set Trigger__DR, CYREG_PRT0_DR
.set Trigger__INTCFG, CYREG_PRT0_INTCFG
.set Trigger__INTSTAT, CYREG_PRT0_INTSTAT
.set Trigger__MASK, 0x08
.set Trigger__PA__CFG0, CYREG_UDB_PA0_CFG0
.set Trigger__PA__CFG1, CYREG_UDB_PA0_CFG1
.set Trigger__PA__CFG10, CYREG_UDB_PA0_CFG10
.set Trigger__PA__CFG11, CYREG_UDB_PA0_CFG11
.set Trigger__PA__CFG12, CYREG_UDB_PA0_CFG12
.set Trigger__PA__CFG13, CYREG_UDB_PA0_CFG13
.set Trigger__PA__CFG14, CYREG_UDB_PA0_CFG14
.set Trigger__PA__CFG2, CYREG_UDB_PA0_CFG2
.set Trigger__PA__CFG3, CYREG_UDB_PA0_CFG3
.set Trigger__PA__CFG4, CYREG_UDB_PA0_CFG4
.set Trigger__PA__CFG5, CYREG_UDB_PA0_CFG5
.set Trigger__PA__CFG6, CYREG_UDB_PA0_CFG6
.set Trigger__PA__CFG7, CYREG_UDB_PA0_CFG7
.set Trigger__PA__CFG8, CYREG_UDB_PA0_CFG8
.set Trigger__PA__CFG9, CYREG_UDB_PA0_CFG9
.set Trigger__PC, CYREG_PRT0_PC
.set Trigger__PC2, CYREG_PRT0_PC2
.set Trigger__PORT, 0
.set Trigger__PS, CYREG_PRT0_PS
.set Trigger__SHIFT, 3

/* Miscellaneous */
.set CYDEV_BCLK__HFCLK__HZ, 24000000
.set CYDEV_BCLK__HFCLK__KHZ, 24000
.set CYDEV_BCLK__HFCLK__MHZ, 24
.set CYDEV_BCLK__SYSCLK__HZ, 24000000
.set CYDEV_BCLK__SYSCLK__KHZ, 24000
.set CYDEV_BCLK__SYSCLK__MHZ, 24
.set CYDEV_CHIP_DIE_LEOPARD, 1
.set CYDEV_CHIP_DIE_PSOC4A, 16
.set CYDEV_CHIP_DIE_PSOC5LP, 2
.set CYDEV_CHIP_DIE_PSOC5TM, 3
.set CYDEV_CHIP_DIE_TMA4, 4
.set CYDEV_CHIP_DIE_UNKNOWN, 0
.set CYDEV_CHIP_FAMILY_FM0P, 5
.set CYDEV_CHIP_FAMILY_FM3, 6
.set CYDEV_CHIP_FAMILY_FM4, 7
.set CYDEV_CHIP_FAMILY_PSOC3, 1
.set CYDEV_CHIP_FAMILY_PSOC4, 2
.set CYDEV_CHIP_FAMILY_PSOC5, 3
.set CYDEV_CHIP_FAMILY_PSOC6, 4
.set CYDEV_CHIP_FAMILY_UNKNOWN, 0
.set CYDEV_CHIP_FAMILY_USED, CYDEV_CHIP_FAMILY_PSOC4
.set CYDEV_CHIP_JTAG_ID, 0x04C81193
.set CYDEV_CHIP_MEMBER_3A, 1
.set CYDEV_CHIP_MEMBER_4A, 16
.set CYDEV_CHIP_MEMBER_4D, 12
.set CYDEV_CHIP_MEMBER_4E, 6
.set CYDEV_CHIP_MEMBER_4F, 17
.set CYDEV_CHIP_MEMBER_4G, 4
.set CYDEV_CHIP_MEMBER_4H, 15
.set CYDEV_CHIP_MEMBER_4I, 21
.set CYDEV_CHIP_MEMBER_4J, 13
.set CYDEV_CHIP_MEMBER_4K, 14
.set CYDEV_CHIP_MEMBER_4L, 20
.set CYDEV_CHIP_MEMBER_4M, 19
.set CYDEV_CHIP_MEMBER_4N, 9
.set CYDEV_CHIP_MEMBER_4O, 7
.set CYDEV_CHIP_MEMBER_4P, 18
.set CYDEV_CHIP_MEMBER_4Q, 11
.set CYDEV_CHIP_MEMBER_4R, 8
.set CYDEV_CHIP_MEMBER_4S, 10
.set CYDEV_CHIP_MEMBER_4U, 5
.set CYDEV_CHIP_MEMBER_5A, 3
.set CYDEV_CHIP_MEMBER_5B, 2
.set CYDEV_CHIP_MEMBER_6A, 22
.set CYDEV_CHIP_MEMBER_FM3, 26
.set CYDEV_CHIP_MEMBER_FM4, 27
.set CYDEV_CHIP_MEMBER_PDL_FM0P_TYPE1, 23
.set CYDEV_CHIP_MEMBER_PDL_FM0P_TYPE2, 24
.set CYDEV_CHIP_MEMBER_PDL_FM0P_TYPE3, 25
.set CYDEV_CHIP_MEMBER_UNKNOWN, 0
.set CYDEV_CHIP_MEMBER_USED, CYDEV_CHIP_MEMBER_4A
.set CYDEV_CHIP_DIE_EXPECT, CYDEV_CHIP_MEMBER_USED
.set CYDEV_CHIP_DIE_ACTUAL, CYDEV_CHIP_DIE_EXPECT
.set CYDEV_CHIP_REV_LEOPARD_ES1, 0
.set CYDEV_CHIP_REV_LEOPARD_ES2, 1
.set CYDEV_CHIP_REV_LEOPARD_ES3, 3
.set CYDEV_CHIP_REV_LEOPARD_PRODUCTION, 3
.set CYDEV_CHIP_REV_PSOC4A_ES0, 17
.set CYDEV_CHIP_REV_PSOC4A_PRODUCTION, 17
.set CYDEV_CHIP_REV_PSOC5LP_ES0, 0
.set CYDEV_CHIP_REV_PSOC5LP_PRODUCTION, 0
.set CYDEV_CHIP_REV_PSOC5TM_ES0, 0
.set CYDEV_CHIP_REV_PSOC5TM_ES1, 1
.set CYDEV_CHIP_REV_PSOC5TM_PRODUCTION, 1
.set CYDEV_CHIP_REV_TMA4_ES, 17
.set CYDEV_CHIP_REV_TMA4_ES2, 33
.set CYDEV_CHIP_REV_TMA4_PRODUCTION, 17
.set CYDEV_CHIP_REVISION_3A_ES1, 0
.set CYDEV_CHIP_REVISION_3A_ES2, 1
.set CYDEV_CHIP_REVISION_3A_ES3, 3
.set CYDEV_CHIP_REVISION_3A_PRODUCTION, 3
.set CYDEV_CHIP_REVISION_4A_ES0, 17
.set CYDEV_CHIP_REVISION_4A_PRODUCTION, 17
.set CYDEV_CHIP_REVISION_4D_PRODUCTION, 0
.set CYDEV_CHIP_REVISION_4E_PRODUCTION, 0
.set CYDEV_CHIP_REVISION_4F_PRODUCTION, 0
.set CYDEV_CHIP_REVISION_4F_PRODUCTION_256DMA, 0
.set CYDEV_CHIP_REVISION_4F_PRODUCTION_256K, 0
.set CYDEV_CHIP_REVISION_4G_ES, 17
.set CYDEV_CHIP_REVISION_4G_ES2, 33
.set CYDEV_CHIP_REVISION_4G_PRODUCTION, 17
.set CYDEV_CHIP_REVISION_4H_PRODUCTION, 0
.set CYDEV_CHIP_REVISION_4I_PRODUCTION, 0
.set CYDEV_CHIP_REVISION_4J_PRODUCTION, 0
.set CYDEV_CHIP_REVISION_4K_PRODUCTION, 0
.set CYDEV_CHIP_REVISION_4L_PRODUCTION, 0
.set CYDEV_CHIP_REVISION_4M_PRODUCTION, 0
.set CYDEV_CHIP_REVISION_4N_PRODUCTION, 0
.set CYDEV_CHIP_REVISION_4O_PRODUCTION, 0
.set CYDEV_CHIP_REVISION_4P_PRODUCTION, 0
.set CYDEV_CHIP_REVISION_4Q_PRODUCTION, 0
.set CYDEV_CHIP_REVISION_4R_PRODUCTION, 0
.set CYDEV_CHIP_REVISION_4S_PRODUCTION, 0
.set CYDEV_CHIP_REVISION_4U_PRODUCTION, 0
.set CYDEV_CHIP_REVISION_5A_ES0, 0
.set CYDEV_CHIP_REVISION_5A_ES1, 1
.set CYDEV_CHIP_REVISION_5A_PRODUCTION, 1
.set CYDEV_CHIP_REVISION_5B_ES0, 0
.set CYDEV_CHIP_REVISION_5B_PRODUCTION, 0
.set CYDEV_CHIP_REVISION_6A_NO_UDB, 0
.set CYDEV_CHIP_REVISION_6A_PRODUCTION, 0
.set CYDEV_CHIP_REVISION_FM3_PRODUCTION, 0
.set CYDEV_CHIP_REVISION_FM4_PRODUCTION, 0
.set CYDEV_CHIP_REVISION_PDL_FM0P_TYPE1_PRODUCTION, 0
.set CYDEV_CHIP_REVISION_PDL_FM0P_TYPE2_PRODUCTION, 0
.set CYDEV_CHIP_REVISION_PDL_FM0P_TYPE3_PRODUCTION, 0
.set CYDEV_CHIP_REVISION_USED, CYDEV_CHIP_REVISION_4A_PRODUCTION
.set CYDEV_CHIP_REV_EXPECT, CYDEV_CHIP_REVISION_USED
.set CYDEV_CONFIG_READ_ACCELERATOR, 1
.set CYDEV_CONFIG_UNUSED_IO_AllowButWarn, 0
.set CYDEV_CONFIG_UNUSED_IO_AllowWithInfo, 1
.set CYDEV_CONFIG_UNUSED_IO_Disallowed, 2
.set CYDEV_CONFIG_UNUSED_IO, CYDEV_CONFIG_UNUSED_IO_Disallowed
.set CYDEV_CONFIGURATION_COMPRESSED, 1
.set CYDEV_CONFIGURATION_MODE_COMPRESSED, 0
.set CYDEV_CONFIGURATION_MODE, CYDEV_CONFIGURATION_MODE_COMPRESSED
.set CYDEV_CONFIGURATION_MODE_DMA, 2
.set CYDEV_CONFIGURATION_MODE_UNCOMPRESSED, 1
.set CYDEV_DEBUG_PROTECT_KILL, 4
.set CYDEV_DEBUG_PROTECT_OPEN, 1
.set CYDEV_DEBUG_PROTECT, CYDEV_DEBUG_PROTECT_OPEN
.set CYDEV_DEBUG_PROTECT_PROTECTED, 2
.set CYDEV_DEBUGGING_DPS_Disable, 3
.set CYDEV_DEBUGGING_DPS_SWD, 2
.set CYDEV_DEBUGGING_DPS, CYDEV_DEBUGGING_DPS_SWD
.set CYDEV_DEBUGGING_ENABLE, 1
.set CYDEV_DFT_SELECT_CLK0, 1
.set CYDEV_DFT_SELECT_CLK1, 2
.set CYDEV_HEAP_SIZE, 0x80
.set CYDEV_IMO_TRIMMED_BY_USB, 0
.set CYDEV_IMO_TRIMMED_BY_WCO, 0
.set CYDEV_IS_EXPORTING_CODE, 0
.set CYDEV_IS_IMPORTING_CODE, 0
.set CYDEV_PROJ_TYPE, 0
.set CYDEV_PROJ_TYPE_BOOTLOADER, 1
.set CYDEV_PROJ_TYPE_LAUNCHER, 5
.set CYDEV_PROJ_TYPE_LOADABLE, 2
.set CYDEV_PROJ_TYPE_LOADABLEANDBOOTLOADER, 4
.set CYDEV_PROJ_TYPE_MULTIAPPBOOTLOADER, 3
.set CYDEV_PROJ_TYPE_STANDARD, 0
.set CYDEV_STACK_SIZE, 0x0400
.set CYDEV_USE_BUNDLED_CMSIS, 1
.set CYDEV_VARIABLE_VDDA, 1
.set CYDEV_VDDA_MV, 3300
.set CYDEV_VDDD_MV, 3300
.set CYDEV_WDT_GENERATE_ISR, 1
.set CYIPBLOCK_M0S8_CTBM_VERSION, 0
.set CYIPBLOCK_m0s8cpuss_VERSION, 0
.set CYIPBLOCK_m0s8csd_VERSION, 0
.set CYIPBLOCK_m0s8gpio2_VERSION, 0
.set CYIPBLOCK_m0s8hsiom4a_VERSION, 0
.set CYIPBLOCK_m0s8lcd_VERSION, 0
.set CYIPBLOCK_m0s8lpcomp_VERSION, 0
.set CYIPBLOCK_m0s8pclk_VERSION, 0
.set CYIPBLOCK_m0s8sar_VERSION, 0
.set CYIPBLOCK_m0s8scb_VERSION, 0
.set CYIPBLOCK_m0s8srssv2_VERSION, 1
.set CYIPBLOCK_m0s8tcpwm_VERSION, 0
.set CYIPBLOCK_m0s8udbif_VERSION, 0
.set CYIPBLOCK_S8_GPIO_VERSION, 2
.set CYDEV_BOOTLOADER_ENABLE, 0
.endif
