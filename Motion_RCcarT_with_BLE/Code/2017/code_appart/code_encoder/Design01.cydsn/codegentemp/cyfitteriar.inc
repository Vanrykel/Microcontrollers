;
; File Name: cyfitteriar.inc
; 
; PSoC Creator  4.1 Update 1
;
; Description:
; 
;
;-------------------------------------------------------------------------------
; Copyright (c) 2007-2017 Cypress Semiconductor.  All rights reserved.
; You may use this file only in accordance with the license, terms, conditions, 
; disclaimers, and limitations in the end user license agreement accompanying 
; the software package with which this file was provided.
;-------------------------------------------------------------------------------

#ifndef INCLUDED_CYFITTERIAR_INC
#define INCLUDED_CYFITTERIAR_INC
    INCLUDE cydeviceiar_trm.inc

/* encoderInputLeft */
encoderInputLeft__0__DM__MASK EQU 0x38
encoderInputLeft__0__DM__SHIFT EQU 3
encoderInputLeft__0__DR EQU CYREG_PRT1_DR
encoderInputLeft__0__HSIOM EQU CYREG_HSIOM_PORT_SEL1
encoderInputLeft__0__HSIOM_MASK EQU 0x000000F0
encoderInputLeft__0__HSIOM_SHIFT EQU 4
encoderInputLeft__0__INTCFG EQU CYREG_PRT1_INTCFG
encoderInputLeft__0__INTSTAT EQU CYREG_PRT1_INTSTAT
encoderInputLeft__0__MASK EQU 0x02
encoderInputLeft__0__PA__CFG0 EQU CYREG_UDB_PA1_CFG0
encoderInputLeft__0__PA__CFG1 EQU CYREG_UDB_PA1_CFG1
encoderInputLeft__0__PA__CFG10 EQU CYREG_UDB_PA1_CFG10
encoderInputLeft__0__PA__CFG11 EQU CYREG_UDB_PA1_CFG11
encoderInputLeft__0__PA__CFG12 EQU CYREG_UDB_PA1_CFG12
encoderInputLeft__0__PA__CFG13 EQU CYREG_UDB_PA1_CFG13
encoderInputLeft__0__PA__CFG14 EQU CYREG_UDB_PA1_CFG14
encoderInputLeft__0__PA__CFG2 EQU CYREG_UDB_PA1_CFG2
encoderInputLeft__0__PA__CFG3 EQU CYREG_UDB_PA1_CFG3
encoderInputLeft__0__PA__CFG4 EQU CYREG_UDB_PA1_CFG4
encoderInputLeft__0__PA__CFG5 EQU CYREG_UDB_PA1_CFG5
encoderInputLeft__0__PA__CFG6 EQU CYREG_UDB_PA1_CFG6
encoderInputLeft__0__PA__CFG7 EQU CYREG_UDB_PA1_CFG7
encoderInputLeft__0__PA__CFG8 EQU CYREG_UDB_PA1_CFG8
encoderInputLeft__0__PA__CFG9 EQU CYREG_UDB_PA1_CFG9
encoderInputLeft__0__PC EQU CYREG_PRT1_PC
encoderInputLeft__0__PC2 EQU CYREG_PRT1_PC2
encoderInputLeft__0__PORT EQU 1
encoderInputLeft__0__PS EQU CYREG_PRT1_PS
encoderInputLeft__0__SHIFT EQU 1
encoderInputLeft__DR EQU CYREG_PRT1_DR
encoderInputLeft__INTCFG EQU CYREG_PRT1_INTCFG
encoderInputLeft__INTSTAT EQU CYREG_PRT1_INTSTAT
encoderInputLeft__MASK EQU 0x02
encoderInputLeft__PA__CFG0 EQU CYREG_UDB_PA1_CFG0
encoderInputLeft__PA__CFG1 EQU CYREG_UDB_PA1_CFG1
encoderInputLeft__PA__CFG10 EQU CYREG_UDB_PA1_CFG10
encoderInputLeft__PA__CFG11 EQU CYREG_UDB_PA1_CFG11
encoderInputLeft__PA__CFG12 EQU CYREG_UDB_PA1_CFG12
encoderInputLeft__PA__CFG13 EQU CYREG_UDB_PA1_CFG13
encoderInputLeft__PA__CFG14 EQU CYREG_UDB_PA1_CFG14
encoderInputLeft__PA__CFG2 EQU CYREG_UDB_PA1_CFG2
encoderInputLeft__PA__CFG3 EQU CYREG_UDB_PA1_CFG3
encoderInputLeft__PA__CFG4 EQU CYREG_UDB_PA1_CFG4
encoderInputLeft__PA__CFG5 EQU CYREG_UDB_PA1_CFG5
encoderInputLeft__PA__CFG6 EQU CYREG_UDB_PA1_CFG6
encoderInputLeft__PA__CFG7 EQU CYREG_UDB_PA1_CFG7
encoderInputLeft__PA__CFG8 EQU CYREG_UDB_PA1_CFG8
encoderInputLeft__PA__CFG9 EQU CYREG_UDB_PA1_CFG9
encoderInputLeft__PC EQU CYREG_PRT1_PC
encoderInputLeft__PC2 EQU CYREG_PRT1_PC2
encoderInputLeft__PORT EQU 1
encoderInputLeft__PS EQU CYREG_PRT1_PS
encoderInputLeft__SHIFT EQU 1

/* encoderInputRight */
encoderInputRight__0__DM__MASK EQU 0x07
encoderInputRight__0__DM__SHIFT EQU 0
encoderInputRight__0__DR EQU CYREG_PRT1_DR
encoderInputRight__0__HSIOM EQU CYREG_HSIOM_PORT_SEL1
encoderInputRight__0__HSIOM_MASK EQU 0x0000000F
encoderInputRight__0__HSIOM_SHIFT EQU 0
encoderInputRight__0__INTCFG EQU CYREG_PRT1_INTCFG
encoderInputRight__0__INTSTAT EQU CYREG_PRT1_INTSTAT
encoderInputRight__0__MASK EQU 0x01
encoderInputRight__0__PA__CFG0 EQU CYREG_UDB_PA1_CFG0
encoderInputRight__0__PA__CFG1 EQU CYREG_UDB_PA1_CFG1
encoderInputRight__0__PA__CFG10 EQU CYREG_UDB_PA1_CFG10
encoderInputRight__0__PA__CFG11 EQU CYREG_UDB_PA1_CFG11
encoderInputRight__0__PA__CFG12 EQU CYREG_UDB_PA1_CFG12
encoderInputRight__0__PA__CFG13 EQU CYREG_UDB_PA1_CFG13
encoderInputRight__0__PA__CFG14 EQU CYREG_UDB_PA1_CFG14
encoderInputRight__0__PA__CFG2 EQU CYREG_UDB_PA1_CFG2
encoderInputRight__0__PA__CFG3 EQU CYREG_UDB_PA1_CFG3
encoderInputRight__0__PA__CFG4 EQU CYREG_UDB_PA1_CFG4
encoderInputRight__0__PA__CFG5 EQU CYREG_UDB_PA1_CFG5
encoderInputRight__0__PA__CFG6 EQU CYREG_UDB_PA1_CFG6
encoderInputRight__0__PA__CFG7 EQU CYREG_UDB_PA1_CFG7
encoderInputRight__0__PA__CFG8 EQU CYREG_UDB_PA1_CFG8
encoderInputRight__0__PA__CFG9 EQU CYREG_UDB_PA1_CFG9
encoderInputRight__0__PC EQU CYREG_PRT1_PC
encoderInputRight__0__PC2 EQU CYREG_PRT1_PC2
encoderInputRight__0__PORT EQU 1
encoderInputRight__0__PS EQU CYREG_PRT1_PS
encoderInputRight__0__SHIFT EQU 0
encoderInputRight__DR EQU CYREG_PRT1_DR
encoderInputRight__INTCFG EQU CYREG_PRT1_INTCFG
encoderInputRight__INTSTAT EQU CYREG_PRT1_INTSTAT
encoderInputRight__MASK EQU 0x01
encoderInputRight__PA__CFG0 EQU CYREG_UDB_PA1_CFG0
encoderInputRight__PA__CFG1 EQU CYREG_UDB_PA1_CFG1
encoderInputRight__PA__CFG10 EQU CYREG_UDB_PA1_CFG10
encoderInputRight__PA__CFG11 EQU CYREG_UDB_PA1_CFG11
encoderInputRight__PA__CFG12 EQU CYREG_UDB_PA1_CFG12
encoderInputRight__PA__CFG13 EQU CYREG_UDB_PA1_CFG13
encoderInputRight__PA__CFG14 EQU CYREG_UDB_PA1_CFG14
encoderInputRight__PA__CFG2 EQU CYREG_UDB_PA1_CFG2
encoderInputRight__PA__CFG3 EQU CYREG_UDB_PA1_CFG3
encoderInputRight__PA__CFG4 EQU CYREG_UDB_PA1_CFG4
encoderInputRight__PA__CFG5 EQU CYREG_UDB_PA1_CFG5
encoderInputRight__PA__CFG6 EQU CYREG_UDB_PA1_CFG6
encoderInputRight__PA__CFG7 EQU CYREG_UDB_PA1_CFG7
encoderInputRight__PA__CFG8 EQU CYREG_UDB_PA1_CFG8
encoderInputRight__PA__CFG9 EQU CYREG_UDB_PA1_CFG9
encoderInputRight__PC EQU CYREG_PRT1_PC
encoderInputRight__PC2 EQU CYREG_PRT1_PC2
encoderInputRight__PORT EQU 1
encoderInputRight__PS EQU CYREG_PRT1_PS
encoderInputRight__SHIFT EQU 0

/* isr_1 */
isr_1__INTC_CLR_EN_REG EQU CYREG_CM0_ICER
isr_1__INTC_CLR_PD_REG EQU CYREG_CM0_ICPR
isr_1__INTC_MASK EQU 0x01
isr_1__INTC_NUMBER EQU 0
isr_1__INTC_PRIOR_MASK EQU 0xC0
isr_1__INTC_PRIOR_NUM EQU 3
isr_1__INTC_PRIOR_REG EQU CYREG_CM0_IPR0
isr_1__INTC_SET_EN_REG EQU CYREG_CM0_ISER
isr_1__INTC_SET_PD_REG EQU CYREG_CM0_ISPR

/* isr_2 */
isr_2__INTC_CLR_EN_REG EQU CYREG_CM0_ICER
isr_2__INTC_CLR_PD_REG EQU CYREG_CM0_ICPR
isr_2__INTC_MASK EQU 0x04
isr_2__INTC_NUMBER EQU 2
isr_2__INTC_PRIOR_MASK EQU 0xC00000
isr_2__INTC_PRIOR_NUM EQU 3
isr_2__INTC_PRIOR_REG EQU CYREG_CM0_IPR0
isr_2__INTC_SET_EN_REG EQU CYREG_CM0_ISER
isr_2__INTC_SET_PD_REG EQU CYREG_CM0_ISPR

/* ledForward */
ledForward__0__DM__MASK EQU 0x1C0
ledForward__0__DM__SHIFT EQU 6
ledForward__0__DR EQU CYREG_PRT0_DR
ledForward__0__HSIOM EQU CYREG_HSIOM_PORT_SEL0
ledForward__0__HSIOM_MASK EQU 0x00000F00
ledForward__0__HSIOM_SHIFT EQU 8
ledForward__0__INTCFG EQU CYREG_PRT0_INTCFG
ledForward__0__INTSTAT EQU CYREG_PRT0_INTSTAT
ledForward__0__MASK EQU 0x04
ledForward__0__PA__CFG0 EQU CYREG_UDB_PA0_CFG0
ledForward__0__PA__CFG1 EQU CYREG_UDB_PA0_CFG1
ledForward__0__PA__CFG10 EQU CYREG_UDB_PA0_CFG10
ledForward__0__PA__CFG11 EQU CYREG_UDB_PA0_CFG11
ledForward__0__PA__CFG12 EQU CYREG_UDB_PA0_CFG12
ledForward__0__PA__CFG13 EQU CYREG_UDB_PA0_CFG13
ledForward__0__PA__CFG14 EQU CYREG_UDB_PA0_CFG14
ledForward__0__PA__CFG2 EQU CYREG_UDB_PA0_CFG2
ledForward__0__PA__CFG3 EQU CYREG_UDB_PA0_CFG3
ledForward__0__PA__CFG4 EQU CYREG_UDB_PA0_CFG4
ledForward__0__PA__CFG5 EQU CYREG_UDB_PA0_CFG5
ledForward__0__PA__CFG6 EQU CYREG_UDB_PA0_CFG6
ledForward__0__PA__CFG7 EQU CYREG_UDB_PA0_CFG7
ledForward__0__PA__CFG8 EQU CYREG_UDB_PA0_CFG8
ledForward__0__PA__CFG9 EQU CYREG_UDB_PA0_CFG9
ledForward__0__PC EQU CYREG_PRT0_PC
ledForward__0__PC2 EQU CYREG_PRT0_PC2
ledForward__0__PORT EQU 0
ledForward__0__PS EQU CYREG_PRT0_PS
ledForward__0__SHIFT EQU 2
ledForward__DR EQU CYREG_PRT0_DR
ledForward__INTCFG EQU CYREG_PRT0_INTCFG
ledForward__INTSTAT EQU CYREG_PRT0_INTSTAT
ledForward__MASK EQU 0x04
ledForward__PA__CFG0 EQU CYREG_UDB_PA0_CFG0
ledForward__PA__CFG1 EQU CYREG_UDB_PA0_CFG1
ledForward__PA__CFG10 EQU CYREG_UDB_PA0_CFG10
ledForward__PA__CFG11 EQU CYREG_UDB_PA0_CFG11
ledForward__PA__CFG12 EQU CYREG_UDB_PA0_CFG12
ledForward__PA__CFG13 EQU CYREG_UDB_PA0_CFG13
ledForward__PA__CFG14 EQU CYREG_UDB_PA0_CFG14
ledForward__PA__CFG2 EQU CYREG_UDB_PA0_CFG2
ledForward__PA__CFG3 EQU CYREG_UDB_PA0_CFG3
ledForward__PA__CFG4 EQU CYREG_UDB_PA0_CFG4
ledForward__PA__CFG5 EQU CYREG_UDB_PA0_CFG5
ledForward__PA__CFG6 EQU CYREG_UDB_PA0_CFG6
ledForward__PA__CFG7 EQU CYREG_UDB_PA0_CFG7
ledForward__PA__CFG8 EQU CYREG_UDB_PA0_CFG8
ledForward__PA__CFG9 EQU CYREG_UDB_PA0_CFG9
ledForward__PC EQU CYREG_PRT0_PC
ledForward__PC2 EQU CYREG_PRT0_PC2
ledForward__PORT EQU 0
ledForward__PS EQU CYREG_PRT0_PS
ledForward__SHIFT EQU 2

/* ledLeft */
ledLeft__0__DM__MASK EQU 0xE00
ledLeft__0__DM__SHIFT EQU 9
ledLeft__0__DR EQU CYREG_PRT0_DR
ledLeft__0__HSIOM EQU CYREG_HSIOM_PORT_SEL0
ledLeft__0__HSIOM_MASK EQU 0x0000F000
ledLeft__0__HSIOM_SHIFT EQU 12
ledLeft__0__INTCFG EQU CYREG_PRT0_INTCFG
ledLeft__0__INTSTAT EQU CYREG_PRT0_INTSTAT
ledLeft__0__MASK EQU 0x08
ledLeft__0__PA__CFG0 EQU CYREG_UDB_PA0_CFG0
ledLeft__0__PA__CFG1 EQU CYREG_UDB_PA0_CFG1
ledLeft__0__PA__CFG10 EQU CYREG_UDB_PA0_CFG10
ledLeft__0__PA__CFG11 EQU CYREG_UDB_PA0_CFG11
ledLeft__0__PA__CFG12 EQU CYREG_UDB_PA0_CFG12
ledLeft__0__PA__CFG13 EQU CYREG_UDB_PA0_CFG13
ledLeft__0__PA__CFG14 EQU CYREG_UDB_PA0_CFG14
ledLeft__0__PA__CFG2 EQU CYREG_UDB_PA0_CFG2
ledLeft__0__PA__CFG3 EQU CYREG_UDB_PA0_CFG3
ledLeft__0__PA__CFG4 EQU CYREG_UDB_PA0_CFG4
ledLeft__0__PA__CFG5 EQU CYREG_UDB_PA0_CFG5
ledLeft__0__PA__CFG6 EQU CYREG_UDB_PA0_CFG6
ledLeft__0__PA__CFG7 EQU CYREG_UDB_PA0_CFG7
ledLeft__0__PA__CFG8 EQU CYREG_UDB_PA0_CFG8
ledLeft__0__PA__CFG9 EQU CYREG_UDB_PA0_CFG9
ledLeft__0__PC EQU CYREG_PRT0_PC
ledLeft__0__PC2 EQU CYREG_PRT0_PC2
ledLeft__0__PORT EQU 0
ledLeft__0__PS EQU CYREG_PRT0_PS
ledLeft__0__SHIFT EQU 3
ledLeft__DR EQU CYREG_PRT0_DR
ledLeft__INTCFG EQU CYREG_PRT0_INTCFG
ledLeft__INTSTAT EQU CYREG_PRT0_INTSTAT
ledLeft__MASK EQU 0x08
ledLeft__PA__CFG0 EQU CYREG_UDB_PA0_CFG0
ledLeft__PA__CFG1 EQU CYREG_UDB_PA0_CFG1
ledLeft__PA__CFG10 EQU CYREG_UDB_PA0_CFG10
ledLeft__PA__CFG11 EQU CYREG_UDB_PA0_CFG11
ledLeft__PA__CFG12 EQU CYREG_UDB_PA0_CFG12
ledLeft__PA__CFG13 EQU CYREG_UDB_PA0_CFG13
ledLeft__PA__CFG14 EQU CYREG_UDB_PA0_CFG14
ledLeft__PA__CFG2 EQU CYREG_UDB_PA0_CFG2
ledLeft__PA__CFG3 EQU CYREG_UDB_PA0_CFG3
ledLeft__PA__CFG4 EQU CYREG_UDB_PA0_CFG4
ledLeft__PA__CFG5 EQU CYREG_UDB_PA0_CFG5
ledLeft__PA__CFG6 EQU CYREG_UDB_PA0_CFG6
ledLeft__PA__CFG7 EQU CYREG_UDB_PA0_CFG7
ledLeft__PA__CFG8 EQU CYREG_UDB_PA0_CFG8
ledLeft__PA__CFG9 EQU CYREG_UDB_PA0_CFG9
ledLeft__PC EQU CYREG_PRT0_PC
ledLeft__PC2 EQU CYREG_PRT0_PC2
ledLeft__PORT EQU 0
ledLeft__PS EQU CYREG_PRT0_PS
ledLeft__SHIFT EQU 3

/* ledRight */
ledRight__0__DM__MASK EQU 0x1C0000
ledRight__0__DM__SHIFT EQU 18
ledRight__0__DR EQU CYREG_PRT1_DR
ledRight__0__HSIOM EQU CYREG_HSIOM_PORT_SEL1
ledRight__0__HSIOM_MASK EQU 0x0F000000
ledRight__0__HSIOM_SHIFT EQU 24
ledRight__0__INTCFG EQU CYREG_PRT1_INTCFG
ledRight__0__INTSTAT EQU CYREG_PRT1_INTSTAT
ledRight__0__MASK EQU 0x40
ledRight__0__PA__CFG0 EQU CYREG_UDB_PA1_CFG0
ledRight__0__PA__CFG1 EQU CYREG_UDB_PA1_CFG1
ledRight__0__PA__CFG10 EQU CYREG_UDB_PA1_CFG10
ledRight__0__PA__CFG11 EQU CYREG_UDB_PA1_CFG11
ledRight__0__PA__CFG12 EQU CYREG_UDB_PA1_CFG12
ledRight__0__PA__CFG13 EQU CYREG_UDB_PA1_CFG13
ledRight__0__PA__CFG14 EQU CYREG_UDB_PA1_CFG14
ledRight__0__PA__CFG2 EQU CYREG_UDB_PA1_CFG2
ledRight__0__PA__CFG3 EQU CYREG_UDB_PA1_CFG3
ledRight__0__PA__CFG4 EQU CYREG_UDB_PA1_CFG4
ledRight__0__PA__CFG5 EQU CYREG_UDB_PA1_CFG5
ledRight__0__PA__CFG6 EQU CYREG_UDB_PA1_CFG6
ledRight__0__PA__CFG7 EQU CYREG_UDB_PA1_CFG7
ledRight__0__PA__CFG8 EQU CYREG_UDB_PA1_CFG8
ledRight__0__PA__CFG9 EQU CYREG_UDB_PA1_CFG9
ledRight__0__PC EQU CYREG_PRT1_PC
ledRight__0__PC2 EQU CYREG_PRT1_PC2
ledRight__0__PORT EQU 1
ledRight__0__PS EQU CYREG_PRT1_PS
ledRight__0__SHIFT EQU 6
ledRight__DR EQU CYREG_PRT1_DR
ledRight__INTCFG EQU CYREG_PRT1_INTCFG
ledRight__INTSTAT EQU CYREG_PRT1_INTSTAT
ledRight__MASK EQU 0x40
ledRight__PA__CFG0 EQU CYREG_UDB_PA1_CFG0
ledRight__PA__CFG1 EQU CYREG_UDB_PA1_CFG1
ledRight__PA__CFG10 EQU CYREG_UDB_PA1_CFG10
ledRight__PA__CFG11 EQU CYREG_UDB_PA1_CFG11
ledRight__PA__CFG12 EQU CYREG_UDB_PA1_CFG12
ledRight__PA__CFG13 EQU CYREG_UDB_PA1_CFG13
ledRight__PA__CFG14 EQU CYREG_UDB_PA1_CFG14
ledRight__PA__CFG2 EQU CYREG_UDB_PA1_CFG2
ledRight__PA__CFG3 EQU CYREG_UDB_PA1_CFG3
ledRight__PA__CFG4 EQU CYREG_UDB_PA1_CFG4
ledRight__PA__CFG5 EQU CYREG_UDB_PA1_CFG5
ledRight__PA__CFG6 EQU CYREG_UDB_PA1_CFG6
ledRight__PA__CFG7 EQU CYREG_UDB_PA1_CFG7
ledRight__PA__CFG8 EQU CYREG_UDB_PA1_CFG8
ledRight__PA__CFG9 EQU CYREG_UDB_PA1_CFG9
ledRight__PC EQU CYREG_PRT1_PC
ledRight__PC2 EQU CYREG_PRT1_PC2
ledRight__PORT EQU 1
ledRight__PS EQU CYREG_PRT1_PS
ledRight__SHIFT EQU 6

/* Miscellaneous */
CYDEV_BCLK__HFCLK__HZ EQU 24000000
CYDEV_BCLK__HFCLK__KHZ EQU 24000
CYDEV_BCLK__HFCLK__MHZ EQU 24
CYDEV_BCLK__SYSCLK__HZ EQU 24000000
CYDEV_BCLK__SYSCLK__KHZ EQU 24000
CYDEV_BCLK__SYSCLK__MHZ EQU 24
CYDEV_CHIP_DIE_LEOPARD EQU 1
CYDEV_CHIP_DIE_PSOC4A EQU 16
CYDEV_CHIP_DIE_PSOC5LP EQU 2
CYDEV_CHIP_DIE_PSOC5TM EQU 3
CYDEV_CHIP_DIE_TMA4 EQU 4
CYDEV_CHIP_DIE_UNKNOWN EQU 0
CYDEV_CHIP_FAMILY_FM0P EQU 5
CYDEV_CHIP_FAMILY_FM3 EQU 6
CYDEV_CHIP_FAMILY_FM4 EQU 7
CYDEV_CHIP_FAMILY_PSOC3 EQU 1
CYDEV_CHIP_FAMILY_PSOC4 EQU 2
CYDEV_CHIP_FAMILY_PSOC5 EQU 3
CYDEV_CHIP_FAMILY_PSOC6 EQU 4
CYDEV_CHIP_FAMILY_UNKNOWN EQU 0
CYDEV_CHIP_FAMILY_USED EQU CYDEV_CHIP_FAMILY_PSOC4
CYDEV_CHIP_JTAG_ID EQU 0x04C81193
CYDEV_CHIP_MEMBER_3A EQU 1
CYDEV_CHIP_MEMBER_4A EQU 16
CYDEV_CHIP_MEMBER_4D EQU 12
CYDEV_CHIP_MEMBER_4E EQU 6
CYDEV_CHIP_MEMBER_4F EQU 17
CYDEV_CHIP_MEMBER_4G EQU 4
CYDEV_CHIP_MEMBER_4H EQU 15
CYDEV_CHIP_MEMBER_4I EQU 21
CYDEV_CHIP_MEMBER_4J EQU 13
CYDEV_CHIP_MEMBER_4K EQU 14
CYDEV_CHIP_MEMBER_4L EQU 20
CYDEV_CHIP_MEMBER_4M EQU 19
CYDEV_CHIP_MEMBER_4N EQU 9
CYDEV_CHIP_MEMBER_4O EQU 7
CYDEV_CHIP_MEMBER_4P EQU 18
CYDEV_CHIP_MEMBER_4Q EQU 11
CYDEV_CHIP_MEMBER_4R EQU 8
CYDEV_CHIP_MEMBER_4S EQU 10
CYDEV_CHIP_MEMBER_4U EQU 5
CYDEV_CHIP_MEMBER_5A EQU 3
CYDEV_CHIP_MEMBER_5B EQU 2
CYDEV_CHIP_MEMBER_6A EQU 22
CYDEV_CHIP_MEMBER_FM3 EQU 26
CYDEV_CHIP_MEMBER_FM4 EQU 27
CYDEV_CHIP_MEMBER_PDL_FM0P_TYPE1 EQU 23
CYDEV_CHIP_MEMBER_PDL_FM0P_TYPE2 EQU 24
CYDEV_CHIP_MEMBER_PDL_FM0P_TYPE3 EQU 25
CYDEV_CHIP_MEMBER_UNKNOWN EQU 0
CYDEV_CHIP_MEMBER_USED EQU CYDEV_CHIP_MEMBER_4A
CYDEV_CHIP_DIE_EXPECT EQU CYDEV_CHIP_MEMBER_USED
CYDEV_CHIP_DIE_ACTUAL EQU CYDEV_CHIP_DIE_EXPECT
CYDEV_CHIP_REV_LEOPARD_ES1 EQU 0
CYDEV_CHIP_REV_LEOPARD_ES2 EQU 1
CYDEV_CHIP_REV_LEOPARD_ES3 EQU 3
CYDEV_CHIP_REV_LEOPARD_PRODUCTION EQU 3
CYDEV_CHIP_REV_PSOC4A_ES0 EQU 17
CYDEV_CHIP_REV_PSOC4A_PRODUCTION EQU 17
CYDEV_CHIP_REV_PSOC5LP_ES0 EQU 0
CYDEV_CHIP_REV_PSOC5LP_PRODUCTION EQU 0
CYDEV_CHIP_REV_PSOC5TM_ES0 EQU 0
CYDEV_CHIP_REV_PSOC5TM_ES1 EQU 1
CYDEV_CHIP_REV_PSOC5TM_PRODUCTION EQU 1
CYDEV_CHIP_REV_TMA4_ES EQU 17
CYDEV_CHIP_REV_TMA4_ES2 EQU 33
CYDEV_CHIP_REV_TMA4_PRODUCTION EQU 17
CYDEV_CHIP_REVISION_3A_ES1 EQU 0
CYDEV_CHIP_REVISION_3A_ES2 EQU 1
CYDEV_CHIP_REVISION_3A_ES3 EQU 3
CYDEV_CHIP_REVISION_3A_PRODUCTION EQU 3
CYDEV_CHIP_REVISION_4A_ES0 EQU 17
CYDEV_CHIP_REVISION_4A_PRODUCTION EQU 17
CYDEV_CHIP_REVISION_4D_PRODUCTION EQU 0
CYDEV_CHIP_REVISION_4E_PRODUCTION EQU 0
CYDEV_CHIP_REVISION_4F_PRODUCTION EQU 0
CYDEV_CHIP_REVISION_4F_PRODUCTION_256DMA EQU 0
CYDEV_CHIP_REVISION_4F_PRODUCTION_256K EQU 0
CYDEV_CHIP_REVISION_4G_ES EQU 17
CYDEV_CHIP_REVISION_4G_ES2 EQU 33
CYDEV_CHIP_REVISION_4G_PRODUCTION EQU 17
CYDEV_CHIP_REVISION_4H_PRODUCTION EQU 0
CYDEV_CHIP_REVISION_4I_PRODUCTION EQU 0
CYDEV_CHIP_REVISION_4J_PRODUCTION EQU 0
CYDEV_CHIP_REVISION_4K_PRODUCTION EQU 0
CYDEV_CHIP_REVISION_4L_PRODUCTION EQU 0
CYDEV_CHIP_REVISION_4M_PRODUCTION EQU 0
CYDEV_CHIP_REVISION_4N_PRODUCTION EQU 0
CYDEV_CHIP_REVISION_4O_PRODUCTION EQU 0
CYDEV_CHIP_REVISION_4P_PRODUCTION EQU 0
CYDEV_CHIP_REVISION_4Q_PRODUCTION EQU 0
CYDEV_CHIP_REVISION_4R_PRODUCTION EQU 0
CYDEV_CHIP_REVISION_4S_PRODUCTION EQU 0
CYDEV_CHIP_REVISION_4U_PRODUCTION EQU 0
CYDEV_CHIP_REVISION_5A_ES0 EQU 0
CYDEV_CHIP_REVISION_5A_ES1 EQU 1
CYDEV_CHIP_REVISION_5A_PRODUCTION EQU 1
CYDEV_CHIP_REVISION_5B_ES0 EQU 0
CYDEV_CHIP_REVISION_5B_PRODUCTION EQU 0
CYDEV_CHIP_REVISION_6A_NO_UDB EQU 0
CYDEV_CHIP_REVISION_6A_PRODUCTION EQU 0
CYDEV_CHIP_REVISION_FM3_PRODUCTION EQU 0
CYDEV_CHIP_REVISION_FM4_PRODUCTION EQU 0
CYDEV_CHIP_REVISION_PDL_FM0P_TYPE1_PRODUCTION EQU 0
CYDEV_CHIP_REVISION_PDL_FM0P_TYPE2_PRODUCTION EQU 0
CYDEV_CHIP_REVISION_PDL_FM0P_TYPE3_PRODUCTION EQU 0
CYDEV_CHIP_REVISION_USED EQU CYDEV_CHIP_REVISION_4A_PRODUCTION
CYDEV_CHIP_REV_EXPECT EQU CYDEV_CHIP_REVISION_USED
CYDEV_CONFIG_READ_ACCELERATOR EQU 1
CYDEV_CONFIG_UNUSED_IO_AllowButWarn EQU 0
CYDEV_CONFIG_UNUSED_IO_AllowWithInfo EQU 1
CYDEV_CONFIG_UNUSED_IO_Disallowed EQU 2
CYDEV_CONFIG_UNUSED_IO EQU CYDEV_CONFIG_UNUSED_IO_Disallowed
CYDEV_CONFIGURATION_COMPRESSED EQU 1
CYDEV_CONFIGURATION_MODE_COMPRESSED EQU 0
CYDEV_CONFIGURATION_MODE EQU CYDEV_CONFIGURATION_MODE_COMPRESSED
CYDEV_CONFIGURATION_MODE_DMA EQU 2
CYDEV_CONFIGURATION_MODE_UNCOMPRESSED EQU 1
CYDEV_DEBUG_PROTECT_KILL EQU 4
CYDEV_DEBUG_PROTECT_OPEN EQU 1
CYDEV_DEBUG_PROTECT EQU CYDEV_DEBUG_PROTECT_OPEN
CYDEV_DEBUG_PROTECT_PROTECTED EQU 2
CYDEV_DEBUGGING_DPS_Disable EQU 3
CYDEV_DEBUGGING_DPS_SWD EQU 2
CYDEV_DEBUGGING_DPS EQU CYDEV_DEBUGGING_DPS_SWD
CYDEV_DEBUGGING_ENABLE EQU 1
CYDEV_DFT_SELECT_CLK0 EQU 1
CYDEV_DFT_SELECT_CLK1 EQU 2
CYDEV_HEAP_SIZE EQU 0x80
CYDEV_IMO_TRIMMED_BY_USB EQU 0
CYDEV_IMO_TRIMMED_BY_WCO EQU 0
CYDEV_IS_EXPORTING_CODE EQU 0
CYDEV_IS_IMPORTING_CODE EQU 0
CYDEV_PROJ_TYPE EQU 0
CYDEV_PROJ_TYPE_BOOTLOADER EQU 1
CYDEV_PROJ_TYPE_LAUNCHER EQU 5
CYDEV_PROJ_TYPE_LOADABLE EQU 2
CYDEV_PROJ_TYPE_LOADABLEANDBOOTLOADER EQU 4
CYDEV_PROJ_TYPE_MULTIAPPBOOTLOADER EQU 3
CYDEV_PROJ_TYPE_STANDARD EQU 0
CYDEV_STACK_SIZE EQU 0x0400
CYDEV_USE_BUNDLED_CMSIS EQU 1
CYDEV_VARIABLE_VDDA EQU 1
CYDEV_VDDA_MV EQU 3300
CYDEV_VDDD_MV EQU 3300
CYDEV_WDT_GENERATE_ISR EQU 1
CYIPBLOCK_M0S8_CTBM_VERSION EQU 0
CYIPBLOCK_m0s8cpuss_VERSION EQU 0
CYIPBLOCK_m0s8csd_VERSION EQU 0
CYIPBLOCK_m0s8gpio2_VERSION EQU 0
CYIPBLOCK_m0s8hsiom4a_VERSION EQU 0
CYIPBLOCK_m0s8lcd_VERSION EQU 0
CYIPBLOCK_m0s8lpcomp_VERSION EQU 0
CYIPBLOCK_m0s8pclk_VERSION EQU 0
CYIPBLOCK_m0s8sar_VERSION EQU 0
CYIPBLOCK_m0s8scb_VERSION EQU 0
CYIPBLOCK_m0s8srssv2_VERSION EQU 1
CYIPBLOCK_m0s8tcpwm_VERSION EQU 0
CYIPBLOCK_m0s8udbif_VERSION EQU 0
CYIPBLOCK_S8_GPIO_VERSION EQU 2
CYDEV_BOOTLOADER_ENABLE EQU 0

#endif /* INCLUDED_CYFITTERIAR_INC */
